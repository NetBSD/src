/*	$NetBSD: t_cgd_adiantum.c,v 1.4 2020/08/15 10:03:10 mlelstv Exp $	*/

/*-
 * Copyright (c) 2020 The NetBSD Foundation, Inc.
 * All rights reserved.
 *
 * Redistribution and use in source and binary forms, with or without
 * modification, are permitted provided that the following conditions
 * are met:
 * 1. Redistributions of source code must retain the above copyright
 *    notice, this list of conditions and the following disclaimer.
 * 2. Redistributions in binary form must reproduce the above copyright
 *    notice, this list of conditions and the following disclaimer in the
 *    documentation and/or other materials provided with the distribution.
 *
 * THIS SOFTWARE IS PROVIDED BY THE NETBSD FOUNDATION, INC. AND CONTRIBUTORS
 * ``AS IS'' AND ANY EXPRESS OR IMPLIED WARRANTIES, INCLUDING, BUT NOT LIMITED
 * TO, THE IMPLIED WARRANTIES OF MERCHANTABILITY AND FITNESS FOR A PARTICULAR
 * PURPOSE ARE DISCLAIMED.  IN NO EVENT SHALL THE FOUNDATION OR CONTRIBUTORS
 * BE LIABLE FOR ANY DIRECT, INDIRECT, INCIDENTAL, SPECIAL, EXEMPLARY, OR
 * CONSEQUENTIAL DAMAGES (INCLUDING, BUT NOT LIMITED TO, PROCUREMENT OF
 * SUBSTITUTE GOODS OR SERVICES; LOSS OF USE, DATA, OR PROFITS; OR BUSINESS
 * INTERRUPTION) HOWEVER CAUSED AND ON ANY THEORY OF LIABILITY, WHETHER IN
 * CONTRACT, STRICT LIABILITY, OR TORT (INCLUDING NEGLIGENCE OR OTHERWISE)
 * ARISING IN ANY WAY OUT OF THE USE OF THIS SOFTWARE, EVEN IF ADVISED OF THE
 * POSSIBILITY OF SUCH DAMAGE.
 */

#include <sys/types.h>

#include <fcntl.h>
#include <stdint.h>
#include <stdint.h>
#include <stdio.h>
#include <unistd.h>
#include <util.h>

#include <dev/cgdvar.h>

#include <rump/rump.h>
#include <rump/rump_syscalls.h>

#include <atf-c.h>

#include "h_macros.h"

#define	MAXSECSIZE	512	/* for now; should be cgd parameter */
#define	IMGSIZE		0x101*512

static const struct {
	uint8_t		key[32];
	uint64_t	blkno;
	unsigned	secsize;
	const uint8_t	*ptxt;
	const uint8_t	*ctxt;
} C[] = {
	[0] = {
		.key = {0},
		.blkno = 0,
		.secsize = 512,
		.ptxt = (const __aligned(4) uint8_t[512]) {0},
		.ctxt = (const uint8_t[512]) {
			0x51,0x6d,0xe2,0x81, 0x26,0xd5,0xc8,0xd7,
			0xff,0xc6,0xc2,0xff, 0x39,0xbf,0x15,0x15,
			0x46,0x80,0x44,0x65, 0x76,0xa1,0x56,0xae,
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			0xd6,0x13,0x00,0xee, 0x2c,0x18,0x49,0xd9,
		},
	},
	[1] = {
		.key = {0},
		.blkno = 1,
		.secsize = 512,
		.ptxt = (const __aligned(4) uint8_t[512]) {0},
		.ctxt = (const uint8_t[512]) {
			0xf2,0x23,0x68,0x5a, 0x15,0x11,0x56,0xa1,
			0x71,0x57,0x5c,0x5e, 0x32,0xd4,0xdd,0xbb,
			0x7a,0x0c,0x84,0x23, 0xe9,0x2f,0x1b,0x63,
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			0x6c,0xef,0xe9,0x62, 0x21,0x89,0x23,0xfd,
		},
	},
	[2] = {
		.key = {0},
		.blkno = 0x100,
		.secsize = 512,
		.ptxt = (const __aligned(4) uint8_t[512]) {0},
		.ctxt = (const uint8_t[512]) {
			0x32,0x26,0xaf,0x56, 0xbc,0x43,0xac,0x37,
			0xb2,0x8d,0xa4,0xfb, 0x32,0xdc,0x09,0x03,
			0xd9,0x44,0xce,0x4e, 0x70,0xaf,0xed,0x83,
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			0x9a,0x10,0x7e,0x50, 0x7e,0xd3,0xe2,0x9d,
		},
	},
};

static void
hexdump(const void *buf, size_t len)
{
	const unsigned char *p = buf;
	size_t i;

	for (i = 0; i < len; i++) {
		if (i % 16 == 8)
			printf(" ");
		printf(" %02hhx", p[i]);
		if ((i + 1) % 16 == 0)
			printf("\n");
	}
	if (i % 16)
		printf("\n");
}

static int
configure_cgd(int fd, const char *dkpath, const char *alg,
    const char *ivmethod, const void *key, size_t keybytes)
{
	struct cgd_ioctl ci;

	memset(&ci, 0, sizeof(ci));
	ci.ci_disk = dkpath;
	ci.ci_alg = alg;
	ci.ci_ivmethod = ivmethod;
	ci.ci_keylen = 8*keybytes;
	ci.ci_key = key;
	ci.ci_blocksize = (size_t)-1;

	return rump_sys_ioctl(fd, CGDIOCSET, &ci);
}

static int
unconfigure_cgd(int fd)
{
	struct cgd_ioctl ci;

	return rump_sys_ioctl(fd, CGDIOCCLR, &ci);
}

ATF_TC(cgd_adiantum);
ATF_TC_HEAD(cgd_adiantum, tc)
{

	atf_tc_set_md_var(tc, "descr", "Adiantum tests");
}

ATF_TC_BODY(cgd_adiantum, tc)
{
	static uint8_t buf[MAXSECSIZE];
	static const char imgpath[] = "adiantum.img";
	static const char dkpath[] = "/dev/dk";
	char cgdpath[MAXPATHLEN];
	int dkfd, cgdfd;
	unsigned i;
	ssize_t nwrit, nread;

	rump_init();

	RL(dkfd = open(imgpath, O_CREAT|O_RDWR|O_TRUNC, 0600));
	RL(ftruncate(dkfd, IMGSIZE));
	RL(rump_pub_etfs_register_withsize(dkpath, imgpath, RUMP_ETFS_BLK, 0,
		IMGSIZE));
	snprintf(cgdpath, sizeof cgdpath, "/dev/rcgd0%c",
	    getrawpartition() + 'a');
	RL(cgdfd = rump_sys_open(cgdpath, O_RDWR));

	for (i = 0; i < __arraycount(C); i++) {
		/* write the plaintext out via cgd */
		RL(configure_cgd(cgdfd, dkpath, "adiantum", "encblkno1",
			C[i].key, 32));
		RL(nwrit = rump_sys_pwrite(cgdfd, C[i].ptxt, C[i].secsize,
			C[i].blkno * C[i].secsize));
		RL(unconfigure_cgd(cgdfd));
		if ((size_t)nwrit != C[i].secsize) {
			atf_tc_fail_nonfatal("truncated write: %zd != %u",
			    nwrit, C[i].secsize);
			continue;
		}

		/* read the ciphertext out from the underlying file */
		RL(nread = pread(dkfd, buf, C[i].secsize,
			C[i].blkno * C[i].secsize));
		if ((size_t)nread != C[i].secsize) {
			atf_tc_fail_nonfatal("truncated read: %zd != %u",
			    nread, C[i].secsize);
			continue;
		}
		if (memcmp(buf, C[i].ctxt, C[i].secsize)) {
			hexdump(buf, C[i].secsize);
			hexdump(C[i].ctxt, C[i].secsize);
			atf_tc_fail_nonfatal("case %u ctxt mismatch", i);
			continue;
		}

		/* read the plaintext back via cgd */
		RL(configure_cgd(cgdfd, dkpath, "adiantum", "encblkno1",
			C[i].key, 32));
		RL(nread = rump_sys_pread(cgdfd, buf, C[i].secsize,
			C[i].blkno * C[i].secsize));
		RL(unconfigure_cgd(cgdfd));
		if ((size_t)nread != C[i].secsize) {
			atf_tc_fail_nonfatal("truncated read: %zd != %u",
			    nread, C[i].secsize);
			continue;
		}
		if (memcmp(buf, C[i].ptxt, C[i].secsize)) {
			hexdump(buf, C[i].secsize);
			atf_tc_fail_nonfatal("case %u ptxt mismatch", i);
			continue;
		}
	}

	RL(rump_sys_close(cgdfd));
	RL(close(dkfd));
}

ATF_TP_ADD_TCS(tp)
{

	ATF_TP_ADD_TC(tp, cgd_adiantum);

	return atf_no_error();
}
