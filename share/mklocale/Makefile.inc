# $FreeBSD: src/usr.bin/mklocale/data/Makefile,v 1.17.2.3 1999/08/29 15:31:04 peter Exp $

NOMAN=YES

#MKLOCALE=mklocale
MKLOCALE_CMD!=cd $(.CURDIR)/../../usr.bin/mklocale; \
	printf "xxx: .MAKE\n\t@echo \$${.OBJDIR}/mklocale\n" | ${MAKE} -s -f-
MKLOCALE=LD_LIBRARY_PATH=${DESTDIR}/usr/lib ${MKLOCALE_CMD}

LOCALES += da_DK.ISO8859-1
 LOCALESRC_da_DK.ISO8859-1 = lt_LN.ISO_8859-1
   ALIASES_da_DK.ISO8859-1+=

LOCALES += da_DK.ISO8859-15
 LOCALESRC_da_DK.ISO8859-15 = lt_LN.DIS_8859-15
   ALIASES_da_DK.ISO8859-15+=

LOCALES += de_AT.ISO8859-1
 LOCALESRC_de_AT.ISO8859-1 = lt_LN.ISO_8859-1
   ALIASES_de_AT.ISO8859-1+=

LOCALES += de_AT.ISO8859-15
 LOCALESRC_de_AT.ISO8859-15 = lt_LN.DIS_8859-15
   ALIASES_de_AT.ISO8859-15+=

LOCALES += de_CH.ISO8859-1
 LOCALESRC_de_CH.ISO8859-1 = lt_LN.ISO_8859-1
   ALIASES_de_CH.ISO8859-1+=

LOCALES += de_CH.ISO8859-15
 LOCALESRC_de_CH.ISO8859-15 = lt_LN.DIS_8859-15
   ALIASES_de_CH.ISO8859-15+=

LOCALES += de_DE.ISO8859-1
 LOCALESRC_de_DE.ISO8859-1 = lt_LN.ISO_8859-1
   ALIASES_de_DE.ISO8859-1+=

LOCALES += de_DE.ISO8859-15
 LOCALESRC_de_DE.ISO8859-15 = lt_LN.DIS_8859-15
   ALIASES_de_DE.ISO8859-15+=

LOCALES += en_AU.ISO8859-1
 LOCALESRC_en_AU.ISO8859-1 = lt_LN.ISO_8859-1
   ALIASES_en_AU.ISO8859-1+=

LOCALES += en_AU.ISO8859-15
 LOCALESRC_en_AU.ISO8859-15 = lt_LN.DIS_8859-15
   ALIASES_en_AU.ISO8859-15+=

LOCALES += en_CA.ISO8859-1
 LOCALESRC_en_CA.ISO8859-1 = lt_LN.ISO_8859-1
   ALIASES_en_CA.ISO8859-1+=

LOCALES += en_CA.ISO8859-15
 LOCALESRC_en_CA.ISO8859-15 = lt_LN.DIS_8859-15
   ALIASES_en_CA.ISO8859-15+=

LOCALES += en_GB.ISO8859-1
 LOCALESRC_en_GB.ISO8859-1 = lt_LN.ISO_8859-1
   ALIASES_en_GB.ISO8859-1+=

LOCALES += en_GB.ISO8859-15
 LOCALESRC_en_GB.ISO8859-15 = lt_LN.DIS_8859-15
   ALIASES_en_GB.ISO8859-15+=

LOCALES += en_US.ISO8859-1
 LOCALESRC_en_US.ISO8859-1 = lt_LN.ISO_8859-1
   ALIASES_en_US.ISO8859-1+=

LOCALES += en_US.ISO8859-15
 LOCALESRC_en_US.ISO8859-15 = lt_LN.DIS_8859-15
   ALIASES_en_US.ISO8859-15+=

LOCALES += es_ES.ISO8859-1
 LOCALESRC_es_ES.ISO8859-1 = lt_LN.ISO_8859-1
   ALIASES_es_ES.ISO8859-1+=

LOCALES += es_ES.ISO8859-15
 LOCALESRC_es_ES.ISO8859-15 = lt_LN.DIS_8859-15
   ALIASES_es_ES.ISO8859-15+=

LOCALES += fi_FI.ISO8859-1
 LOCALESRC_fi_FI.ISO8859-1 = lt_LN.ISO_8859-1
   ALIASES_fi_FI.ISO8859-1+=

LOCALES += fi_FI.ISO8859-15
 LOCALESRC_fi_FI.ISO8859-15 = lt_LN.DIS_8859-15
   ALIASES_fi_FI.ISO8859-15+=

LOCALES += fr_BE.ISO8859-1
 LOCALESRC_fr_BE.ISO8859-1 = lt_LN.ISO_8859-1
   ALIASES_fr_BE.ISO8859-1+=

LOCALES += fr_BE.ISO8859-15
 LOCALESRC_fr_BE.ISO8859-15 = lt_LN.DIS_8859-15
   ALIASES_fr_BE.ISO8859-15+=

LOCALES += fr_CA.ISO8859-1
 LOCALESRC_fr_CA.ISO8859-1 = lt_LN.ISO_8859-1
   ALIASES_fr_CA.ISO8859-1+=

LOCALES += fr_CA.ISO8859-15
 LOCALESRC_fr_CA.ISO8859-15 = lt_LN.DIS_8859-15
   ALIASES_fr_CA.ISO8859-15+=

LOCALES += fr_CH.ISO8859-1
 LOCALESRC_fr_CH.ISO8859-1 = lt_LN.ISO_8859-1
   ALIASES_fr_CH.ISO8859-1+=

LOCALES += fr_CH.ISO8859-15
 LOCALESRC_fr_CH.ISO8859-15 = lt_LN.DIS_8859-15
   ALIASES_fr_CH.ISO8859-15+=

LOCALES += fr_FR.ISO8859-1
 LOCALESRC_fr_FR.ISO8859-1 = lt_LN.ISO_8859-1
   ALIASES_fr_FR.ISO8859-1+=

LOCALES += fr_FR.ISO8859-15
 LOCALESRC_fr_FR.ISO8859-15 = lt_LN.DIS_8859-15
   ALIASES_fr_FR.ISO8859-15+=

LOCALES += is_IS.ISO8859-1
 LOCALESRC_is_IS.ISO8859-1 = lt_LN.ISO_8859-1
   ALIASES_is_IS.ISO8859-1+=

LOCALES += is_IS.ISO8859-15
 LOCALESRC_is_IS.ISO8859-15 = lt_LN.DIS_8859-15
   ALIASES_is_IS.ISO8859-15+=

LOCALES += it_CH.ISO8859-1
 LOCALESRC_it_CH.ISO8859-1 = lt_LN.ISO_8859-1
   ALIASES_it_CH.ISO8859-1+=

LOCALES += it_CH.ISO8859-15
 LOCALESRC_it_CH.ISO8859-15 = lt_LN.DIS_8859-15
   ALIASES_it_CH.ISO8859-15+=

LOCALES += it_IT.ISO8859-1
 LOCALESRC_it_IT.ISO8859-1 = lt_LN.ISO_8859-1
   ALIASES_it_IT.ISO8859-1+=

LOCALES += it_IT.ISO8859-15
 LOCALESRC_it_IT.ISO8859-15 = lt_LN.DIS_8859-15
   ALIASES_it_IT.ISO8859-15+=

LOCALES += nl_BE.ISO8859-1
 LOCALESRC_nl_BE.ISO8859-1 = lt_LN.ISO_8859-1
   ALIASES_nl_BE.ISO8859-1+=

LOCALES += nl_BE.ISO8859-15
 LOCALESRC_nl_BE.ISO8859-15 = lt_LN.DIS_8859-15
   ALIASES_nl_BE.ISO8859-15+=

LOCALES += nl_NL.ISO8859-1
 LOCALESRC_nl_NL.ISO8859-1 = lt_LN.ISO_8859-1
   ALIASES_nl_NL.ISO8859-1+=

LOCALES += nl_NL.ISO8859-15
 LOCALESRC_nl_NL.ISO8859-15 = lt_LN.DIS_8859-15
   ALIASES_nl_NL.ISO8859-15+=

LOCALES += no_NO.ISO8859-1
 LOCALESRC_no_NO.ISO8859-1 = lt_LN.ISO_8859-1
   ALIASES_no_NO.ISO8859-1+=

LOCALES += no_NO.ISO8859-15
 LOCALESRC_no_NO.ISO8859-15 = lt_LN.DIS_8859-15
   ALIASES_no_NO.ISO8859-15+=

LOCALES += pt_PT.ISO8859-1
 LOCALESRC_pt_PT.ISO8859-1 = lt_LN.ISO_8859-1
   ALIASES_pt_PT.ISO8859-1+=

LOCALES += pt_PT.ISO8859-15
 LOCALESRC_pt_PT.ISO8859-15 = lt_LN.DIS_8859-15
   ALIASES_pt_PT.ISO8859-15+=

LOCALES += sv_SE.ISO8859-1
 LOCALESRC_sv_SE.ISO8859-1 = lt_LN.ISO_8859-1
   ALIASES_sv_SE.ISO8859-1+=

LOCALES += sv_SE.ISO8859-15
 LOCALESRC_sv_SE.ISO8859-15 = lt_LN.DIS_8859-15
   ALIASES_sv_SE.ISO8859-15+=

LOCALES += hr_HR.ISO8859-2
 LOCALESRC_hr_HR.ISO8859-2 = lt_LN.ISO_8859-2
   ALIASES_hr_HR.ISO8859-2+=


LOCALES += hu_HU.ISO8859-2
 LOCALESRC_hu_HU.ISO8859-2 = lt_LN.ISO_8859-2
   ALIASES_hu_HU.ISO8859-2+=


LOCALES += pl_PL.ISO8859-2
 LOCALESRC_pl_PL.ISO8859-2 = lt_LN.ISO_8859-2
   ALIASES_pl_PL.ISO8859-2+=


LOCALES += sl_SI.ISO8859-2
 LOCALESRC_sl_SI.ISO8859-2 = lt_LN.ISO_8859-2
   ALIASES_sl_SI.ISO8859-2+=

LOCALES += en_US.UTF-8
 LOCALESRC_en_US.UTF-8 = en_US.UTF-8
   ALIASES_en_US.UTF-8+=

LOCALES += ja_JP.eucJP
 LOCALESRC_ja_JP.eucJP = ja_JP.eucJP
   ALIASES_ja_JP.eucJP+=

LOCALES += ko_KR.eucKR
 LOCALESRC_ko_KR.eucKR = ko_KR.eucKR
   ALIASES_ko_KR.eucKR+=

LOCALES += zh_CN.eucCN
 LOCALESRC_zh_CN.eucCN = zh_CN.eucCN
   ALIASES_zh_CN.eucCN+=

# XXX: EUC-TW is not EUC!
LOCALES += zh_TW.eucTW
 LOCALESRC_zh_TW.eucTW = zh_TW.eucTW
   ALIASES_zh_TW.eucTW+=

LOCALES += ja_JP.ISO2022-JP
 LOCALESRC_ja_JP.ISO2022-JP = ja_JP.ISO-2022-JP
   ALIASES_ja_JP.ISO2022-JP+=

LOCALES += ja_JP.ISO2022-JP2
 LOCALESRC_ja_JP.ISO2022-JP2 = ja_JP.ISO-2022-JP-2
   ALIASES_ja_JP.ISO2022-JP2+=

LOCALES += ja_JP.ct
 LOCALESRC_ja_JP.ct = ja_JP.CTEXT
   ALIASES_ja_JP.ct+=

LOCALES += ja_JP.SJIS
 LOCALESRC_ja_JP.SJIS = ja_JP.SJIS
   ALIASES_ja_JP.SJIS+=

LOCALES += zh_TW.Big5
 LOCALESRC_zh_TW.Big5 = zh_TW.BIG5
   ALIASES_zh_TW.Big5+= zh_TW.BIG5

LOCALES += ru_SU.CP866
 LOCALESRC_ru_SU.CP866 = ru_SU.CP866
   ALIASES_ru_SU.CP866+=

LOCALES += ru_SU.KOI8-R
 LOCALESRC_ru_SU.KOI8-R = ru_SU.KOI8-R
   ALIASES_ru_SU.KOI8-R+=



LOCALEDIR=	${DESTDIR}/usr/libdata/locale

.for locale in ${LOCALES}
LOCALESRCS += ${LOCALESRC_${locale}}
.endfor
CLEANFILES+= ${LOCALESRCS:S/$/.out/g}


.SUFFIXES: .src .out

.src.out:
	cpp -I${.CURDIR} < ${.IMPSRC} | sed -e '/^#/d' | \
        ${MKLOCALE} -o ${.TARGET}

.if !defined(_BUILD_TOOLS)
all: ${LOCALESRCS:S/$/.out/g}
realall: ${LOCALESRCS:S/$/.out/g}		# XXX for NetBSD-current XXX
.endif


.if !defined(_BUILD_TOOLS)
afterinstall:
	if [ ! -e ${LOCALEDIR} ] ; then \
		mkdir ${LOCALEDIR}; \
	fi
.for locale in ${LOCALES}
	if [ ! -e ${LOCALEDIR}/${locale} ] ; then \
		mkdir ${LOCALEDIR}/${locale}; \
	fi
	${INSTALL} ${COPY} -m 644 -o ${BINOWN} -g ${BINGRP} \
		${LOCALESRC_${locale}}.out ${LOCALEDIR}/${locale}/LC_CTYPE
.for alias in ${ALIASES_${locale}}
	if [ ! -e ${LOCALEDIR}/${alias} ] ; then \
		ln -s ${locale} ${LOCALEDIR}/${alias}; \
	fi
.endfor
.endfor
.endif

.include <bsd.prog.mk>
