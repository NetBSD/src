# from: Id: Makefile.inc,v 1.9 2000/05/21 14:22:35 minoura Exp

NOMAN=YES

#COLLDEF=colldef
COLLDEF_CMD!=cd $(.CURDIR)/../../usr.bin/colldef; \
	printf "xxx: .MAKE\n\t@echo \$${.OBJDIR}/colldef\n" | ${MAKE} -s -f-
COLLDEF=LD_LIBRARY_PATH=${DESTDIR}/usr/lib ${COLLDEF_CMD}


LOCALES += es_ES.ISO8859-1
 LOCALESRC_es_ES.ISO8859-1 = es_ES.ISO_8859-1
   ALIASES_es_ES.ISO8859-1+=

LOCALES += es_ES.ISO8859-15
 LOCALESRC_es_ES.ISO8859-15 = es_ES.DIS_8859-15
   ALIASES_es_ES.ISO8859-15+=

LOCALES += is_IS.ISO8859-1
 LOCALESRC_is_IS.ISO8859-1 = is_IS.ISO_8859-1
   ALIASES_is_IS.ISO8859-1+=

LOCALES += is_IS.ISO8859-15
 LOCALESRC_is_IS.ISO8859-15 = is_IS.DIS_8859-15
   ALIASES_is_IS.ISO8859-15+=

LOCALES += de_DE.ISO8859-1
 LOCALESRC_de_DE.ISO8859-1 = de_DE.ISO_8859-1
   ALIASES_de_DE.ISO8859-1+=

LOCALES += de_DE.ISO8859-15
 LOCALESRC_de_DE.ISO8859-15 = de_DE.DIS_8859-15
   ALIASES_de_DE.ISO8859-15+=

LOCALES += da_DK.ISO8859-1
 LOCALESRC_da_DK.ISO8859-1 = lt_LN.ISO_8859-1
   ALIASES_da_DK.ISO8859-1+=

LOCALES += da_DK.ISO8859-15
 LOCALESRC_da_DK.ISO8859-15 = lt_LN.DIS_8859-15
   ALIASES_da_DK.ISO8859-15+=

LOCALES += en_AU.ISO8859-1
 LOCALESRC_en_AU.ISO8859-1 = lt_LN.ISO_8859-1
   ALIASES_en_AU.ISO8859-1+=

LOCALES += en_AU.ISO8859-15
 LOCALESRC_en_AU.ISO8859-15 = lt_LN.DIS_8859-15
   ALIASES_en_AU.ISO8859-15+=

LOCALES += en_CA.ISO8859-1
 LOCALESRC_en_CA.ISO8859-1 = lt_LN.ISO_8859-1
   ALIASES_en_CA.ISO8859-1+=

LOCALES += en_CA.ISO8859-15
 LOCALESRC_en_CA.ISO8859-15 = lt_LN.DIS_8859-15
   ALIASES_en_CA.ISO8859-15+=

LOCALES += en_GB.ISO8859-1
 LOCALESRC_en_GB.ISO8859-1 = lt_LN.ISO_8859-1
   ALIASES_en_GB.ISO8859-1+=

LOCALES += en_GB.ISO8859-15
 LOCALESRC_en_GB.ISO8859-15 = lt_LN.DIS_8859-15
   ALIASES_en_GB.ISO8859-15+=

LOCALES += en_US.ISO8859-1
 LOCALESRC_en_US.ISO8859-1 = lt_LN.ISO_8859-1
   ALIASES_en_US.ISO8859-1+=

LOCALES += en_US.ISO8859-15
 LOCALESRC_en_US.ISO8859-15 = lt_LN.DIS_8859-15
   ALIASES_en_US.ISO8859-15+=

LOCALES += fi_FI.ISO8859-1
 LOCALESRC_fi_FI.ISO8859-1 = lt_LN.ISO_8859-1
   ALIASES_fi_FI.ISO8859-1+=

LOCALES += fi_FI.ISO8859-15
 LOCALESRC_fi_FI.ISO8859-15 = lt_LN.DIS_8859-15
   ALIASES_fi_FI.ISO8859-15+=

LOCALES += fr_BE.ISO8859-1
 LOCALESRC_fr_BE.ISO8859-1 = lt_LN.ISO_8859-1
   ALIASES_fr_BE.ISO8859-1+=

LOCALES += fr_BE.ISO8859-15
 LOCALESRC_fr_BE.ISO8859-15 = lt_LN.DIS_8859-15
   ALIASES_fr_BE.ISO8859-15+=

LOCALES += fr_CA.ISO8859-1
 LOCALESRC_fr_CA.ISO8859-1 = lt_LN.ISO_8859-1
   ALIASES_fr_CA.ISO8859-1+=

LOCALES += fr_CA.ISO8859-15
 LOCALESRC_fr_CA.ISO8859-15 = lt_LN.DIS_8859-15
   ALIASES_fr_CA.ISO8859-15+=

LOCALES += fr_CH.ISO8859-1
 LOCALESRC_fr_CH.ISO8859-1 = lt_LN.ISO_8859-1
   ALIASES_fr_CH.ISO8859-1+=

LOCALES += fr_CH.ISO8859-15
 LOCALESRC_fr_CH.ISO8859-15 = lt_LN.DIS_8859-15
   ALIASES_fr_CH.ISO8859-15+=

LOCALES += fr_FR.ISO8859-1
 LOCALESRC_fr_FR.ISO8859-1 = lt_LN.ISO_8859-1
   ALIASES_fr_FR.ISO8859-1+=

LOCALES += fr_FR.ISO8859-15
 LOCALESRC_fr_FR.ISO8859-15 = lt_LN.DIS_8859-15
   ALIASES_fr_FR.ISO8859-15+=

LOCALES += it_CH.ISO8859-1
 LOCALESRC_it_CH.ISO8859-1 = lt_LN.ISO_8859-1
   ALIASES_it_CH.ISO8859-1+=

LOCALES += it_CH.ISO8859-15
 LOCALESRC_it_CH.ISO8859-15 = lt_LN.DIS_8859-15
   ALIASES_it_CH.ISO8859-15+=

LOCALES += it_IT.ISO8859-1
 LOCALESRC_it_IT.ISO8859-1 = lt_LN.ISO_8859-1
   ALIASES_it_IT.ISO8859-1+=

LOCALES += it_IT.ISO8859-15
 LOCALESRC_it_IT.ISO8859-15 = lt_LN.DIS_8859-15
   ALIASES_it_IT.ISO8859-15+=

LOCALES += nl_BE.ISO8859-1
 LOCALESRC_nl_BE.ISO8859-1 = lt_LN.ISO_8859-1
   ALIASES_nl_BE.ISO8859-1+=

LOCALES += nl_BE.ISO8859-15
 LOCALESRC_nl_BE.ISO8859-15 = lt_LN.DIS_8859-15
   ALIASES_nl_BE.ISO8859-15+=

LOCALES += nl_NL.ISO8859-1
 LOCALESRC_nl_NL.ISO8859-1 = lt_LN.ISO_8859-1
   ALIASES_nl_NL.ISO8859-1+=

LOCALES += nl_NL.ISO8859-15
 LOCALESRC_nl_NL.ISO8859-15 = lt_LN.DIS_8859-15
   ALIASES_nl_NL.ISO8859-15+=

LOCALES += no_NO.ISO8859-1
 LOCALESRC_no_NO.ISO8859-1 = lt_LN.ISO_8859-1
   ALIASES_no_NO.ISO8859-1+=

LOCALES += no_NO.ISO8859-15
 LOCALESRC_no_NO.ISO8859-15 = lt_LN.DIS_8859-15
   ALIASES_no_NO.ISO8859-15+=

LOCALES += pt_PT.ISO8859-1
 LOCALESRC_pt_PT.ISO8859-1 = lt_LN.ISO_8859-1
   ALIASES_pt_PT.ISO8859-1+=

LOCALES += pt_PT.ISO8859-15
 LOCALESRC_pt_PT.ISO8859-15 = lt_LN.DIS_8859-15
   ALIASES_pt_PT.ISO8859-15+=

LOCALES += sv_SE.ISO8859-1
 LOCALESRC_sv_SE.ISO8859-1 = lt_LN.ISO_8859-1
   ALIASES_sv_SE.ISO8859-1+=

LOCALES += sv_SE.ISO8859-15
 LOCALESRC_sv_SE.ISO8859-15 = lt_LN.DIS_8859-15
   ALIASES_sv_SE.ISO8859-15+=

LOCALES += hr_HR.ISO8859-2
 LOCALESRC_hr_HR.ISO8859-2 = lt_LN.ISO_8859-2
   ALIASES_hr_HR.ISO8859-2+=


LOCALES += hu_HU.ISO8859-2
 LOCALESRC_hu_HU.ISO8859-2 = lt_LN.ISO_8859-2
   ALIASES_hu_HU.ISO8859-2+=


LOCALES += pl_PL.ISO8859-2
 LOCALESRC_pl_PL.ISO8859-2 = lt_LN.ISO_8859-2
   ALIASES_pl_PL.ISO8859-2+=


LOCALES += sl_SI.ISO8859-2
 LOCALESRC_sl_SI.ISO8859-2 = lt_LN.ISO_8859-2
   ALIASES_sl_SI.ISO8859-2+=


LOCALES += de_AT.ISO8859-1
 LOCALESRC_de_AT.ISO8859-1 = de_DE.ISO_8859-1
   ALIASES_de_AT.ISO8859-1+=

LOCALES += de_AT.ISO8859-15
 LOCALESRC_de_AT.ISO8859-15 = de_DE.DIS_8859-15
   ALIASES_de_AT.ISO8859-15+=

LOCALES += de_CH.ISO8859-1
 LOCALESRC_de_CH.ISO8859-1 = de_DE.ISO_8859-1
   ALIASES_de_CH.ISO8859-1+=

LOCALES += de_CH.ISO8859-15
 LOCALESRC_de_CH.ISO8859-15 = de_DE.DIS_8859-15
   ALIASES_de_CH.ISO8859-15+=



LOCALES += en_US.UTF-8
 LOCALESRC_en_US.UTF-8 = lt_LN.ISO_8859-1
   ALIASES_en_US.UTF-8+=

LOCALES += ja_JP.eucJP
 LOCALESRC_ja_JP.eucJP = lt_LN.ASCII
   ALIASES_ja_JP.eucJP+= ja_JP.EUC

LOCALES += ko_KR.eucKR
 LOCALESRC_ko_KR.eucKR = lt_LN.ASCII
   ALIASES_ko_KR.eucKR+= ko_KR.EUC

LOCALES += zh_CN.eucCN
 LOCALESRC_zh_CN.eucCN = lt_LN.ASCII
   ALIASES_zh_CN.eucCN+= zh_CN.EUC

# XXX: EUC-TW is not EUC!
LOCALES += zh_TW.eucTW
 LOCALESRC_zh_TW.eucTW = lt_LN.ASCII
   ALIASES_zh_TW.eucTW+= zh_TW.EUC

LOCALES += ja_JP.ISO2022-JP
 LOCALESRC_ja_JP.ISO2022-JP = lt_LN.ASCII
   ALIASES_ja_JP.ISO2022-JP+=

LOCALES += ja_JP.ISO2022-JP2
 LOCALESRC_ja_JP.ISO2022-JP2 = lt_LN.ASCII
   ALIASES_ja_JP.ISO2022-JP2+=

LOCALES += ja_JP.ct
 LOCALESRC_ja_JP.ct = lt_LN.ASCII
   ALIASES_ja_JP.ct+=

LOCALES += ja_JP.SJIS
 LOCALESRC_ja_JP.SJIS = lt_LN.ASCII
   ALIASES_ja_JP.SJIS+=

LOCALES += zh_TW.Big5
 LOCALESRC_zh_TW.Big5 = is_IS.ISO_8859-1
   ALIASES_zh_TW.Big5+=

LOCALES += ru_SU.CP866
 LOCALESRC_ru_SU.CP866 = ru_SU.CP866
   ALIASES_ru_SU.CP866+=

LOCALES += ru_SU.KOI8-R
 LOCALESRC_ru_SU.KOI8-R = ru_SU.KOI8-R
   ALIASES_ru_SU.KOI8-R+=



LOCALEDIR=      ${DESTDIR}/usr/libdata/locale


.for locale in ${LOCALES}
LOCALESRCS += ${LOCALESRC_${locale}}
.endfor
CLEANFILES+= ${LOCALESRCS:S/$/.out/g}

.SUFFIXES: .src .out

.src.out:
	${COLLDEF} -I ${.CURDIR} -o ${.TARGET} ${.IMPSRC}

.if !defined(_BUILD_TOOLS)
all: ${LOCALESRCS:S/$/.out/g}
realall: ${LOCALESRCS:S/$/.out/g}		# XXX NetBSD-current XXX

de_DE.DIS_8859-15.out:  map.DIS_8859-15
de_DE.ISO_8859-1.out:   map.ISO_8859-1
es_ES.DIS_8859-15.out:  map.DIS_8859-15
es_ES.ISO_8859-1.out:   map.ISO_8859-1
is_IS.DIS_8859-15.out:  map.DIS_8859-15
is_IS.ISO_8859-1.out:   map.ISO_8859-1
lt_LN.DIS_8859-15.out:  map.DIS_8859-15
lt_LN.ISO_8859-1.out:   map.ISO_8859-1
lt_LN.ISO_8859-2.out:   map.ISO_8859-2
ru_SU.CP866.out:        map.CP866
ru_SU.KOI8-R.out:       map.KOI8-R

afterinstall:
	if [ ! -e ${LOCALEDIR} ] ; then \
		mkdir ${LOCALEDIR}; \
	fi
.for locale in ${LOCALES}
	if [ ! -e ${LOCALEDIR}/${locale} ] ; then \
		mkdir ${LOCALEDIR}/${locale}; \
	fi
	${INSTALL} ${COPY} -m 644 -o ${BINOWN} -g ${BINGRP} \
		${LOCALESRC_${locale}}.out ${LOCALEDIR}/${locale}/LC_COLLATE
.for alias in ${ALIASES_${locale}}
	if [ ! -e ${LOCALEDIR}/${alias} ] ; then \
		ln -s ${locale} ${LOCALEDIR}/${alias}; \
	fi
.endfor
.endfor
.endif

.include <bsd.prog.mk>
