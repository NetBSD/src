/* A Bison parser, made from ldgram.y
   by GNU bison 1.35.  */

#define YYBISON 1  /* Identify Bison output.  */

# define	INT	257
# define	NAME	258
# define	LNAME	259
# define	PLUSEQ	260
# define	MINUSEQ	261
# define	MULTEQ	262
# define	DIVEQ	263
# define	LSHIFTEQ	264
# define	RSHIFTEQ	265
# define	ANDEQ	266
# define	OREQ	267
# define	OROR	268
# define	ANDAND	269
# define	EQ	270
# define	NE	271
# define	LE	272
# define	GE	273
# define	LSHIFT	274
# define	RSHIFT	275
# define	UNARY	276
# define	END	277
# define	ALIGN_K	278
# define	BLOCK	279
# define	BIND	280
# define	QUAD	281
# define	SQUAD	282
# define	LONG	283
# define	SHORT	284
# define	BYTE	285
# define	SECTIONS	286
# define	PHDRS	287
# define	DATA_SEGMENT_ALIGN	288
# define	DATA_SEGMENT_RELRO_END	289
# define	DATA_SEGMENT_END	290
# define	SORT_BY_NAME	291
# define	SORT_BY_ALIGNMENT	292
# define	SIZEOF_HEADERS	293
# define	OUTPUT_FORMAT	294
# define	FORCE_COMMON_ALLOCATION	295
# define	OUTPUT_ARCH	296
# define	INHIBIT_COMMON_ALLOCATION	297
# define	SEGMENT_START	298
# define	INCLUDE	299
# define	MEMORY	300
# define	DEFSYMEND	301
# define	NOLOAD	302
# define	DSECT	303
# define	COPY	304
# define	INFO	305
# define	OVERLAY	306
# define	DEFINED	307
# define	TARGET_K	308
# define	SEARCH_DIR	309
# define	MAP	310
# define	ENTRY	311
# define	NEXT	312
# define	SIZEOF	313
# define	ADDR	314
# define	LOADADDR	315
# define	MAX_K	316
# define	MIN_K	317
# define	STARTUP	318
# define	HLL	319
# define	SYSLIB	320
# define	FLOAT	321
# define	NOFLOAT	322
# define	NOCROSSREFS	323
# define	ORIGIN	324
# define	FILL	325
# define	LENGTH	326
# define	CREATE_OBJECT_SYMBOLS	327
# define	INPUT	328
# define	GROUP	329
# define	OUTPUT	330
# define	CONSTRUCTORS	331
# define	ALIGNMOD	332
# define	AT	333
# define	SUBALIGN	334
# define	PROVIDE	335
# define	AS_NEEDED	336
# define	CHIP	337
# define	LIST	338
# define	SECT	339
# define	ABSOLUTE	340
# define	LOAD	341
# define	NEWLINE	342
# define	ENDWORD	343
# define	ORDER	344
# define	NAMEWORD	345
# define	ASSERT_K	346
# define	FORMAT	347
# define	PUBLIC	348
# define	BASE	349
# define	ALIAS	350
# define	TRUNCATE	351
# define	REL	352
# define	INPUT_SCRIPT	353
# define	INPUT_MRI_SCRIPT	354
# define	INPUT_DEFSYM	355
# define	CASE	356
# define	EXTERN	357
# define	START	358
# define	VERS_TAG	359
# define	VERS_IDENTIFIER	360
# define	GLOBAL	361
# define	LOCAL	362
# define	VERSIONK	363
# define	INPUT_VERSION_SCRIPT	364
# define	KEEP	365
# define	ONLY_IF_RO	366
# define	ONLY_IF_RW	367
# define	EXCLUDE_FILE	368

#line 22 "ldgram.y"

/*

 */

#define DONTDECLARE_MALLOC

#include "bfd.h"
#include "sysdep.h"
#include "bfdlink.h"
#include "ld.h"
#include "ldexp.h"
#include "ldver.h"
#include "ldlang.h"
#include "ldfile.h"
#include "ldemul.h"
#include "ldmisc.h"
#include "ldmain.h"
#include "mri.h"
#include "ldctor.h"
#include "ldlex.h"

#ifndef YYDEBUG
#define YYDEBUG 1
#endif

static enum section_type sectype;

lang_memory_region_type *region;

bfd_boolean ldgram_want_filename = TRUE;
FILE *saved_script_handle = NULL;
bfd_boolean force_make_executable = FALSE;

bfd_boolean ldgram_in_script = FALSE;
bfd_boolean ldgram_had_equals = FALSE;
bfd_boolean ldgram_had_keep = FALSE;
char *ldgram_vers_current_lang = NULL;

#define ERROR_NAME_MAX 20
static char *error_names[ERROR_NAME_MAX];
static int error_index;
#define PUSH_ERROR(x) if (error_index < ERROR_NAME_MAX) error_names[error_index] = x; error_index++;
#define POP_ERROR()   error_index--;

#line 67 "ldgram.y"
#ifndef YYSTYPE
typedef union {
  bfd_vma integer;
  struct big_int
    {
      bfd_vma integer;
      char *str;
    } bigint;
  fill_type *fill;
  char *name;
  const char *cname;
  struct wildcard_spec wildcard;
  struct wildcard_list *wildcard_list;
  struct name_list *name_list;
  int token;
  union etree_union *etree;
  struct phdr_info
    {
      bfd_boolean filehdr;
      bfd_boolean phdrs;
      union etree_union *at;
      union etree_union *flags;
    } phdr;
  struct lang_nocrossref *nocrossref;
  struct lang_output_section_phdr_list *section_phdr;
  struct bfd_elf_version_deps *deflist;
  struct bfd_elf_version_expr *versyms;
  struct bfd_elf_version_tree *versnode;
} yystype;
# define YYSTYPE yystype
# define YYSTYPE_IS_TRIVIAL 1
#endif
#ifndef YYDEBUG
# define YYDEBUG 0
#endif



#define	YYFINAL		689
#define	YYFLAG		-32768
#define	YYNTBASE	138

/* YYTRANSLATE(YYLEX) -- Bison token number corresponding to YYLEX. */
#define YYTRANSLATE(x) ((unsigned)(x) <= 368 ? yytranslate[x] : 250)

/* YYTRANSLATE[YYLEX] -- Bison token number corresponding to YYLEX. */
static const short yytranslate[] =
{
       0,     2,     2,     2,     2,     2,     2,     2,     2,     2,
       2,     2,     2,     2,     2,     2,     2,     2,     2,     2,
       2,     2,     2,     2,     2,     2,     2,     2,     2,     2,
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     122,   123,   124,   125,   126,   127,   128,   129,   130
};

#if YYDEBUG
static const short yyprhs[] =
{
       0,     0,     3,     6,     9,    12,    14,    15,    20,    21,
      24,    28,    29,    32,    37,    39,    41,    44,    46,    51,
      56,    60,    63,    68,    72,    77,    82,    87,    92,    97,
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    1061,  1066,  1071,  1080,  1082,  1086,  1087,  1097,  1098,  1106,
    1107
};
static const short yyrhs[] =
{
     115,   152,     0,   116,   142,     0,   126,   238,     0,   117,
     140,     0,     4,     0,     0,   141,     4,    10,   201,     0,
       0,   143,   144,     0,   144,   145,   104,     0,     0,    99,
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      53,   248,   246,   249,    54,     0,     0,   132,     0
};

#endif

#if YYDEBUG
/* YYRLINE[YYN] -- source line where rule number YYN was defined. */
static const short yyrline[] =
{
       0,   163,   165,   166,   167,   171,   174,   174,   184,   184,
     197,   199,   202,   204,   205,   208,   211,   212,   213,   215,
     217,   219,   221,   223,   225,   227,   229,   231,   233,   235,
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    1201,  1205,  1209,  1215,  1220,  1224,  1224,  1234,  1234,  1246,
    1248
};
#endif


#if (YYDEBUG) || defined YYERROR_VERBOSE

/* YYTNAME[TOKEN_NUM] -- String name of the token TOKEN_NUM. */
static const char *const yytname[] =
{
  "$", "error", "$undefined.", "INT", "NAME", "LNAME", "PLUSEQ", "MINUSEQ", 
  "MULTEQ", "DIVEQ", "'='", "LSHIFTEQ", "RSHIFTEQ", "ANDEQ", "OREQ", 
  "'?'", "':'", "OROR", "ANDAND", "'|'", "'^'", "'&'", "EQ", "NE", "'<'", 
  "'>'", "LE", "GE", "LSHIFT", "RSHIFT", "'+'", "'-'", "'*'", "'/'", 
  "'%'", "UNARY", "END", "'('", "ALIGN_K", "BLOCK", "BIND", "QUAD", 
  "SQUAD", "LONG", "SHORT", "BYTE", "SECTIONS", "PHDRS", 
  "DATA_SEGMENT_ALIGN", "DATA_SEGMENT_RELRO_END", "DATA_SEGMENT_END", 
  "SORT_BY_NAME", "SORT_BY_ALIGNMENT", "'{'", "'}'", "SIZEOF_HEADERS", 
  "OUTPUT_FORMAT", "FORCE_COMMON_ALLOCATION", "OUTPUT_ARCH", 
  "INHIBIT_COMMON_ALLOCATION", "SEGMENT_START", "INCLUDE", "MEMORY", 
  "DEFSYMEND", "NOLOAD", "DSECT", "COPY", "INFO", "OVERLAY", "DEFINED", 
  "TARGET_K", "SEARCH_DIR", "MAP", "ENTRY", "NEXT", "SIZEOF", "ADDR", 
  "LOADADDR", "MAX_K", "MIN_K", "STARTUP", "HLL", "SYSLIB", "FLOAT", 
  "NOFLOAT", "NOCROSSREFS", "ORIGIN", "FILL", "LENGTH", 
  "CREATE_OBJECT_SYMBOLS", "INPUT", "GROUP", "OUTPUT", "CONSTRUCTORS", 
  "ALIGNMOD", "AT", "SUBALIGN", "PROVIDE", "AS_NEEDED", "CHIP", "LIST", 
  "SECT", "ABSOLUTE", "LOAD", "NEWLINE", "ENDWORD", "ORDER", "NAMEWORD", 
  "ASSERT_K", "FORMAT", "PUBLIC", "BASE", "ALIAS", "TRUNCATE", "REL", 
  "INPUT_SCRIPT", "INPUT_MRI_SCRIPT", "INPUT_DEFSYM", "CASE", "EXTERN", 
  "START", "VERS_TAG", "VERS_IDENTIFIER", "GLOBAL", "LOCAL", "VERSIONK", 
  "INPUT_VERSION_SCRIPT", "KEEP", "ONLY_IF_RO", "ONLY_IF_RW", 
  "EXCLUDE_FILE", "','", "';'", "')'", "'['", "']'", "'!'", "'~'", "file", 
  "filename", "defsym_expr", "@1", "mri_script_file", "@2", 
  "mri_script_lines", "mri_script_command", "@3", "ordernamelist", 
  "mri_load_name_list", "mri_abs_name_list", "casesymlist", 
  "extern_name_list", "script_file", "@4", "ifile_list", "ifile_p1", "@5", 
  "@6", "input_list", "@7", "@8", "@9", "sections", "sec_or_group_p1", 
  "statement_anywhere", "@10", "wildcard_name", "wildcard_spec", 
  "exclude_name_list", "file_NAME_list", "input_section_spec_no_keep", 
  "input_section_spec", "@11", "statement", "statement_list", 
  "statement_list_opt", "length", "fill_exp", "fill_opt", "assign_op", 
  "end", "assignment", "opt_comma", "memory", "memory_spec_list", 
  "memory_spec", "@12", "origin_spec", "length_spec", "attributes_opt", 
  "attributes_list", "attributes_string", "startup", "high_level_library", 
  "high_level_library_NAME_list", "low_level_library", 
  "low_level_library_NAME_list", "floating_point_support", 
  "nocrossref_list", "mustbe_exp", "@13", "exp", "memspec_at_opt", 
  "opt_at", "opt_subalign", "sect_constraint", "section", "@14", "@15", 
  "@16", "@17", "@18", "@19", "@20", "@21", "@22", "@23", "@24", "@25", 
  "type", "atype", "opt_exp_with_type", "opt_exp_without_type", 
  "opt_nocrossrefs", "memspec_opt", "phdr_opt", "overlay_section", "@26", 
  "@27", "@28", "phdrs", "phdr_list", "phdr", "@29", "@30", "phdr_type", 
  "phdr_qualifiers", "phdr_val", "version_script_file", "@31", "version", 
  "@32", "vers_nodes", "vers_node", "verdep", "vers_tag", "vers_defns", 
  "@33", "@34", "opt_semicolon", 0
};
#endif

/* YYR1[YYN] -- Symbol number of symbol that rule YYN derives. */
static const short yyr1[] =
{
       0,   138,   138,   138,   138,   139,   141,   140,   143,   142,
     144,   144,   145,   145,   145,   145,   145,   145,   145,   145,
     145,   145,   145,   145,   145,   145,   145,   145,   145,   145,
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     245,   245,   245,   246,   246,   247,   246,   248,   246,   249,
     249
};

/* YYR2[YYN] -- Number of symbols composing right hand side of rule YYN. */
static const short yyr2[] =
{
       0,     2,     2,     2,     2,     1,     0,     4,     0,     2,
       3,     0,     2,     4,     1,     1,     2,     1,     4,     4,
       3,     2,     4,     3,     4,     4,     4,     4,     4,     2,
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       4,     4,     8,     1,     3,     0,     9,     0,     7,     0,
       1
};

/* YYDEFACT[S] -- default rule to reduce with in state S when YYTABLE
   doesn't specify something else to do.  Zero means the default is an
   error. */
static const short yydefact[] =
{
       0,    55,     8,     6,   297,     1,    58,     2,    11,     4,
       0,     3,     0,    56,     9,     0,   308,     0,   298,   301,
       0,     0,     0,     0,    75,     0,    76,     0,     0,     0,
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     146,   161,   250,   283,   256,   161,   284,     0,     0,     0
};

static const short yydefgoto[] =
{
     687,   103,     9,    10,     7,     8,    14,    78,   210,   157,
     156,   154,   165,   167,     5,     6,    13,    46,   114,   184,
     201,   392,   489,   445,    47,   180,    48,   117,   575,   576,
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     371,   458
};

static const short yypact[] =
{
     139,-32768,-32768,-32768,-32768,-32768,-32768,-32768,-32768,-32768,
      18,-32768,   -35,   759,  1346,    52,   180,    14,   -35,-32768,
     391,    26,    74,    96,-32768,   162,-32768,    85,   149,   196,
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      53,   464,-32768,-32768,-32768,   464,-32768,   657,   664,-32768
};

static const short yypgoto[] =
{
  -32768,   -51,-32768,-32768,-32768,-32768,   455,-32768,-32768,-32768,
  -32768,-32768,-32768,   559,-32768,-32768,   529,-32768,-32768,-32768,
    -192,-32768,-32768,-32768,-32768,   165,  -174,-32768,  -167,  -538,
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  -32768,   218
};


#define	YYLAST		1760


static const short yytable[] =
{
     177,   299,   301,    87,   151,   179,   281,   270,   271,   124,
     311,   267,   438,   438,   161,   260,   527,   102,    16,   591,
     591,   170,    15,   303,    80,   185,   478,    81,   306,   307,
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     243,   244,   245,   246,   247,   248,   249,   250,   251,   252,
     253
};

static const short yycheck[] =
{
      92,   194,   195,    18,    62,    97,   180,   172,   173,    60,
     202,     4,     4,     4,    72,     4,   510,     4,    53,     4,
       4,    79,     4,   196,   119,     4,     4,   122,     4,     5,
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      24,    25,    26,    27,    28,    29,    30,    31,    32,    33,
      34
};
/* -*-C-*-  Note some compilers choke on comments on `#line' lines.  */
#line 3 "/usr/share/bison/bison.simple"

/* Skeleton output parser for bison,

   Copyright (C) 1984, 1989, 1990, 2000, 2001, 2002 Free Software
   Foundation, Inc.

   This program is free software; you can redistribute it and/or modify
   it under the terms of the GNU General Public License as published by
   the Free Software Foundation; either version 2, or (at your option)
   any later version.

   This program is distributed in the hope that it will be useful,
   but WITHOUT ANY WARRANTY; without even the implied warranty of
   MERCHANTABILITY or FITNESS FOR A PARTICULAR PURPOSE.  See the
   GNU General Public License for more details.

   You should have received a copy of the GNU General Public License
   along with this program; if not, write to the Free Software
   Foundation, Inc., 59 Temple Place - Suite 330,
   Boston, MA 02111-1307, USA.  */

/* As a special exception, when this file is copied by Bison into a
   Bison output file, you may use that output file without restriction.
   This special exception was added by the Free Software Foundation
   in version 1.24 of Bison.  */

/* This is the parser code that is written into each bison parser when
   the %semantic_parser declaration is not specified in the grammar.
   It was written by Richard Stallman by simplifying the hairy parser
   used when %semantic_parser is specified.  */

/* All symbols defined below should begin with yy or YY, to avoid
   infringing on user name space.  This should be done even for local
   variables, as they might otherwise be expanded by user macros.
   There are some unavoidable exceptions within include files to
   define necessary library symbols; they are noted "INFRINGES ON
   USER NAME SPACE" below.  */

#if ! defined (yyoverflow) || defined (YYERROR_VERBOSE)

/* The parser invokes alloca or malloc; define the necessary symbols.  */

# if YYSTACK_USE_ALLOCA
#  define YYSTACK_ALLOC alloca
# else
#  ifndef YYSTACK_USE_ALLOCA
#   if defined (alloca) || defined (_ALLOCA_H)
#    define YYSTACK_ALLOC alloca
#   else
#    ifdef __GNUC__
#     define YYSTACK_ALLOC __builtin_alloca
#    endif
#   endif
#  endif
# endif

# ifdef YYSTACK_ALLOC
   /* Pacify GCC's `empty if-body' warning. */
#  define YYSTACK_FREE(Ptr) do { /* empty */; } while (0)
# else
#  if defined (__STDC__) || defined (__cplusplus)
#   include <stdlib.h> /* INFRINGES ON USER NAME SPACE */
#   define YYSIZE_T size_t
#  endif
#  define YYSTACK_ALLOC malloc
#  define YYSTACK_FREE free
# endif
#endif /* ! defined (yyoverflow) || defined (YYERROR_VERBOSE) */


#if (! defined (yyoverflow) \
     && (! defined (__cplusplus) \
	 || (YYLTYPE_IS_TRIVIAL && YYSTYPE_IS_TRIVIAL)))

/* A type that is properly aligned for any stack member.  */
union yyalloc
{
  short yyss;
  YYSTYPE yyvs;
# if YYLSP_NEEDED
  YYLTYPE yyls;
# endif
};

/* The size of the maximum gap between one aligned stack and the next.  */
# define YYSTACK_GAP_MAX (sizeof (union yyalloc) - 1)

/* The size of an array large to enough to hold all stacks, each with
   N elements.  */
# if YYLSP_NEEDED
#  define YYSTACK_BYTES(N) \
     ((N) * (sizeof (short) + sizeof (YYSTYPE) + sizeof (YYLTYPE))	\
      + 2 * YYSTACK_GAP_MAX)
# else
#  define YYSTACK_BYTES(N) \
     ((N) * (sizeof (short) + sizeof (YYSTYPE))				\
      + YYSTACK_GAP_MAX)
# endif

/* Copy COUNT objects from FROM to TO.  The source and destination do
   not overlap.  */
# ifndef YYCOPY
#  if 1 < __GNUC__
#   define YYCOPY(To, From, Count) \
      __builtin_memcpy (To, From, (Count) * sizeof (*(From)))
#  else
#   define YYCOPY(To, From, Count)		\
      do					\
	{					\
	  register YYSIZE_T yyi;		\
	  for (yyi = 0; yyi < (Count); yyi++)	\
	    (To)[yyi] = (From)[yyi];		\
	}					\
      while (0)
#  endif
# endif

/* Relocate STACK from its old location to the new one.  The
   local variables YYSIZE and YYSTACKSIZE give the old and new number of
   elements in the stack, and YYPTR gives the new location of the
   stack.  Advance YYPTR to a properly aligned location for the next
   stack.  */
# define YYSTACK_RELOCATE(Stack)					\
    do									\
      {									\
	YYSIZE_T yynewbytes;						\
	YYCOPY (&yyptr->Stack, Stack, yysize);				\
	Stack = &yyptr->Stack;						\
	yynewbytes = yystacksize * sizeof (*Stack) + YYSTACK_GAP_MAX;	\
	yyptr += yynewbytes / sizeof (*yyptr);				\
      }									\
    while (0)

#endif


#if ! defined (YYSIZE_T) && defined (__SIZE_TYPE__)
# define YYSIZE_T __SIZE_TYPE__
#endif
#if ! defined (YYSIZE_T) && defined (size_t)
# define YYSIZE_T size_t
#endif
#if ! defined (YYSIZE_T)
# if defined (__STDC__) || defined (__cplusplus)
#  include <stddef.h> /* INFRINGES ON USER NAME SPACE */
#  define YYSIZE_T size_t
# endif
#endif
#if ! defined (YYSIZE_T)
# define YYSIZE_T unsigned int
#endif

#define yyerrok		(yyerrstatus = 0)
#define yyclearin	(yychar = YYEMPTY)
#define YYEMPTY		-2
#define YYEOF		0
#define YYACCEPT	goto yyacceptlab
#define YYABORT 	goto yyabortlab
#define YYERROR		goto yyerrlab1
/* Like YYERROR except do call yyerror.  This remains here temporarily
   to ease the transition to the new meaning of YYERROR, for GCC.
   Once GCC version 2 has supplanted version 1, this can go.  */
#define YYFAIL		goto yyerrlab
#define YYRECOVERING()  (!!yyerrstatus)
#define YYBACKUP(Token, Value)					\
do								\
  if (yychar == YYEMPTY && yylen == 1)				\
    {								\
      yychar = (Token);						\
      yylval = (Value);						\
      yychar1 = YYTRANSLATE (yychar);				\
      YYPOPSTACK;						\
      goto yybackup;						\
    }								\
  else								\
    { 								\
      yyerror ("syntax error: cannot back up");			\
      YYERROR;							\
    }								\
while (0)

#define YYTERROR	1
#define YYERRCODE	256


/* YYLLOC_DEFAULT -- Compute the default location (before the actions
   are run).

   When YYLLOC_DEFAULT is run, CURRENT is set the location of the
   first token.  By default, to implement support for ranges, extend
   its range to the last symbol.  */

#ifndef YYLLOC_DEFAULT
# define YYLLOC_DEFAULT(Current, Rhs, N)       	\
   Current.last_line   = Rhs[N].last_line;	\
   Current.last_column = Rhs[N].last_column;
#endif


/* YYLEX -- calling `yylex' with the right arguments.  */

#if YYPURE
# if YYLSP_NEEDED
#  ifdef YYLEX_PARAM
#   define YYLEX		yylex (&yylval, &yylloc, YYLEX_PARAM)
#  else
#   define YYLEX		yylex (&yylval, &yylloc)
#  endif
# else /* !YYLSP_NEEDED */
#  ifdef YYLEX_PARAM
#   define YYLEX		yylex (&yylval, YYLEX_PARAM)
#  else
#   define YYLEX		yylex (&yylval)
#  endif
# endif /* !YYLSP_NEEDED */
#else /* !YYPURE */
# define YYLEX			yylex ()
#endif /* !YYPURE */


/* Enable debugging if requested.  */
#if YYDEBUG

# ifndef YYFPRINTF
#  include <stdio.h> /* INFRINGES ON USER NAME SPACE */
#  define YYFPRINTF fprintf
# endif

# define YYDPRINTF(Args)			\
do {						\
  if (yydebug)					\
    YYFPRINTF Args;				\
} while (0)
/* Nonzero means print parse trace.  It is left uninitialized so that
   multiple parsers can coexist.  */
int yydebug;
#else /* !YYDEBUG */
# define YYDPRINTF(Args)
#endif /* !YYDEBUG */

/* YYINITDEPTH -- initial size of the parser's stacks.  */
#ifndef	YYINITDEPTH
# define YYINITDEPTH 200
#endif

/* YYMAXDEPTH -- maximum size the stacks can grow to (effective only
   if the built-in stack extension method is used).

   Do not make this value too large; the results are undefined if
   SIZE_MAX < YYSTACK_BYTES (YYMAXDEPTH)
   evaluated with infinite-precision integer arithmetic.  */

#if YYMAXDEPTH == 0
# undef YYMAXDEPTH
#endif

#ifndef YYMAXDEPTH
# define YYMAXDEPTH 10000
#endif

#ifdef YYERROR_VERBOSE

# ifndef yystrlen
#  if defined (__GLIBC__) && defined (_STRING_H)
#   define yystrlen strlen
#  else
/* Return the length of YYSTR.  */
static YYSIZE_T
#   if defined (__STDC__) || defined (__cplusplus)
yystrlen (const char *yystr)
#   else
yystrlen (yystr)
     const char *yystr;
#   endif
{
  register const char *yys = yystr;

  while (*yys++ != '\0')
    continue;

  return yys - yystr - 1;
}
#  endif
# endif

# ifndef yystpcpy
#  if defined (__GLIBC__) && defined (_STRING_H) && defined (_GNU_SOURCE)
#   include <string.h>
#   define yystpcpy stpcpy
#  else
/* Copy YYSRC to YYDEST, returning the address of the terminating '\0' in
   YYDEST.  */
static char *
#   if defined (__STDC__) || defined (__cplusplus)
yystpcpy (char *yydest, const char *yysrc)
#   else
yystpcpy (yydest, yysrc)
     char *yydest;
     const char *yysrc;
#   endif
{
  register char *yyd = yydest;
  register const char *yys = yysrc;

  while ((*yyd++ = *yys++) != '\0')
    continue;

  return yyd - 1;
}
#  endif
# endif
#endif

#line 316 "/usr/share/bison/bison.simple"


/* The user can define YYPARSE_PARAM as the name of an argument to be passed
   into yyparse.  The argument should have type void *.
   It should actually point to an object.
   Grammar actions can access the variable by casting it
   to the proper pointer type.  */

#ifdef YYPARSE_PARAM
# if defined (__STDC__) || defined (__cplusplus)
#  define YYPARSE_PARAM_ARG void *YYPARSE_PARAM
#  define YYPARSE_PARAM_DECL
# else
#  define YYPARSE_PARAM_ARG YYPARSE_PARAM
#  define YYPARSE_PARAM_DECL void *YYPARSE_PARAM;
# endif
#else /* !YYPARSE_PARAM */
# define YYPARSE_PARAM_ARG
# define YYPARSE_PARAM_DECL
#endif /* !YYPARSE_PARAM */

/* Prevent warning if -Wstrict-prototypes.  */
#ifdef __GNUC__
# ifdef YYPARSE_PARAM
int yyparse (void *);
# else
int yyparse (void);
# endif
#endif

/* YY_DECL_VARIABLES -- depending whether we use a pure parser,
   variables are global, or local to YYPARSE.  */

#define YY_DECL_NON_LSP_VARIABLES			\
/* The lookahead symbol.  */				\
int yychar;						\
							\
/* The semantic value of the lookahead symbol. */	\
YYSTYPE yylval;						\
							\
/* Number of parse errors so far.  */			\
int yynerrs;

#if YYLSP_NEEDED
# define YY_DECL_VARIABLES			\
YY_DECL_NON_LSP_VARIABLES			\
						\
/* Location data for the lookahead symbol.  */	\
YYLTYPE yylloc;
#else
# define YY_DECL_VARIABLES			\
YY_DECL_NON_LSP_VARIABLES
#endif


/* If nonreentrant, generate the variables here. */

#if !YYPURE
YY_DECL_VARIABLES
#endif  /* !YYPURE */

int
yyparse (YYPARSE_PARAM_ARG)
     YYPARSE_PARAM_DECL
{
  /* If reentrant, generate the variables here. */
#if YYPURE
  YY_DECL_VARIABLES
#endif  /* !YYPURE */

  register int yystate;
  register int yyn;
  int yyresult;
  /* Number of tokens to shift before error messages enabled.  */
  int yyerrstatus;
  /* Lookahead token as an internal (translated) token number.  */
  int yychar1 = 0;

  /* Three stacks and their tools:
     `yyss': related to states,
     `yyvs': related to semantic values,
     `yyls': related to locations.

     Refer to the stacks thru separate pointers, to allow yyoverflow
     to reallocate them elsewhere.  */

  /* The state stack. */
  short	yyssa[YYINITDEPTH];
  short *yyss = yyssa;
  register short *yyssp;

  /* The semantic value stack.  */
  YYSTYPE yyvsa[YYINITDEPTH];
  YYSTYPE *yyvs = yyvsa;
  register YYSTYPE *yyvsp;

#if YYLSP_NEEDED
  /* The location stack.  */
  YYLTYPE yylsa[YYINITDEPTH];
  YYLTYPE *yyls = yylsa;
  YYLTYPE *yylsp;
#endif

#if YYLSP_NEEDED
# define YYPOPSTACK   (yyvsp--, yyssp--, yylsp--)
#else
# define YYPOPSTACK   (yyvsp--, yyssp--)
#endif

  YYSIZE_T yystacksize = YYINITDEPTH;


  /* The variables used to return semantic value and location from the
     action routines.  */
  YYSTYPE yyval;
#if YYLSP_NEEDED
  YYLTYPE yyloc;
#endif

  /* When reducing, the number of symbols on the RHS of the reduced
     rule. */
  int yylen;

  YYDPRINTF ((stderr, "Starting parse\n"));

  yystate = 0;
  yyerrstatus = 0;
  yynerrs = 0;
  yychar = YYEMPTY;		/* Cause a token to be read.  */

  /* Initialize stack pointers.
     Waste one element of value and location stack
     so that they stay on the same level as the state stack.
     The wasted elements are never initialized.  */

  yyssp = yyss;
  yyvsp = yyvs;
#if YYLSP_NEEDED
  yylsp = yyls;
#endif
  goto yysetstate;

/*------------------------------------------------------------.
| yynewstate -- Push a new state, which is found in yystate.  |
`------------------------------------------------------------*/
 yynewstate:
  /* In all cases, when you get here, the value and location stacks
     have just been pushed. so pushing a state here evens the stacks.
     */
  yyssp++;

 yysetstate:
  *yyssp = yystate;

  if (yyssp >= yyss + yystacksize - 1)
    {
      /* Get the current used size of the three stacks, in elements.  */
      YYSIZE_T yysize = yyssp - yyss + 1;

#ifdef yyoverflow
      {
	/* Give user a chance to reallocate the stack. Use copies of
	   these so that the &'s don't force the real ones into
	   memory.  */
	YYSTYPE *yyvs1 = yyvs;
	short *yyss1 = yyss;

	/* Each stack pointer address is followed by the size of the
	   data in use in that stack, in bytes.  */
# if YYLSP_NEEDED
	YYLTYPE *yyls1 = yyls;
	/* This used to be a conditional around just the two extra args,
	   but that might be undefined if yyoverflow is a macro.  */
	yyoverflow ("parser stack overflow",
		    &yyss1, yysize * sizeof (*yyssp),
		    &yyvs1, yysize * sizeof (*yyvsp),
		    &yyls1, yysize * sizeof (*yylsp),
		    &yystacksize);
	yyls = yyls1;
# else
	yyoverflow ("parser stack overflow",
		    &yyss1, yysize * sizeof (*yyssp),
		    &yyvs1, yysize * sizeof (*yyvsp),
		    &yystacksize);
# endif
	yyss = yyss1;
	yyvs = yyvs1;
      }
#else /* no yyoverflow */
# ifndef YYSTACK_RELOCATE
      goto yyoverflowlab;
# else
      /* Extend the stack our own way.  */
      if (yystacksize >= YYMAXDEPTH)
	goto yyoverflowlab;
      yystacksize *= 2;
      if (yystacksize > YYMAXDEPTH)
	yystacksize = YYMAXDEPTH;

      {
	short *yyss1 = yyss;
	union yyalloc *yyptr =
	  (union yyalloc *) YYSTACK_ALLOC (YYSTACK_BYTES (yystacksize));
	if (! yyptr)
	  goto yyoverflowlab;
	YYSTACK_RELOCATE (yyss);
	YYSTACK_RELOCATE (yyvs);
# if YYLSP_NEEDED
	YYSTACK_RELOCATE (yyls);
# endif
# undef YYSTACK_RELOCATE
	if (yyss1 != yyssa)
	  YYSTACK_FREE (yyss1);
      }
# endif
#endif /* no yyoverflow */

      yyssp = yyss + yysize - 1;
      yyvsp = yyvs + yysize - 1;
#if YYLSP_NEEDED
      yylsp = yyls + yysize - 1;
#endif

      YYDPRINTF ((stderr, "Stack size increased to %lu\n",
		  (unsigned long int) yystacksize));

      if (yyssp >= yyss + yystacksize - 1)
	YYABORT;
    }

  YYDPRINTF ((stderr, "Entering state %d\n", yystate));

  goto yybackup;


/*-----------.
| yybackup.  |
`-----------*/
yybackup:

/* Do appropriate processing given the current state.  */
/* Read a lookahead token if we need one and don't already have one.  */
/* yyresume: */

  /* First try to decide what to do without reference to lookahead token.  */

  yyn = yypact[yystate];
  if (yyn == YYFLAG)
    goto yydefault;

  /* Not known => get a lookahead token if don't already have one.  */

  /* yychar is either YYEMPTY or YYEOF
     or a valid token in external form.  */

  if (yychar == YYEMPTY)
    {
      YYDPRINTF ((stderr, "Reading a token: "));
      yychar = YYLEX;
    }

  /* Convert token to internal form (in yychar1) for indexing tables with */

  if (yychar <= 0)		/* This means end of input. */
    {
      yychar1 = 0;
      yychar = YYEOF;		/* Don't call YYLEX any more */

      YYDPRINTF ((stderr, "Now at end of input.\n"));
    }
  else
    {
      yychar1 = YYTRANSLATE (yychar);

#if YYDEBUG
     /* We have to keep this `#if YYDEBUG', since we use variables
	which are defined only if `YYDEBUG' is set.  */
      if (yydebug)
	{
	  YYFPRINTF (stderr, "Next token is %d (%s",
		     yychar, yytname[yychar1]);
	  /* Give the individual parser a way to print the precise
	     meaning of a token, for further debugging info.  */
# ifdef YYPRINT
	  YYPRINT (stderr, yychar, yylval);
# endif
	  YYFPRINTF (stderr, ")\n");
	}
#endif
    }

  yyn += yychar1;
  if (yyn < 0 || yyn > YYLAST || yycheck[yyn] != yychar1)
    goto yydefault;

  yyn = yytable[yyn];

  /* yyn is what to do for this token type in this state.
     Negative => reduce, -yyn is rule number.
     Positive => shift, yyn is new state.
       New state is final state => don't bother to shift,
       just return success.
     0, or most negative number => error.  */

  if (yyn < 0)
    {
      if (yyn == YYFLAG)
	goto yyerrlab;
      yyn = -yyn;
      goto yyreduce;
    }
  else if (yyn == 0)
    goto yyerrlab;

  if (yyn == YYFINAL)
    YYACCEPT;

  /* Shift the lookahead token.  */
  YYDPRINTF ((stderr, "Shifting token %d (%s), ",
	      yychar, yytname[yychar1]));

  /* Discard the token being shifted unless it is eof.  */
  if (yychar != YYEOF)
    yychar = YYEMPTY;

  *++yyvsp = yylval;
#if YYLSP_NEEDED
  *++yylsp = yylloc;
#endif

  /* Count tokens shifted since error; after three, turn off error
     status.  */
  if (yyerrstatus)
    yyerrstatus--;

  yystate = yyn;
  goto yynewstate;


/*-----------------------------------------------------------.
| yydefault -- do the default action for the current state.  |
`-----------------------------------------------------------*/
yydefault:
  yyn = yydefact[yystate];
  if (yyn == 0)
    goto yyerrlab;
  goto yyreduce;


/*-----------------------------.
| yyreduce -- Do a reduction.  |
`-----------------------------*/
yyreduce:
  /* yyn is the number of a rule to reduce with.  */
  yylen = yyr2[yyn];

  /* If YYLEN is nonzero, implement the default value of the action:
     `$$ = $1'.

     Otherwise, the following line sets YYVAL to the semantic value of
     the lookahead token.  This behavior is undocumented and Bison
     users should not rely upon it.  Assigning to YYVAL
     unconditionally makes the parser a bit smaller, and it avoids a
     GCC warning that YYVAL may be used uninitialized.  */
  yyval = yyvsp[1-yylen];

#if YYLSP_NEEDED
  /* Similarly for the default location.  Let the user run additional
     commands if for instance locations are ranges.  */
  yyloc = yylsp[1-yylen];
  YYLLOC_DEFAULT (yyloc, (yylsp - yylen), yylen);
#endif

#if YYDEBUG
  /* We have to keep this `#if YYDEBUG', since we use variables which
     are defined only if `YYDEBUG' is set.  */
  if (yydebug)
    {
      int yyi;

      YYFPRINTF (stderr, "Reducing via rule %d (line %d), ",
		 yyn, yyrline[yyn]);

      /* Print the symbols being reduced, and their result.  */
      for (yyi = yyprhs[yyn]; yyrhs[yyi] > 0; yyi++)
	YYFPRINTF (stderr, "%s ", yytname[yyrhs[yyi]]);
      YYFPRINTF (stderr, " -> %s\n", yytname[yyr1[yyn]]);
    }
#endif

  switch (yyn) {

case 6:
#line 175 "ldgram.y"
{ ldlex_defsym(); }
    break;
case 7:
#line 177 "ldgram.y"
{
		  ldlex_popstate();
		  lang_add_assignment(exp_assop(yyvsp[-1].token,yyvsp[-2].name,yyvsp[0].etree));
		}
    break;
case 8:
#line 185 "ldgram.y"
{
		  ldlex_mri_script ();
		  PUSH_ERROR (_("MRI style script"));
		}
    break;
case 9:
#line 190 "ldgram.y"
{
		  ldlex_popstate ();
		  mri_draw_tree ();
		  POP_ERROR ();
		}
    break;
case 14:
#line 205 "ldgram.y"
{
			einfo(_("%P%F: unrecognised keyword in MRI style script '%s'\n"),yyvsp[0].name);
			}
    break;
case 15:
#line 208 "ldgram.y"
{
			config.map_filename = "-";
			}
    break;
case 18:
#line 214 "ldgram.y"
{ mri_public(yyvsp[-2].name, yyvsp[0].etree); }
    break;
case 19:
#line 216 "ldgram.y"
{ mri_public(yyvsp[-2].name, yyvsp[0].etree); }
    break;
case 20:
#line 218 "ldgram.y"
{ mri_public(yyvsp[-1].name, yyvsp[0].etree); }
    break;
case 21:
#line 220 "ldgram.y"
{ mri_format(yyvsp[0].name); }
    break;
case 22:
#line 222 "ldgram.y"
{ mri_output_section(yyvsp[-2].name, yyvsp[0].etree);}
    break;
case 23:
#line 224 "ldgram.y"
{ mri_output_section(yyvsp[-1].name, yyvsp[0].etree);}
    break;
case 24:
#line 226 "ldgram.y"
{ mri_output_section(yyvsp[-2].name, yyvsp[0].etree);}
    break;
case 25:
#line 228 "ldgram.y"
{ mri_align(yyvsp[-2].name,yyvsp[0].etree); }
    break;
case 26:
#line 230 "ldgram.y"
{ mri_align(yyvsp[-2].name,yyvsp[0].etree); }
    break;
case 27:
#line 232 "ldgram.y"
{ mri_alignmod(yyvsp[-2].name,yyvsp[0].etree); }
    break;
case 28:
#line 234 "ldgram.y"
{ mri_alignmod(yyvsp[-2].name,yyvsp[0].etree); }
    break;
case 31:
#line 238 "ldgram.y"
{ mri_name(yyvsp[0].name); }
    break;
case 32:
#line 240 "ldgram.y"
{ mri_alias(yyvsp[-2].name,yyvsp[0].name,0);}
    break;
case 33:
#line 242 "ldgram.y"
{ mri_alias (yyvsp[-2].name, 0, (int) yyvsp[0].bigint.integer); }
    break;
case 34:
#line 244 "ldgram.y"
{ mri_base(yyvsp[0].etree); }
    break;
case 35:
#line 246 "ldgram.y"
{ mri_truncate ((unsigned int) yyvsp[0].bigint.integer); }
    break;
case 38:
#line 250 "ldgram.y"
{ ldlex_script (); ldfile_open_command_file(yyvsp[0].name); }
    break;
case 39:
#line 252 "ldgram.y"
{ ldlex_popstate (); }
    break;
case 40:
#line 254 "ldgram.y"
{ lang_add_entry (yyvsp[0].name, FALSE); }
    break;
case 42:
#line 259 "ldgram.y"
{ mri_order(yyvsp[0].name); }
    break;
case 43:
#line 260 "ldgram.y"
{ mri_order(yyvsp[0].name); }
    break;
case 45:
#line 266 "ldgram.y"
{ mri_load(yyvsp[0].name); }
    break;
case 46:
#line 267 "ldgram.y"
{ mri_load(yyvsp[0].name); }
    break;
case 47:
#line 272 "ldgram.y"
{ mri_only_load(yyvsp[0].name); }
    break;
case 48:
#line 274 "ldgram.y"
{ mri_only_load(yyvsp[0].name); }
    break;
case 49:
#line 278 "ldgram.y"
{ yyval.name = NULL; }
    break;
case 52:
#line 285 "ldgram.y"
{ ldlang_add_undef (yyvsp[0].name); }
    break;
case 53:
#line 287 "ldgram.y"
{ ldlang_add_undef (yyvsp[0].name); }
    break;
case 54:
#line 289 "ldgram.y"
{ ldlang_add_undef (yyvsp[0].name); }
    break;
case 55:
#line 293 "ldgram.y"
{
	 ldlex_both();
	}
    break;
case 56:
#line 297 "ldgram.y"
{
	ldlex_popstate();
	}
    break;
case 69:
#line 322 "ldgram.y"
{ lang_add_target(yyvsp[-1].name); }
    break;
case 70:
#line 324 "ldgram.y"
{ ldfile_add_library_path (yyvsp[-1].name, FALSE); }
    break;
case 71:
#line 326 "ldgram.y"
{ lang_add_output(yyvsp[-1].name, 1); }
    break;
case 72:
#line 328 "ldgram.y"
{ lang_add_output_format (yyvsp[-1].name, (char *) NULL,
					    (char *) NULL, 1); }
    break;
case 73:
#line 331 "ldgram.y"
{ lang_add_output_format (yyvsp[-5].name, yyvsp[-3].name, yyvsp[-1].name, 1); }
    break;
case 74:
#line 333 "ldgram.y"
{ ldfile_set_output_arch (yyvsp[-1].name, bfd_arch_unknown); }
    break;
case 75:
#line 335 "ldgram.y"
{ command_line.force_common_definition = TRUE ; }
    break;
case 76:
#line 337 "ldgram.y"
{ command_line.inhibit_common_definition = TRUE ; }
    break;
case 78:
#line 340 "ldgram.y"
{ lang_enter_group (); }
    break;
case 79:
#line 342 "ldgram.y"
{ lang_leave_group (); }
    break;
case 80:
#line 344 "ldgram.y"
{ lang_add_map(yyvsp[-1].name); }
    break;
case 81:
#line 346 "ldgram.y"
{ ldlex_script (); ldfile_open_command_file(yyvsp[0].name); }
    break;
case 82:
#line 348 "ldgram.y"
{ ldlex_popstate (); }
    break;
case 83:
#line 350 "ldgram.y"
{
		  lang_add_nocrossref (yyvsp[-1].nocrossref);
		}
    break;
case 85:
#line 358 "ldgram.y"
{ lang_add_input_file(yyvsp[0].name,lang_input_file_is_search_file_enum,
				 (char *)NULL); }
    break;
case 86:
#line 361 "ldgram.y"
{ lang_add_input_file(yyvsp[0].name,lang_input_file_is_search_file_enum,
				 (char *)NULL); }
    break;
case 87:
#line 364 "ldgram.y"
{ lang_add_input_file(yyvsp[0].name,lang_input_file_is_search_file_enum,
				 (char *)NULL); }
    break;
case 88:
#line 367 "ldgram.y"
{ lang_add_input_file(yyvsp[0].name,lang_input_file_is_l_enum,
				 (char *)NULL); }
    break;
case 89:
#line 370 "ldgram.y"
{ lang_add_input_file(yyvsp[0].name,lang_input_file_is_l_enum,
				 (char *)NULL); }
    break;
case 90:
#line 373 "ldgram.y"
{ lang_add_input_file(yyvsp[0].name,lang_input_file_is_l_enum,
				 (char *)NULL); }
    break;
case 91:
#line 376 "ldgram.y"
{ yyval.integer = as_needed; as_needed = TRUE; }
    break;
case 92:
#line 378 "ldgram.y"
{ as_needed = yyvsp[-2].integer; }
    break;
case 93:
#line 380 "ldgram.y"
{ yyval.integer = as_needed; as_needed = TRUE; }
    break;
case 94:
#line 382 "ldgram.y"
{ as_needed = yyvsp[-2].integer; }
    break;
case 95:
#line 384 "ldgram.y"
{ yyval.integer = as_needed; as_needed = TRUE; }
    break;
case 96:
#line 386 "ldgram.y"
{ as_needed = yyvsp[-2].integer; }
    break;
case 101:
#line 401 "ldgram.y"
{ lang_add_entry (yyvsp[-1].name, FALSE); }
    break;
case 103:
#line 403 "ldgram.y"
{ldlex_expression ();}
    break;
case 104:
#line 404 "ldgram.y"
{ ldlex_popstate ();
		  lang_add_assignment (exp_assert (yyvsp[-3].etree, yyvsp[-1].name)); }
    break;
case 105:
#line 412 "ldgram.y"
{
			  yyval.cname = yyvsp[0].name;
			}
    break;
case 106:
#line 416 "ldgram.y"
{
			  yyval.cname = "*";
			}
    break;
case 107:
#line 420 "ldgram.y"
{
			  yyval.cname = "?";
			}
    break;
case 108:
#line 427 "ldgram.y"
{
			  yyval.wildcard.name = yyvsp[0].cname;
			  yyval.wildcard.sorted = none;
			  yyval.wildcard.exclude_name_list = NULL;
			}
    break;
case 109:
#line 433 "ldgram.y"
{
			  yyval.wildcard.name = yyvsp[0].cname;
			  yyval.wildcard.sorted = none;
			  yyval.wildcard.exclude_name_list = yyvsp[-2].name_list;
			}
    break;
case 110:
#line 439 "ldgram.y"
{
			  yyval.wildcard.name = yyvsp[-1].cname;
			  yyval.wildcard.sorted = by_name;
			  yyval.wildcard.exclude_name_list = NULL;
			}
    break;
case 111:
#line 445 "ldgram.y"
{
			  yyval.wildcard.name = yyvsp[-1].cname;
			  yyval.wildcard.sorted = by_alignment;
			  yyval.wildcard.exclude_name_list = NULL;
			}
    break;
case 112:
#line 451 "ldgram.y"
{
			  yyval.wildcard.name = yyvsp[-2].cname;
			  yyval.wildcard.sorted = by_name_alignment;
			  yyval.wildcard.exclude_name_list = NULL;
			}
    break;
case 113:
#line 457 "ldgram.y"
{
			  yyval.wildcard.name = yyvsp[-2].cname;
			  yyval.wildcard.sorted = by_name;
			  yyval.wildcard.exclude_name_list = NULL;
			}
    break;
case 114:
#line 463 "ldgram.y"
{
			  yyval.wildcard.name = yyvsp[-2].cname;
			  yyval.wildcard.sorted = by_alignment_name;
			  yyval.wildcard.exclude_name_list = NULL;
			}
    break;
case 115:
#line 469 "ldgram.y"
{
			  yyval.wildcard.name = yyvsp[-2].cname;
			  yyval.wildcard.sorted = by_alignment;
			  yyval.wildcard.exclude_name_list = NULL;
			}
    break;
case 116:
#line 475 "ldgram.y"
{
			  yyval.wildcard.name = yyvsp[-1].cname;
			  yyval.wildcard.sorted = by_name;
			  yyval.wildcard.exclude_name_list = yyvsp[-3].name_list;
			}
    break;
case 117:
#line 484 "ldgram.y"
{
			  struct name_list *tmp;
			  tmp = (struct name_list *) xmalloc (sizeof *tmp);
			  tmp->name = yyvsp[0].cname;
			  tmp->next = yyvsp[-1].name_list;
			  yyval.name_list = tmp;
			}
    break;
case 118:
#line 493 "ldgram.y"
{
			  struct name_list *tmp;
			  tmp = (struct name_list *) xmalloc (sizeof *tmp);
			  tmp->name = yyvsp[0].cname;
			  tmp->next = NULL;
			  yyval.name_list = tmp;
			}
    break;
case 119:
#line 504 "ldgram.y"
{
			  struct wildcard_list *tmp;
			  tmp = (struct wildcard_list *) xmalloc (sizeof *tmp);
			  tmp->next = yyvsp[-2].wildcard_list;
			  tmp->spec = yyvsp[0].wildcard;
			  yyval.wildcard_list = tmp;
			}
    break;
case 120:
#line 513 "ldgram.y"
{
			  struct wildcard_list *tmp;
			  tmp = (struct wildcard_list *) xmalloc (sizeof *tmp);
			  tmp->next = NULL;
			  tmp->spec = yyvsp[0].wildcard;
			  yyval.wildcard_list = tmp;
			}
    break;
case 121:
#line 524 "ldgram.y"
{
			  struct wildcard_spec tmp;
			  tmp.name = yyvsp[0].name;
			  tmp.exclude_name_list = NULL;
			  tmp.sorted = none;
			  lang_add_wild (&tmp, NULL, ldgram_had_keep);
			}
    break;
case 122:
#line 532 "ldgram.y"
{
			  lang_add_wild (NULL, yyvsp[-1].wildcard_list, ldgram_had_keep);
			}
    break;
case 123:
#line 536 "ldgram.y"
{
			  lang_add_wild (&yyvsp[-3].wildcard, yyvsp[-1].wildcard_list, ldgram_had_keep);
			}
    break;
case 125:
#line 544 "ldgram.y"
{ ldgram_had_keep = TRUE; }
    break;
case 126:
#line 546 "ldgram.y"
{ ldgram_had_keep = FALSE; }
    break;
case 128:
#line 552 "ldgram.y"
{
 		lang_add_attribute(lang_object_symbols_statement_enum);
	      	}
    break;
case 130:
#line 557 "ldgram.y"
{

		  lang_add_attribute(lang_constructors_statement_enum);
		}
    break;
case 131:
#line 562 "ldgram.y"
{
		  constructors_sorted = TRUE;
		  lang_add_attribute (lang_constructors_statement_enum);
		}
    break;
case 133:
#line 568 "ldgram.y"
{
			  lang_add_data ((int) yyvsp[-3].integer, yyvsp[-1].etree);
			}
    break;
case 134:
#line 573 "ldgram.y"
{
			  lang_add_fill (yyvsp[-1].fill);
			}
    break;
case 139:
#line 590 "ldgram.y"
{ yyval.integer = yyvsp[0].token; }
    break;
case 140:
#line 592 "ldgram.y"
{ yyval.integer = yyvsp[0].token; }
    break;
case 141:
#line 594 "ldgram.y"
{ yyval.integer = yyvsp[0].token; }
    break;
case 142:
#line 596 "ldgram.y"
{ yyval.integer = yyvsp[0].token; }
    break;
case 143:
#line 598 "ldgram.y"
{ yyval.integer = yyvsp[0].token; }
    break;
case 144:
#line 603 "ldgram.y"
{
		  yyval.fill = exp_get_fill (yyvsp[0].etree,
				     0,
				     "fill value",
				     lang_first_phase_enum);
		}
    break;
case 145:
#line 613 "ldgram.y"
{ yyval.fill = yyvsp[0].fill; }
    break;
case 146:
#line 614 "ldgram.y"
{ yyval.fill = (fill_type *) 0; }
    break;
case 147:
#line 619 "ldgram.y"
{ yyval.token = '+'; }
    break;
case 148:
#line 621 "ldgram.y"
{ yyval.token = '-'; }
    break;
case 149:
#line 623 "ldgram.y"
{ yyval.token = '*'; }
    break;
case 150:
#line 625 "ldgram.y"
{ yyval.token = '/'; }
    break;
case 151:
#line 627 "ldgram.y"
{ yyval.token = LSHIFT; }
    break;
case 152:
#line 629 "ldgram.y"
{ yyval.token = RSHIFT; }
    break;
case 153:
#line 631 "ldgram.y"
{ yyval.token = '&'; }
    break;
case 154:
#line 633 "ldgram.y"
{ yyval.token = '|'; }
    break;
case 157:
#line 643 "ldgram.y"
{
		  lang_add_assignment (exp_assop (yyvsp[-1].token, yyvsp[-2].name, yyvsp[0].etree));
		}
    break;
case 158:
#line 647 "ldgram.y"
{
		  lang_add_assignment (exp_assop ('=', yyvsp[-2].name,
						  exp_binop (yyvsp[-1].token,
							     exp_nameop (NAME,
									 yyvsp[-2].name),
							     yyvsp[0].etree)));
		}
    break;
case 159:
#line 655 "ldgram.y"
{
		  lang_add_assignment (exp_provide (yyvsp[-3].name, yyvsp[-1].etree));
		}
    break;
case 166:
#line 677 "ldgram.y"
{ region = lang_memory_region_lookup (yyvsp[0].name, TRUE); }
    break;
case 167:
#line 680 "ldgram.y"
{}
    break;
case 168:
#line 685 "ldgram.y"
{ region->current =
		 region->origin =
		 exp_get_vma(yyvsp[0].etree, 0L,"origin", lang_first_phase_enum);
}
    break;
case 169:
#line 693 "ldgram.y"
{ region->length = exp_get_vma(yyvsp[0].etree,
					       ~((bfd_vma)0),
					       "length",
					       lang_first_phase_enum);
		}
    break;
case 170:
#line 702 "ldgram.y"
{ /* dummy action to avoid bison 1.25 error message */ }
    break;
case 174:
#line 713 "ldgram.y"
{ lang_set_flags (region, yyvsp[0].name, 0); }
    break;
case 175:
#line 715 "ldgram.y"
{ lang_set_flags (region, yyvsp[0].name, 1); }
    break;
case 176:
#line 720 "ldgram.y"
{ lang_startup(yyvsp[-1].name); }
    break;
case 178:
#line 726 "ldgram.y"
{ ldemul_hll((char *)NULL); }
    break;
case 179:
#line 731 "ldgram.y"
{ ldemul_hll(yyvsp[0].name); }
    break;
case 180:
#line 733 "ldgram.y"
{ ldemul_hll(yyvsp[0].name); }
    break;
case 182:
#line 741 "ldgram.y"
{ ldemul_syslib(yyvsp[0].name); }
    break;
case 184:
#line 747 "ldgram.y"
{ lang_float(TRUE); }
    break;
case 185:
#line 749 "ldgram.y"
{ lang_float(FALSE); }
    break;
case 186:
#line 754 "ldgram.y"
{
		  yyval.nocrossref = NULL;
		}
    break;
case 187:
#line 758 "ldgram.y"
{
		  struct lang_nocrossref *n;

		  n = (struct lang_nocrossref *) xmalloc (sizeof *n);
		  n->name = yyvsp[-1].name;
		  n->next = yyvsp[0].nocrossref;
		  yyval.nocrossref = n;
		}
    break;
case 188:
#line 767 "ldgram.y"
{
		  struct lang_nocrossref *n;

		  n = (struct lang_nocrossref *) xmalloc (sizeof *n);
		  n->name = yyvsp[-2].name;
		  n->next = yyvsp[0].nocrossref;
		  yyval.nocrossref = n;
		}
    break;
case 189:
#line 777 "ldgram.y"
{ ldlex_expression (); }
    break;
case 190:
#line 779 "ldgram.y"
{ ldlex_popstate (); yyval.etree=yyvsp[0].etree;}
    break;
case 191:
#line 784 "ldgram.y"
{ yyval.etree = exp_unop ('-', yyvsp[0].etree); }
    break;
case 192:
#line 786 "ldgram.y"
{ yyval.etree = yyvsp[-1].etree; }
    break;
case 193:
#line 788 "ldgram.y"
{ yyval.etree = exp_unop ((int) yyvsp[-3].integer,yyvsp[-1].etree); }
    break;
case 194:
#line 790 "ldgram.y"
{ yyval.etree = exp_unop ('!', yyvsp[0].etree); }
    break;
case 195:
#line 792 "ldgram.y"
{ yyval.etree = yyvsp[0].etree; }
    break;
case 196:
#line 794 "ldgram.y"
{ yyval.etree = exp_unop ('~', yyvsp[0].etree);}
    break;
case 197:
#line 797 "ldgram.y"
{ yyval.etree = exp_binop ('*', yyvsp[-2].etree, yyvsp[0].etree); }
    break;
case 198:
#line 799 "ldgram.y"
{ yyval.etree = exp_binop ('/', yyvsp[-2].etree, yyvsp[0].etree); }
    break;
case 199:
#line 801 "ldgram.y"
{ yyval.etree = exp_binop ('%', yyvsp[-2].etree, yyvsp[0].etree); }
    break;
case 200:
#line 803 "ldgram.y"
{ yyval.etree = exp_binop ('+', yyvsp[-2].etree, yyvsp[0].etree); }
    break;
case 201:
#line 805 "ldgram.y"
{ yyval.etree = exp_binop ('-' , yyvsp[-2].etree, yyvsp[0].etree); }
    break;
case 202:
#line 807 "ldgram.y"
{ yyval.etree = exp_binop (LSHIFT , yyvsp[-2].etree, yyvsp[0].etree); }
    break;
case 203:
#line 809 "ldgram.y"
{ yyval.etree = exp_binop (RSHIFT , yyvsp[-2].etree, yyvsp[0].etree); }
    break;
case 204:
#line 811 "ldgram.y"
{ yyval.etree = exp_binop (EQ , yyvsp[-2].etree, yyvsp[0].etree); }
    break;
case 205:
#line 813 "ldgram.y"
{ yyval.etree = exp_binop (NE , yyvsp[-2].etree, yyvsp[0].etree); }
    break;
case 206:
#line 815 "ldgram.y"
{ yyval.etree = exp_binop (LE , yyvsp[-2].etree, yyvsp[0].etree); }
    break;
case 207:
#line 817 "ldgram.y"
{ yyval.etree = exp_binop (GE , yyvsp[-2].etree, yyvsp[0].etree); }
    break;
case 208:
#line 819 "ldgram.y"
{ yyval.etree = exp_binop ('<' , yyvsp[-2].etree, yyvsp[0].etree); }
    break;
case 209:
#line 821 "ldgram.y"
{ yyval.etree = exp_binop ('>' , yyvsp[-2].etree, yyvsp[0].etree); }
    break;
case 210:
#line 823 "ldgram.y"
{ yyval.etree = exp_binop ('&' , yyvsp[-2].etree, yyvsp[0].etree); }
    break;
case 211:
#line 825 "ldgram.y"
{ yyval.etree = exp_binop ('^' , yyvsp[-2].etree, yyvsp[0].etree); }
    break;
case 212:
#line 827 "ldgram.y"
{ yyval.etree = exp_binop ('|' , yyvsp[-2].etree, yyvsp[0].etree); }
    break;
case 213:
#line 829 "ldgram.y"
{ yyval.etree = exp_trinop ('?' , yyvsp[-4].etree, yyvsp[-2].etree, yyvsp[0].etree); }
    break;
case 214:
#line 831 "ldgram.y"
{ yyval.etree = exp_binop (ANDAND , yyvsp[-2].etree, yyvsp[0].etree); }
    break;
case 215:
#line 833 "ldgram.y"
{ yyval.etree = exp_binop (OROR , yyvsp[-2].etree, yyvsp[0].etree); }
    break;
case 216:
#line 835 "ldgram.y"
{ yyval.etree = exp_nameop (DEFINED, yyvsp[-1].name); }
    break;
case 217:
#line 837 "ldgram.y"
{ yyval.etree = exp_bigintop (yyvsp[0].bigint.integer, yyvsp[0].bigint.str); }
    break;
case 218:
#line 839 "ldgram.y"
{ yyval.etree = exp_nameop (SIZEOF_HEADERS,0); }
    break;
case 219:
#line 842 "ldgram.y"
{ yyval.etree = exp_nameop (SIZEOF,yyvsp[-1].name); }
    break;
case 220:
#line 844 "ldgram.y"
{ yyval.etree = exp_nameop (ADDR,yyvsp[-1].name); }
    break;
case 221:
#line 846 "ldgram.y"
{ yyval.etree = exp_nameop (LOADADDR,yyvsp[-1].name); }
    break;
case 222:
#line 848 "ldgram.y"
{ yyval.etree = exp_unop (ABSOLUTE, yyvsp[-1].etree); }
    break;
case 223:
#line 850 "ldgram.y"
{ yyval.etree = exp_unop (ALIGN_K,yyvsp[-1].etree); }
    break;
case 224:
#line 852 "ldgram.y"
{ yyval.etree = exp_binop (ALIGN_K,yyvsp[-3].etree,yyvsp[-1].etree); }
    break;
case 225:
#line 854 "ldgram.y"
{ yyval.etree = exp_binop (DATA_SEGMENT_ALIGN, yyvsp[-3].etree, yyvsp[-1].etree); }
    break;
case 226:
#line 856 "ldgram.y"
{ yyval.etree = exp_binop (DATA_SEGMENT_RELRO_END, yyvsp[-1].etree, yyvsp[-3].etree); }
    break;
case 227:
#line 858 "ldgram.y"
{ yyval.etree = exp_unop (DATA_SEGMENT_END, yyvsp[-1].etree); }
    break;
case 228:
#line 860 "ldgram.y"
{ /* The operands to the expression node are
			     placed in the opposite order from the way
			     in which they appear in the script as
			     that allows us to reuse more code in
			     fold_binary.  */
			  yyval.etree = exp_binop (SEGMENT_START,
					  yyvsp[-1].etree,
					  exp_nameop (NAME, yyvsp[-3].name)); }
    break;
case 229:
#line 869 "ldgram.y"
{ yyval.etree = exp_unop (ALIGN_K,yyvsp[-1].etree); }
    break;
case 230:
#line 871 "ldgram.y"
{ yyval.etree = exp_nameop (NAME,yyvsp[0].name); }
    break;
case 231:
#line 873 "ldgram.y"
{ yyval.etree = exp_binop (MAX_K, yyvsp[-3].etree, yyvsp[-1].etree ); }
    break;
case 232:
#line 875 "ldgram.y"
{ yyval.etree = exp_binop (MIN_K, yyvsp[-3].etree, yyvsp[-1].etree ); }
    break;
case 233:
#line 877 "ldgram.y"
{ yyval.etree = exp_assert (yyvsp[-3].etree, yyvsp[-1].name); }
    break;
case 234:
#line 879 "ldgram.y"
{ yyval.etree = exp_nameop (ORIGIN, yyvsp[-1].name); }
    break;
case 235:
#line 881 "ldgram.y"
{ yyval.etree = exp_nameop (LENGTH, yyvsp[-1].name); }
    break;
case 236:
#line 886 "ldgram.y"
{ yyval.name = yyvsp[0].name; }
    break;
case 237:
#line 887 "ldgram.y"
{ yyval.name = 0; }
    break;
case 238:
#line 891 "ldgram.y"
{ yyval.etree = yyvsp[-1].etree; }
    break;
case 239:
#line 892 "ldgram.y"
{ yyval.etree = 0; }
    break;
case 240:
#line 896 "ldgram.y"
{ yyval.etree = yyvsp[-1].etree; }
    break;
case 241:
#line 897 "ldgram.y"
{ yyval.etree = 0; }
    break;
case 242:
#line 901 "ldgram.y"
{ yyval.token = ONLY_IF_RO; }
    break;
case 243:
#line 902 "ldgram.y"
{ yyval.token = ONLY_IF_RW; }
    break;
case 244:
#line 903 "ldgram.y"
{ yyval.token = 0; }
    break;
case 245:
#line 906 "ldgram.y"
{ ldlex_expression(); }
    break;
case 246:
#line 909 "ldgram.y"
{ ldlex_popstate (); ldlex_script (); }
    break;
case 247:
#line 912 "ldgram.y"
{
			  lang_enter_output_section_statement(yyvsp[-7].name, yyvsp[-5].etree,
							      sectype,
							      0, yyvsp[-3].etree, yyvsp[-4].etree, yyvsp[-1].token);
			}
    break;
case 248:
#line 918 "ldgram.y"
{ ldlex_popstate (); ldlex_expression (); }
    break;
case 249:
#line 920 "ldgram.y"
{
		  ldlex_popstate ();
		  lang_leave_output_section_statement (yyvsp[0].fill, yyvsp[-3].name, yyvsp[-1].section_phdr, yyvsp[-2].name);
		}
    break;
case 250:
#line 925 "ldgram.y"
{}
    break;
case 251:
#line 927 "ldgram.y"
{ ldlex_expression (); }
    break;
case 252:
#line 929 "ldgram.y"
{ ldlex_popstate (); ldlex_script (); }
    break;
case 253:
#line 931 "ldgram.y"
{
			  lang_enter_overlay (yyvsp[-5].etree, yyvsp[-2].etree);
			}
    break;
case 254:
#line 936 "ldgram.y"
{ ldlex_popstate (); ldlex_expression (); }
    break;
case 255:
#line 938 "ldgram.y"
{
			  ldlex_popstate ();
			  lang_leave_overlay (yyvsp[-11].etree, (int) yyvsp[-12].integer,
					      yyvsp[0].fill, yyvsp[-3].name, yyvsp[-1].section_phdr, yyvsp[-2].name);
			}
    break;
case 257:
#line 948 "ldgram.y"
{ ldlex_expression (); }
    break;
case 258:
#line 950 "ldgram.y"
{
		  ldlex_popstate ();
		  lang_add_assignment (exp_assop ('=', ".", yyvsp[0].etree));
		}
    break;
case 260:
#line 958 "ldgram.y"
{ sectype = noload_section; }
    break;
case 261:
#line 959 "ldgram.y"
{ sectype = dsect_section; }
    break;
case 262:
#line 960 "ldgram.y"
{ sectype = copy_section; }
    break;
case 263:
#line 961 "ldgram.y"
{ sectype = info_section; }
    break;
case 264:
#line 962 "ldgram.y"
{ sectype = overlay_section; }
    break;
case 266:
#line 967 "ldgram.y"
{ sectype = normal_section; }
    break;
case 267:
#line 968 "ldgram.y"
{ sectype = normal_section; }
    break;
case 268:
#line 972 "ldgram.y"
{ yyval.etree = yyvsp[-2].etree; }
    break;
case 269:
#line 973 "ldgram.y"
{ yyval.etree = (etree_type *)NULL;  }
    break;
case 270:
#line 978 "ldgram.y"
{ yyval.etree = yyvsp[-3].etree; }
    break;
case 271:
#line 980 "ldgram.y"
{ yyval.etree = yyvsp[-7].etree; }
    break;
case 272:
#line 984 "ldgram.y"
{ yyval.etree = yyvsp[-1].etree; }
    break;
case 273:
#line 985 "ldgram.y"
{ yyval.etree = (etree_type *) NULL;  }
    break;
case 274:
#line 990 "ldgram.y"
{ yyval.integer = 0; }
    break;
case 275:
#line 992 "ldgram.y"
{ yyval.integer = 1; }
    break;
case 276:
#line 997 "ldgram.y"
{ yyval.name = yyvsp[0].name; }
    break;
case 277:
#line 998 "ldgram.y"
{ yyval.name = DEFAULT_MEMORY_REGION; }
    break;
case 278:
#line 1003 "ldgram.y"
{
		  yyval.section_phdr = NULL;
		}
    break;
case 279:
#line 1007 "ldgram.y"
{
		  struct lang_output_section_phdr_list *n;

		  n = ((struct lang_output_section_phdr_list *)
		       xmalloc (sizeof *n));
		  n->name = yyvsp[0].name;
		  n->used = FALSE;
		  n->next = yyvsp[-2].section_phdr;
		  yyval.section_phdr = n;
		}
    break;
case 281:
#line 1023 "ldgram.y"
{
			  ldlex_script ();
			  lang_enter_overlay_section (yyvsp[0].name);
			}
    break;
case 282:
#line 1028 "ldgram.y"
{ ldlex_popstate (); ldlex_expression (); }
    break;
case 283:
#line 1030 "ldgram.y"
{
			  ldlex_popstate ();
			  lang_leave_overlay_section (yyvsp[0].fill, yyvsp[-1].section_phdr);
			}
    break;
case 288:
#line 1047 "ldgram.y"
{ ldlex_expression (); }
    break;
case 289:
#line 1048 "ldgram.y"
{ ldlex_popstate (); }
    break;
case 290:
#line 1050 "ldgram.y"
{
		  lang_new_phdr (yyvsp[-5].name, yyvsp[-3].etree, yyvsp[-2].phdr.filehdr, yyvsp[-2].phdr.phdrs, yyvsp[-2].phdr.at,
				 yyvsp[-2].phdr.flags);
		}
    break;
case 291:
#line 1058 "ldgram.y"
{
		  yyval.etree = yyvsp[0].etree;

		  if (yyvsp[0].etree->type.node_class == etree_name
		      && yyvsp[0].etree->type.node_code == NAME)
		    {
		      const char *s;
		      unsigned int i;
		      static const char * const phdr_types[] =
			{
			  "PT_NULL", "PT_LOAD", "PT_DYNAMIC",
			  "PT_INTERP", "PT_NOTE", "PT_SHLIB",
			  "PT_PHDR", "PT_TLS"
			};

		      s = yyvsp[0].etree->name.name;
		      for (i = 0;
			   i < sizeof phdr_types / sizeof phdr_types[0];
			   i++)
			if (strcmp (s, phdr_types[i]) == 0)
			  {
			    yyval.etree = exp_intop (i);
			    break;
			  }
		      if (i == sizeof phdr_types / sizeof phdr_types[0])
			{
			  if (strcmp (s, "PT_GNU_EH_FRAME") == 0)
			    yyval.etree = exp_intop (0x6474e550);
			  else if (strcmp (s, "PT_GNU_STACK") == 0)
			    yyval.etree = exp_intop (0x6474e551);
			  else
			    {
			      einfo (_("\
%X%P:%S: unknown phdr type `%s' (try integer literal)\n"),
				     s);
			      yyval.etree = exp_intop (0);
			    }
			}
		    }
		}
    break;
case 292:
#line 1102 "ldgram.y"
{
		  memset (&yyval.phdr, 0, sizeof (struct phdr_info));
		}
    break;
case 293:
#line 1106 "ldgram.y"
{
		  yyval.phdr = yyvsp[0].phdr;
		  if (strcmp (yyvsp[-2].name, "FILEHDR") == 0 && yyvsp[-1].etree == NULL)
		    yyval.phdr.filehdr = TRUE;
		  else if (strcmp (yyvsp[-2].name, "PHDRS") == 0 && yyvsp[-1].etree == NULL)
		    yyval.phdr.phdrs = TRUE;
		  else if (strcmp (yyvsp[-2].name, "FLAGS") == 0 && yyvsp[-1].etree != NULL)
		    yyval.phdr.flags = yyvsp[-1].etree;
		  else
		    einfo (_("%X%P:%S: PHDRS syntax error at `%s'\n"), yyvsp[-2].name);
		}
    break;
case 294:
#line 1118 "ldgram.y"
{
		  yyval.phdr = yyvsp[0].phdr;
		  yyval.phdr.at = yyvsp[-2].etree;
		}
    break;
case 295:
#line 1126 "ldgram.y"
{
		  yyval.etree = NULL;
		}
    break;
case 296:
#line 1130 "ldgram.y"
{
		  yyval.etree = yyvsp[-1].etree;
		}
    break;
case 297:
#line 1138 "ldgram.y"
{
		  ldlex_version_file ();
		  PUSH_ERROR (_("VERSION script"));
		}
    break;
case 298:
#line 1143 "ldgram.y"
{
		  ldlex_popstate ();
		  POP_ERROR ();
		}
    break;
case 299:
#line 1152 "ldgram.y"
{
		  ldlex_version_script ();
		}
    break;
case 300:
#line 1156 "ldgram.y"
{
		  ldlex_popstate ();
		}
    break;
case 303:
#line 1168 "ldgram.y"
{
		  lang_register_vers_node (NULL, yyvsp[-2].versnode, NULL);
		}
    break;
case 304:
#line 1172 "ldgram.y"
{
		  lang_register_vers_node (yyvsp[-4].name, yyvsp[-2].versnode, NULL);
		}
    break;
case 305:
#line 1176 "ldgram.y"
{
		  lang_register_vers_node (yyvsp[-5].name, yyvsp[-3].versnode, yyvsp[-1].deflist);
		}
    break;
case 306:
#line 1183 "ldgram.y"
{
		  yyval.deflist = lang_add_vers_depend (NULL, yyvsp[0].name);
		}
    break;
case 307:
#line 1187 "ldgram.y"
{
		  yyval.deflist = lang_add_vers_depend (yyvsp[-1].deflist, yyvsp[0].name);
		}
    break;
case 308:
#line 1194 "ldgram.y"
{
		  yyval.versnode = lang_new_vers_node (NULL, NULL);
		}
    break;
case 309:
#line 1198 "ldgram.y"
{
		  yyval.versnode = lang_new_vers_node (yyvsp[-1].versyms, NULL);
		}
    break;
case 310:
#line 1202 "ldgram.y"
{
		  yyval.versnode = lang_new_vers_node (yyvsp[-1].versyms, NULL);
		}
    break;
case 311:
#line 1206 "ldgram.y"
{
		  yyval.versnode = lang_new_vers_node (NULL, yyvsp[-1].versyms);
		}
    break;
case 312:
#line 1210 "ldgram.y"
{
		  yyval.versnode = lang_new_vers_node (yyvsp[-5].versyms, yyvsp[-1].versyms);
		}
    break;
case 313:
#line 1217 "ldgram.y"
{
		  yyval.versyms = lang_new_vers_pattern (NULL, yyvsp[0].name, ldgram_vers_current_lang);
		}
    break;
case 314:
#line 1221 "ldgram.y"
{
		  yyval.versyms = lang_new_vers_pattern (yyvsp[-2].versyms, yyvsp[0].name, ldgram_vers_current_lang);
		}
    break;
case 315:
#line 1225 "ldgram.y"
{
			  yyval.name = ldgram_vers_current_lang;
			  ldgram_vers_current_lang = yyvsp[-1].name;
			}
    break;
case 316:
#line 1230 "ldgram.y"
{
			  yyval.versyms = yyvsp[-2].versyms;
			  ldgram_vers_current_lang = yyvsp[-3].name;
			}
    break;
case 317:
#line 1235 "ldgram.y"
{
			  yyval.name = ldgram_vers_current_lang;
			  ldgram_vers_current_lang = yyvsp[-1].name;
			}
    break;
case 318:
#line 1240 "ldgram.y"
{
			  yyval.versyms = yyvsp[-2].versyms;
			  ldgram_vers_current_lang = yyvsp[-3].name;
			}
    break;
}

#line 706 "/usr/share/bison/bison.simple"


  yyvsp -= yylen;
  yyssp -= yylen;
#if YYLSP_NEEDED
  yylsp -= yylen;
#endif

#if YYDEBUG
  if (yydebug)
    {
      short *yyssp1 = yyss - 1;
      YYFPRINTF (stderr, "state stack now");
      while (yyssp1 != yyssp)
	YYFPRINTF (stderr, " %d", *++yyssp1);
      YYFPRINTF (stderr, "\n");
    }
#endif

  *++yyvsp = yyval;
#if YYLSP_NEEDED
  *++yylsp = yyloc;
#endif

  /* Now `shift' the result of the reduction.  Determine what state
     that goes to, based on the state we popped back to and the rule
     number reduced by.  */

  yyn = yyr1[yyn];

  yystate = yypgoto[yyn - YYNTBASE] + *yyssp;
  if (yystate >= 0 && yystate <= YYLAST && yycheck[yystate] == *yyssp)
    yystate = yytable[yystate];
  else
    yystate = yydefgoto[yyn - YYNTBASE];

  goto yynewstate;


/*------------------------------------.
| yyerrlab -- here on detecting error |
`------------------------------------*/
yyerrlab:
  /* If not already recovering from an error, report this error.  */
  if (!yyerrstatus)
    {
      ++yynerrs;

#ifdef YYERROR_VERBOSE
      yyn = yypact[yystate];

      if (yyn > YYFLAG && yyn < YYLAST)
	{
	  YYSIZE_T yysize = 0;
	  char *yymsg;
	  int yyx, yycount;

	  yycount = 0;
	  /* Start YYX at -YYN if negative to avoid negative indexes in
	     YYCHECK.  */
	  for (yyx = yyn < 0 ? -yyn : 0;
	       yyx < (int) (sizeof (yytname) / sizeof (char *)); yyx++)
	    if (yycheck[yyx + yyn] == yyx)
	      yysize += yystrlen (yytname[yyx]) + 15, yycount++;
	  yysize += yystrlen ("parse error, unexpected ") + 1;
	  yysize += yystrlen (yytname[YYTRANSLATE (yychar)]);
	  yymsg = (char *) YYSTACK_ALLOC (yysize);
	  if (yymsg != 0)
	    {
	      char *yyp = yystpcpy (yymsg, "parse error, unexpected ");
	      yyp = yystpcpy (yyp, yytname[YYTRANSLATE (yychar)]);

	      if (yycount < 5)
		{
		  yycount = 0;
		  for (yyx = yyn < 0 ? -yyn : 0;
		       yyx < (int) (sizeof (yytname) / sizeof (char *));
		       yyx++)
		    if (yycheck[yyx + yyn] == yyx)
		      {
			const char *yyq = ! yycount ? ", expecting " : " or ";
			yyp = yystpcpy (yyp, yyq);
			yyp = yystpcpy (yyp, yytname[yyx]);
			yycount++;
		      }
		}
	      yyerror (yymsg);
	      YYSTACK_FREE (yymsg);
	    }
	  else
	    yyerror ("parse error; also virtual memory exhausted");
	}
      else
#endif /* defined (YYERROR_VERBOSE) */
	yyerror ("parse error");
    }
  goto yyerrlab1;


/*--------------------------------------------------.
| yyerrlab1 -- error raised explicitly by an action |
`--------------------------------------------------*/
yyerrlab1:
  if (yyerrstatus == 3)
    {
      /* If just tried and failed to reuse lookahead token after an
	 error, discard it.  */

      /* return failure if at end of input */
      if (yychar == YYEOF)
	YYABORT;
      YYDPRINTF ((stderr, "Discarding token %d (%s).\n",
		  yychar, yytname[yychar1]));
      yychar = YYEMPTY;
    }

  /* Else will try to reuse lookahead token after shifting the error
     token.  */

  yyerrstatus = 3;		/* Each real token shifted decrements this */

  goto yyerrhandle;


/*-------------------------------------------------------------------.
| yyerrdefault -- current state does not do anything special for the |
| error token.                                                       |
`-------------------------------------------------------------------*/
yyerrdefault:
#if 0
  /* This is wrong; only states that explicitly want error tokens
     should shift them.  */

  /* If its default is to accept any token, ok.  Otherwise pop it.  */
  yyn = yydefact[yystate];
  if (yyn)
    goto yydefault;
#endif


/*---------------------------------------------------------------.
| yyerrpop -- pop the current state because it cannot handle the |
| error token                                                    |
`---------------------------------------------------------------*/
yyerrpop:
  if (yyssp == yyss)
    YYABORT;
  yyvsp--;
  yystate = *--yyssp;
#if YYLSP_NEEDED
  yylsp--;
#endif

#if YYDEBUG
  if (yydebug)
    {
      short *yyssp1 = yyss - 1;
      YYFPRINTF (stderr, "Error: state stack now");
      while (yyssp1 != yyssp)
	YYFPRINTF (stderr, " %d", *++yyssp1);
      YYFPRINTF (stderr, "\n");
    }
#endif

/*--------------.
| yyerrhandle.  |
`--------------*/
yyerrhandle:
  yyn = yypact[yystate];
  if (yyn == YYFLAG)
    goto yyerrdefault;

  yyn += YYTERROR;
  if (yyn < 0 || yyn > YYLAST || yycheck[yyn] != YYTERROR)
    goto yyerrdefault;

  yyn = yytable[yyn];
  if (yyn < 0)
    {
      if (yyn == YYFLAG)
	goto yyerrpop;
      yyn = -yyn;
      goto yyreduce;
    }
  else if (yyn == 0)
    goto yyerrpop;

  if (yyn == YYFINAL)
    YYACCEPT;

  YYDPRINTF ((stderr, "Shifting error token, "));

  *++yyvsp = yylval;
#if YYLSP_NEEDED
  *++yylsp = yylloc;
#endif

  yystate = yyn;
  goto yynewstate;


/*-------------------------------------.
| yyacceptlab -- YYACCEPT comes here.  |
`-------------------------------------*/
yyacceptlab:
  yyresult = 0;
  goto yyreturn;

/*-----------------------------------.
| yyabortlab -- YYABORT comes here.  |
`-----------------------------------*/
yyabortlab:
  yyresult = 1;
  goto yyreturn;

/*---------------------------------------------.
| yyoverflowab -- parser overflow comes here.  |
`---------------------------------------------*/
yyoverflowlab:
  yyerror ("parser stack overflow");
  yyresult = 2;
  /* Fall through.  */

yyreturn:
#ifndef yyoverflow
  if (yyss != yyssa)
    YYSTACK_FREE (yyss);
#endif
  return yyresult;
}
#line 1251 "ldgram.y"

void
yyerror(arg)
     const char *arg;
{
  if (ldfile_assumed_script)
    einfo (_("%P:%s: file format not recognized; treating as linker script\n"),
	   ldfile_input_filename);
  if (error_index > 0 && error_index < ERROR_NAME_MAX)
     einfo ("%P%F:%S: %s in %s\n", arg, error_names[error_index-1]);
  else
     einfo ("%P%F:%S: %s\n", arg);
}
