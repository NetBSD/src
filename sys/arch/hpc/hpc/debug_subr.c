/*	$NetBSD: debug_subr.c,v 1.3.2.2 2002/02/28 04:09:35 nathanw Exp $	*/

/*-
 * Copyright (c) 2001, 2002 The NetBSD Foundation, Inc.
 * All rights reserved.
 *
 * This code is derived from software contributed to The NetBSD Foundation
 * by UCHIYAMA Yasushi.
 *
 * Redistribution and use in source and binary forms, with or without
 * modification, are permitted provided that the following conditions
 * are met:
 * 1. Redistributions of source code must retain the above copyright
 *    notice, this list of conditions and the following disclaimer.
 * 2. Redistributions in binary form must reproduce the above copyright
 *    notice, this list of conditions and the following disclaimer in the
 *    documentation and/or other materials provided with the distribution.
 * 3. All advertising materials mentioning features or use of this software
 *    must display the following acknowledgement:
 *        This product includes software developed by the NetBSD
 *        Foundation, Inc. and its contributors.
 * 4. Neither the name of The NetBSD Foundation nor the names of its
 *    contributors may be used to endorse or promote products derived
 *    from this software without specific prior written permission.
 *
 * THIS SOFTWARE IS PROVIDED BY THE NETBSD FOUNDATION, INC. AND CONTRIBUTORS
 * ``AS IS'' AND ANY EXPRESS OR IMPLIED WARRANTIES, INCLUDING, BUT NOT LIMITED
 * TO, THE IMPLIED WARRANTIES OF MERCHANTABILITY AND FITNESS FOR A PARTICULAR
 * PURPOSE ARE DISCLAIMED.  IN NO EVENT SHALL THE FOUNDATION OR CONTRIBUTORS
 * BE LIABLE FOR ANY DIRECT, INDIRECT, INCIDENTAL, SPECIAL, EXEMPLARY, OR
 * CONSEQUENTIAL DAMAGES (INCLUDING, BUT NOT LIMITED TO, PROCUREMENT OF
 * SUBSTITUTE GOODS OR SERVICES; LOSS OF USE, DATA, OR PROFITS; OR BUSINESS
 * INTERRUPTION) HOWEVER CAUSED AND ON ANY THEORY OF LIABILITY, WHETHER IN
 * CONTRACT, STRICT LIABILITY, OR TORT (INCLUDING NEGLIGENCE OR OTHERWISE)
 * ARISING IN ANY WAY OUT OF THE USE OF THIS SOFTWARE, EVEN IF ADVISED OF THE
 * POSSIBILITY OF SUCH DAMAGE.
 */

#include "debug_hpc.h"

#include <sys/param.h>
#include <sys/systm.h>

#include <machine/debug.h>
#include <machine/bootinfo.h>

#define BANNER_LENGTH		80

static const char onoff[2] = "_x";

void
__dbg_bit_print(u_int32_t a, int len, int start, int end, char *title,
    int count)
{
	u_int32_t j, j1;
	int i, n;
	char buf[64];

	n = len * NBBY - 1;
	j1 = 1 << n;
	end = end ? end : n;

	printf(" ");
	if (title) {
		printf("[%-16s] ", title);
	}

	for (j = j1, i = n; j > 0; j >>=1, i--) {
		if (i > end || i < start) {
			printf("%c", a & j ? '+' : '-'); /* out of range */
		} else {
			printf("%c", a & j ? '|' : '.');
		}
	}

	snprintf(buf, sizeof buf, " [0x%%0%dx %%12d]", len << 1);
	printf(buf, a, a);

	if (count) {
		for (j = j1, i = n; j > 0; j >>=1, i--) {
			if (!(i > end || i < start) && (a & j)) {
				printf(" %d", i);
			}
		}
	}

	printf("\n");
}

void
dbg_bitmask_print(u_int32_t reg, u_int32_t mask, const char *name)
{

	printf("%s[%c] ", name, onoff[reg & mask ? 1 : 0]);
}

void
dbg_banner_title(const char *name, size_t len)
{
	int n = (BANNER_LENGTH - (len + 2)) >> 1;

	dbg_draw_line(n);
	printf("[%s]", name);
	dbg_draw_line(n);
	printf("\n");
}

void
dbg_banner_line()
{

	dbg_draw_line(BANNER_LENGTH);
	printf("\n");
}

void
dbg_draw_line(int n)
{
	int i;

	for (i = 0; i < n; i++)
		printf("-");
}

#ifdef HPC_DEBUG_LCD
/*
 * LCD test routines for 8bpp, 16bpp LCD.
 */
static const u_int8_t img[1024] = {
	0xff,0xff,0xff,0xff,0xff,0xff,0xff,0xff,
	0xff,0xff,0xff,0xff,0xff,0xff,0xff,0xff,
	0xff,0xff,0xff,0xff,0xff,0xff,0xff,0xff,
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	0x80,0x80,0x80,0x80,0x80,0x80,0x80,0x80,
};

static const u_int16_t rgb565_clut[256] = {
	0x0000, 0x8000, 0x0400, 0x8400, 0x0080, 0x8080, 0x0480, 0x8480,
	0xc6e0, 0xa6f0, 0x29ea, 0x29ff, 0x2ae0, 0x2af5, 0x2aea, 0x2aff,
	0x2be0, 0x2bf5, 0x2bea, 0x2bff, 0x2ce0, 0x2cf5, 0x2cea, 0x2cff,
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	0x8480, 0xf800, 0x07e0, 0xffe0, 0x00ff, 0xf8ff, 0x07ff, 0xffff
};

static u_int16_t __color_tab16[] = {
	RGB565_BLACK,
	RGB565_RED,
	RGB565_GREEN,
	RGB565_YELLOW,
	RGB565_BLUE,
	RGB565_MAGENTA,
	RGB565_CYAN,
	RGB565_WHITE
};

static int bootinfo_fb_depth(void);
static void __dbg_lcd_test8(vaddr_t, int, int);
static void __dbg_lcd_test16(vaddr_t, int, int);

void
dbg_lcd_test()
{
	vaddr_t fbaddr;
	int w, h;

	if (bootinfo == NULL || bootinfo->fb_addr == NULL)
		return;

	fbaddr = (vaddr_t)bootinfo->fb_addr;
	w = bootinfo->fb_width;
	h = bootinfo->fb_height;

	switch (bootinfo_fb_depth()) {
	default:
		break;
	case 8:
		__dbg_lcd_test8(fbaddr, w, h);
		break;
	case 16:
		__dbg_lcd_test16(fbaddr, w, h);
		break;
	}
}

/*
 * 8bpp LCD test routine.
 *  HP620LX, HPW50PAD are little-endian display.
 */
void
__dbg_lcd_test8(vaddr_t fbaddr, int w, int h)
{
	u_int8_t *fb, *fb_start = (u_int8_t *)fbaddr;
	int i, x, y, y_start, y_end, len, skip;
	u_int16_t *fb16;
	u_int32_t *fb32;
	
	/* 
	 * Clear screen (BLACK)
	 */
	for (fb = fb_start, i = 0; i < w * h; i++)
		*fb++ = 0;

	/*
	 * Color bar (I assume palette index is ANSI)
	 *	BLACK|RED|GREEN|YELLOW|BLUE|MAGENTA|CYAN|WHITE
	 */
	len = w / 8;
	y_start = 0;
	y_end = h / 2;
	skip = bootinfo->fb_line_bytes - w;
	for (fb = fb_start, y = y_start; y < y_end; y++, fb += skip) {
		for (i = 0; i < 8; i++) {
			for (x = 0; x < len; x++)
				*fb++ = i;
		}
	}

	/*
	 * Byte order test. (display 32x32 bitmap)
	 */
	/* 
	 * 8-bit access (reference) 
	 */
	y_start = y_end;
	y_end = y_start + 32;
	i = 0;
	fb += w / 2 - 16; /* center */
	skip = bootinfo->fb_line_bytes - 32;
	for (y = y_start; y < y_end; y++, fb += skip)
		for (x = 0; x < 32; x++)
			*fb++ = img[i++];

	/* 
	 * 16-bit access
	 */
	y_start = y_end;
	y_end = y_start + 32;
	i = 0;
	fb16 = (u_int16_t *)fb;
	skip /= 2;
	for (y = y_start; y < y_end; y++, fb16 += skip)
		for (x = 0; x < 16; x++, i += 2)
			*fb16++ =
			    img[i + 1] << 8 |
			    img[i + 0];

	/* 
	 * 32-bit access
	 */
	y_start = y_end;
	y_end = y_start + 32;
	i = 0;
	fb32 = (u_int32_t *)(fb + 32 * w);
	skip /= 2;
	for (y = y_start; y < y_end; y++, fb32 += skip)
		for (x = 0; x < 8; x++, i += 4)
			*fb32++ = 
			    img[i + 3] << 24 | 
			    img[i + 2] << 16 |
			    img[i + 1] <<  8 |
			    img[i + 0];
}

/*
 * 16bpp LCD test routine.
 *  Jornada6[89]0, HPW650PA are big-endian display.
 */
void
__dbg_lcd_test16(vaddr_t fbaddr, int w, int h)
{
	u_int16_t *fb, *fb_start = (u_int16_t *)fbaddr;
	u_int16_t pat;
	int i, x, y, y_start, y_end, len, skip;
	u_int32_t *fb32;

	/* 
	 * Clear screen (BLACK)
	 */
	pat = __color_tab16[0];
	for (fb = fb_start, i = 0; i < w * h; i++)
		*fb++ = pat;

	/*
	 * Color bar
	 *	BLACK|RED|GREEN|YELLOW|BLUE|MAGENTA|CYAN|WHITE
	 */
	len = w / 8;
	y_start = 0;
	y_end = h / 2;
	for (fb = fb_start, y = y_start; y < y_end; y++) {
		for (i = 0; i < 8; i++) {
			pat = __color_tab16[i];
			for (x = 0; x < len; x++)
				*fb++ = pat;
		}
	}
	y_start = y_end;

	/*
	 * Byte order test. (display 32x32 bitmap)
	 */
	/* 
	 * 16-bit access (reference) 
	 */
	y_start = y_end;
	y_end = y_start + 32;
	i = 0;
	fb += w / 2 - 16; /* center */
	skip = w - 32;
	for (y = y_start; y < y_end; y++, fb += skip)
		for (x = 0; x < 32; x++)
			*fb++ = rgb565_clut[img[i++]];

	/* 
	 * 32-bit access (test)
	 */
	y_start = y_end;
	y_end = y_start + 32;
	i = 0;
	fb32 = (u_int32_t *)fb;
	skip /= 2;
	for (y = y_start; y < y_end; y++, fb32 += skip)
		for (x = 0; x < 16; x++, i += 2)
			*fb32++ = (rgb565_clut[img[i + 1]] << 16) |
			    rgb565_clut[img[i]];
}

int
bootinfo_fb_depth()
{

	switch (bootinfo->fb_type) {
	case BIFB_D2_M2L_3:
		/* FALLTHROUGH */
	case BIFB_D2_M2L_0:
		return (2);
	case BIFB_D4_M2L_F:
		/* FALLTHROUGH */
	case BIFB_D4_M2L_0:
		return (4);
	case BIFB_D8_FF:
		/* FALLTHROUGH */
	case BIFB_D8_00:
		return (8);
	case BIFB_D16_FFFF:
		/* FALLTHROUGH */
	case BIFB_D16_0000:
		return (16);
	}

	return (0);
}

#endif /* HPC_DEBUG_LCD */
