/*	$NetBSD: ibm4xx_460ex_pll.c,v 1.1 2026/09/28 20:41:00 rkujawa Exp $	*/

/*-
 * Copyright (c) 2026 The NetBSD Foundation, Inc.
 * All rights reserved.
 *
 * This code is derived from software contributed to The NetBSD Foundation
 * by Radoslaw Kujawa.
 *
 * Redistribution and use in source and binary forms, with or without
 * modification, are permitted provided that the following conditions
 * are met:
 * 1. Redistributions of source code must retain the above copyright
 *    notice, this list of conditions and the following disclaimer.
 * 2. Redistributions in binary form must reproduce the above copyright
 *    notice, this list of conditions and the following disclaimer in the
 *    documentation and/or other materials provided with the distribution.
 *
 * THIS SOFTWARE IS PROVIDED BY THE NETBSD FOUNDATION, INC. AND CONTRIBUTORS
 * ``AS IS'' AND ANY EXPRESS OR IMPLIED WARRANTIES, INCLUDING, BUT NOT LIMITED
 * TO, THE IMPLIED WARRANTIES OF MERCHANTABILITY AND FITNESS FOR A PARTICULAR
 * PURPOSE ARE DISCLAIMED.  IN NO EVENT SHALL THE FOUNDATION OR CONTRIBUTORS
 * BE LIABLE FOR ANY DIRECT, INDIRECT, INCIDENTAL, SPECIAL, EXEMPLARY, OR
 * CONSEQUENTIAL DAMAGES (INCLUDING, BUT NOT LIMITED TO, PROCUREMENT OF
 * SUBSTITUTE GOODS OR SERVICES; LOSS OF USE, DATA, OR PROFITS; OR BUSINESS
 * INTERRUPTION) HOWEVER CAUSED AND ON ANY THEORY OF LIABILITY, WHETHER IN
 * CONTRACT, STRICT LIABILITY, OR TORT (INCLUDING NEGLIGENCE OR OTHERWISE)
 * ARISING IN ANY WAY OUT OF THE USE OF THIS SOFTWARE, EVEN IF ADVISED OF THE
 * POSSIBILITY OF SUCH DAMAGE.
 */

/*
 * AMCC 460EX/GT PLL straps decode.
 */

#include <sys/cdefs.h>
__KERNEL_RCSID(0, "$NetBSD: ibm4xx_460ex_pll.c,v 1.1 2026/09/28 20:41:00 rkujawa Exp $");

#include <sys/param.h>
#include <sys/systm.h>

#include <powerpc/ibm4xx/cpu.h>
#include <powerpc/ibm4xx/dcr4xx.h>
#include <powerpc/ibm4xx/ibm4xx_460ex_pll.h>

/* LFSR coded divisors. */
static const uint8_t ibm4xx_460ex_fwdv_code[] = {
	0x00, 0x01, 0x0f, 0x04, 0x09, 0x0a, 0x0d, 0x0e, 0x03, 0x0c,
	0x05, 0x08, 0x07, 0x02, 0x0b, 0x06
};

static const uint8_t ibm4xx_460ex_fbdv_code[] = {
	0x00, 0xff, 0x7e, 0xfd, 0x7a, 0xf5, 0x6a, 0xd5, 0x2a, 0xd4,
	0x29, 0xd3, 0x26, 0xcc, 0x19, 0xb3, 0x67, 0xce, 0x1d, 0xbb,
	0x77, 0xee, 0x5d, 0xba, 0x74, 0xe9, 0x52, 0xa5, 0x4b, 0x96,
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	0x03, 0x87, 0x0f, 0x9f, 0x3f
};

static u_int
ibm4xx_460ex_pll_div(const uint8_t *tab, size_t n, uint32_t code)
{
	size_t i;

	for (i = 0; i < n; i++)
		if (tab[i] == code)
			return i + 1;
	return 0;
}

/*
 * The PLL clock in MHz. 0 if the straps don't have that configuration.
 */
u_int
ibm4xx_460ex_base_clock(uint32_t cpu_hz)
{
	uint32_t strap;
	u_int fwdva, fbdv;

	strap = mfsdr(DCR_SDR0_SDSTP0);
	if (__SHIFTOUT(strap, SDR0_SDSTP0_SEL) != 0)
		return 0;

	fwdva = ibm4xx_460ex_pll_div(ibm4xx_460ex_fwdv_code,
	    __arraycount(ibm4xx_460ex_fwdv_code),
	    __SHIFTOUT(strap, SDR0_SDSTP0_FWDVA));
	fbdv = ibm4xx_460ex_pll_div(ibm4xx_460ex_fbdv_code,
	    __arraycount(ibm4xx_460ex_fbdv_code),
	    __SHIFTOUT(strap, SDR0_SDSTP0_FBDV));
	if (fwdva == 0 || fbdv == 0)
		return 0;

	return ((cpu_hz / 100000) * fwdva / fbdv) / 10;
}

