/* $NetBSD: sunxi-h3-h5-orangepi-zero-nas.dts,v 1.1 2019/10/20 23:47:14 thorpej Exp $ */

/*-
 * Copyright (c) 2019 Jason R Thorpe
 * All rights reserved.
 *
 * Redistribution and use in source and binary forms, with or without
 * modification, are permitted provided that the following conditions
 * are met:
 * 1. Redistributions of source code must retain the above copyright
 *    notice, this list of conditions and the following disclaimer.
 * 2. Redistributions in binary form must reproduce the above copyright
 *    notice, this list of conditions and the following disclaimer in the
 *    documentation and/or other materials provided with the distribution.
 *
 * THIS SOFTWARE IS PROVIDED BY THE AUTHOR ``AS IS'' AND ANY EXPRESS OR
 * IMPLIED WARRANTIES, INCLUDING, BUT NOT LIMITED TO, THE IMPLIED WARRANTIES
 * OF MERCHANTABILITY AND FITNESS FOR A PARTICULAR PURPOSE ARE DISCLAIMED.
 * IN NO EVENT SHALL THE AUTHOR BE LIABLE FOR ANY DIRECT, INDIRECT,
 * INCIDENTAL, SPECIAL, EXEMPLARY, OR CONSEQUENTIAL DAMAGES (INCLUDING,
 * BUT NOT LIMITED TO, PROCUREMENT OF SUBSTITUTE GOODS OR SERVICES;
 * LOSS OF USE, DATA, OR PROFITS; OR BUSINESS INTERRUPTION) HOWEVER CAUSED
 * AND ON ANY THEORY OF LIABILITY, WHETHER IN CONTRACT, STRICT LIABILITY,
 * OR TORT (INCLUDING NEGLIGENCE OR OTHERWISE) ARISING IN ANY WAY
 * OUT OF THE USE OF THIS SOFTWARE, EVEN IF ADVISED OF THE POSSIBILITY OF
 * SUCH DAMAGE.
 */

/*
 * Overlay for the Orange Pi Zero NAS expansion board for Orange Pi Zero
 * and Orange Pi Zero Plus.
 *
 * https://www.aliexpress.com/item/Orange-Pi-Zero-NAS-Expansion-board-Interface-board-Development-board-beyond-Raspberry-Pi/32789632568.html
 */

/dts-v1/;
/plugin/;

/ {
	compatible = "xunlong,orangepi-zero-plus", "xunlong,orangepi-zero";

	/* ohci2/ehci2 has the JMS578 USB2->SATA bridge. */
	fragment@0 {
		target = <&ehci2>;
		__overlay__ {
			status = "okay";
		};
	};

	fragment@1 {
		target = <&ohci2>;
		__overlay__ {
			status = "okay";
		};
	};
};
