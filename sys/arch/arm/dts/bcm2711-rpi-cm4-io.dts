/* $NetBSD: bcm2711-rpi-cm4-io.dts,v 1.1.2.2 2026/11/04 23:20:07 perseant Exp $ */

#include "../../../external/gpl2/dts/dist/arch/arm64/boot/dts/broadcom/bcm2711-rpi-cm4-io.dts"

#include "bcm2711-cpus.dtsi"
