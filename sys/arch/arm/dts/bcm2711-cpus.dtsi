/* $NetBSD: bcm2711-cpus.dtsi,v 1.1.2.2 2026/11/04 23:20:07 perseant Exp $ */

/*
 * return "bcm2711-smp" instead of upstream default "bcm2836-smp"
 * in bcm2711.dtsi to handle bcm2711 specific device addresses
 */

&cpus {
	enable-method = "brcm,bcm2711-smp";
};
