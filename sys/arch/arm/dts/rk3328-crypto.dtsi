// SPDX-License-Identifier: (GPL-2.0+ OR MIT)
/*
 * Copyright (c) 2017 Fuzhou Rockchip Electronics Co., Ltd
 */

/* From upstream d1152bc533c941f7e267bf53d344cee510ea2808 */

/ {
	crypto: crypto@ff060000 {
		compatible = "rockchip,rk3328-crypto";
		reg = <0x0 0xff060000 0x0 0x4000>;
		interrupts = <GIC_SPI 30 IRQ_TYPE_LEVEL_HIGH>;
		clocks = <&cru HCLK_CRYPTO_MST>, <&cru HCLK_CRYPTO_SLV>,
			 <&cru SCLK_CRYPTO>;
		clock-names = "hclk_master", "hclk_slave", "sclk";
		resets = <&cru SRST_CRYPTO>;
		reset-names = "crypto-rst";
	};
};
