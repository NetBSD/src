/*	$NetBSD: mulaw.c,v 1.2 2019/05/08 13:40:17 isaki Exp $	*/

/*
 * Copyright (C) 2017 Tetsuya Isaki. All rights reserved.
 * Copyright (C) 2017 Y.Sugahara (moveccr). All rights reserved.
 *
 * Redistribution and use in source and binary forms, with or without
 * modification, are permitted provided that the following conditions
 * are met:
 * 1. Redistributions of source code must retain the above copyright
 *    notice, this list of conditions and the following disclaimer.
 * 2. Redistributions in binary form must reproduce the above copyright
 *    notice, this list of conditions and the following disclaimer in the
 *    documentation and/or other materials provided with the distribution.
 *
 * THIS SOFTWARE IS PROVIDED BY THE AUTHOR ``AS IS'' AND ANY EXPRESS OR
 * IMPLIED WARRANTIES, INCLUDING, BUT NOT LIMITED TO, THE IMPLIED WARRANTIES
 * OF MERCHANTABILITY AND FITNESS FOR A PARTICULAR PURPOSE ARE DISCLAIMED.
 * IN NO EVENT SHALL THE AUTHOR BE LIABLE FOR ANY DIRECT, INDIRECT,
 * INCIDENTAL, SPECIAL, EXEMPLARY, OR CONSEQUENTIAL DAMAGES (INCLUDING,
 * BUT NOT LIMITED TO, PROCUREMENT OF SUBSTITUTE GOODS OR SERVICES;
 * LOSS OF USE, DATA, OR PROFITS; OR BUSINESS INTERRUPTION) HOWEVER CAUSED
 * AND ON ANY THEORY OF LIABILITY, WHETHER IN CONTRACT, STRICT LIABILITY,
 * OR TORT (INCLUDING NEGLIGENCE OR OTHERWISE) ARISING IN ANY WAY
 * OUT OF THE USE OF THIS SOFTWARE, EVEN IF ADVISED OF THE POSSIBILITY OF
 * SUCH DAMAGE.
 */

#if defined(_KERNEL)
#include <sys/cdefs.h>
__KERNEL_RCSID(0, "$NetBSD: mulaw.c,v 1.2 2019/05/08 13:40:17 isaki Exp $");

#include <sys/types.h>
#include <sys/systm.h>
#include <sys/device.h>
#include <dev/audio/audiovar.h>
#include <dev/audio/mulaw.h>
#else
#include <stdint.h>
#include <stdbool.h>
#include "compat.h"
#include "audiovar.h"
#endif /* _KERNEL */

/*
 * audio_internal_to_mulaw has two implementations.
 *
 * 1. Use 8bit table (MULAW_LQ_ENC)
 *  It's traditional implementation and its precision is 8bit.
 *  It's faster but the size is larger.  And you can hear a little noise
 *  in silent part.
 *
 * 2. Calculation (default)
 *  It calculates mu-law with full spec and its precision is 14bit.
 *  It's about 10 times slower but the size is less than a half (on m68k,
 *  for example).
 *
 * mu-law is no longer a popular format.  I think size-optimized is better.
 */
/* #define MULAW_LQ_ENC */

/*
 * About mulaw32 format.
 *
 * The format which I call ``mulaw32'' is only used in dev/tc/bba.c .
 * It is 8bit mu-law but 16bit left-shifted and its containter is 32bit.
 * Not mu-law calculated in 32bit.
 *
 * When MULAW32 is not defined (it's default), this file outputs
 * audio_internal_to_mulaw() and audio_mulaw_to_internal().  When
 * MULAW32 is defined, this file outputs audio_internal_to_mulaw32()
 * and audio_mulaw32_to_internal() instead.
 *
 * Since mu-law is used as userland format and is mandatory, all audio
 * drivers (including tc/bba) link this mulaw.c in ordinary procedure.
 * On the other hand, only tc/bba also needs audio_internal_to_mulaw32()
 * and audio_mulaw32_to_internal() as its hardware drivers codec, so
 * define MULAW32 and include this file.  It's a bit tricky but I think
 * this is the simplest way.
 */

#if 0
#define MPRINTF(fmt, ...)	printf(fmt, ## __VA_ARGS__)
#else
#define MPRINTF(fmt, ...)	/**/
#endif

static const int16_t mulaw_to_slinear16[256] = {
	0x8284, 0x8684, 0x8a84, 0x8e84, 0x9284, 0x9684, 0x9a84, 0x9e84,
	0xa284, 0xa684, 0xaa84, 0xae84, 0xb284, 0xb684, 0xba84, 0xbe84,
	0xc184, 0xc384, 0xc584, 0xc784, 0xc984, 0xcb84, 0xcd84, 0xcf84,
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	0x0038, 0x0030, 0x0028, 0x0020, 0x0018, 0x0010, 0x0008, 0x0000,
};

#if defined(MULAW_LQ_ENC)
static const uint8_t slinear8_to_mulaw[256] = {
	0xff, 0xe7, 0xdb, 0xd3, 0xcd, 0xc9, 0xc5, 0xc1,
	0xbe, 0xbc, 0xba, 0xb8, 0xb6, 0xb4, 0xb2, 0xb0,
	0xaf, 0xae, 0xad, 0xac, 0xab, 0xaa, 0xa9, 0xa8,
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	0x3e, 0x41, 0x45, 0x49, 0x4d, 0x53, 0x5b, 0x67,
};
#endif

/*
 * audio_mulaw_to_internal:
 *	This filter performs conversion from mu-law to internal format.
 *
 * audio_mulaw32_to_internal:
 *	This filter performs conversion from mulaw32 used only in tc/bba.c
 *	to internal format.
 */
void
#if !defined(MULAW32)
audio_mulaw_to_internal(audio_filter_arg_t *arg)
#else
audio_mulaw32_to_internal(audio_filter_arg_t *arg)
#endif
{
#if defined(MULAW32)
	const uint32_t *s;
#else
	const uint8_t *s;
#endif
	aint_t *d;
	u_int sample_count;
	u_int i;

	DIAGNOSTIC_filter_arg(arg);
#if !defined(MULAW32)
	KASSERT(arg->srcfmt->encoding == AUDIO_ENCODING_ULAW);
	KASSERT(arg->srcfmt->stride == 8);
	KASSERT(arg->srcfmt->precision == 8);
#endif
	KASSERT(audio_format2_is_internal(arg->dstfmt));
	KASSERT(arg->srcfmt->channels == arg->dstfmt->channels);

	s = arg->src;
	d = arg->dst;
	sample_count = arg->count * arg->srcfmt->channels;

	for (i = 0; i < sample_count; i++) {
		aint_t val;
		uint m;
		m = *s++;
#if defined(MULAW32)
		/* 32bit container used only in tc/bba.c */
		m = (m >> 16) & 0xff;
#endif
		val = mulaw_to_slinear16[m];
		val <<= AUDIO_INTERNAL_BITS - 16;
		*d++ = val;
	}
}

/*
 * audio_internal_to_mulaw:
 *	This filter performs conversion from internal format to mu-law.
 *
 * audio_internal_to_mulaw32:
 *	This filter performs conversion from internal format to mulaw32
 *	used only in tc/bba.c.
 */
void
#if !defined(MULAW32)
audio_internal_to_mulaw(audio_filter_arg_t *arg)
#else
audio_internal_to_mulaw32(audio_filter_arg_t *arg)
#endif
{
	const aint_t *s;
#if defined(MULAW32)
	uint32_t *d;
#else
	uint8_t *d;
#endif
	u_int sample_count;
	u_int i;

	DIAGNOSTIC_filter_arg(arg);
#if !defined(MULAW32)
	KASSERT(arg->dstfmt->encoding == AUDIO_ENCODING_ULAW);
	KASSERT(arg->dstfmt->stride == 8);
	KASSERT(arg->dstfmt->precision == 8);
#endif
	KASSERT(audio_format2_is_internal(arg->srcfmt));
	KASSERT(arg->srcfmt->channels == arg->dstfmt->channels);

	s = arg->src;
	d = arg->dst;
	sample_count = arg->count * arg->srcfmt->channels;

	for (i = 0; i < sample_count; i++) {
		uint8_t m;
#if defined(MULAW_LQ_ENC)
		/* 8bit (low quality, fast but fat) encoder */
		uint8_t val;
		val = (*s++) >> (AUDIO_INTERNAL_BITS - 8);
		m = slinear8_to_mulaw[val];
#else
		/* 14bit (fullspec, slow but small) encoder */
		int16_t val;
		int c;

		val = (int16_t)(*s++ >> (AUDIO_INTERNAL_BITS - 16));
		if (val < 0) {
			m = 0;
		} else {
			val = ~val;
			m = 0x80;
		}
		/* limit */
		if (val < -8158 * 4)
			val = -8158 * 4;
		val -= 33 * 4;	/* bias */

		val <<= 1;
		for (c = 0; c < 7; c++) {
			if (val >= 0) {
				break;
			}

			m += (1 << 4);	/* exponent */
			val <<= 1;
		}
		val <<= 1;

		m += (val >> 12) & 0x0f; /* mantissa */
#endif

#if defined(MULAW32)
		/* 8bit mu-law in 32bit container used only in tc/bba.c */
		*d++ = m << 16;
#else
		*d++ = m;
#endif
	}
}
