// SPDX-License-Identifier: GPL-2.0 OR MIT
/*
 * Copyright (C) 2021 Emil Renner Berthing <kernel@esmil.dk>
 */

/dts-v1/;
#include "jh7100-common.dtsi"
#include <dt-bindings/gpio/gpio.h>

/ {
	model = "BeagleV Starlight Beta A1";
	compatible = "beagle,beaglev-starlight-jh7100-a1", "starfive,jh7100";

	gpio-restart {
		compatible = "gpio-restart";
		gpios = <&gpio 63 GPIO_ACTIVE_HIGH>;
		priority = <224>;
	};
};

&gpio {
	/* don't reset gpio mux for serial console and reset gpio */
	starfive,keep-gpiomux = <13 14 63>;
};
