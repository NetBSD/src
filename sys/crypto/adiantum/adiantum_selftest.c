/*	$NetBSD: adiantum_selftest.c,v 1.1 2020/06/29 23:44:01 riastradh Exp $	*/

/*-
 * Copyright (c) 2020 The NetBSD Foundation, Inc.
 * All rights reserved.
 *
 * Redistribution and use in source and binary forms, with or without
 * modification, are permitted provided that the following conditions
 * are met:
 * 1. Redistributions of source code must retain the above copyright
 *    notice, this list of conditions and the following disclaimer.
 * 2. Redistributions in binary form must reproduce the above copyright
 *    notice, this list of conditions and the following disclaimer in the
 *    documentation and/or other materials provided with the distribution.
 *
 * THIS SOFTWARE IS PROVIDED BY THE NETBSD FOUNDATION, INC. AND CONTRIBUTORS
 * ``AS IS'' AND ANY EXPRESS OR IMPLIED WARRANTIES, INCLUDING, BUT NOT LIMITED
 * TO, THE IMPLIED WARRANTIES OF MERCHANTABILITY AND FITNESS FOR A PARTICULAR
 * PURPOSE ARE DISCLAIMED.  IN NO EVENT SHALL THE FOUNDATION OR CONTRIBUTORS
 * BE LIABLE FOR ANY DIRECT, INDIRECT, INCIDENTAL, SPECIAL, EXEMPLARY, OR
 * CONSEQUENTIAL DAMAGES (INCLUDING, BUT NOT LIMITED TO, PROCUREMENT OF
 * SUBSTITUTE GOODS OR SERVICES; LOSS OF USE, DATA, OR PROFITS; OR BUSINESS
 * INTERRUPTION) HOWEVER CAUSED AND ON ANY THEORY OF LIABILITY, WHETHER IN
 * CONTRACT, STRICT LIABILITY, OR TORT (INCLUDING NEGLIGENCE OR OTHERWISE)
 * ARISING IN ANY WAY OUT OF THE USE OF THIS SOFTWARE, EVEN IF ADVISED OF THE
 * POSSIBILITY OF SUCH DAMAGE.
 */

#include <sys/cdefs.h>
__KERNEL_RCSID(1, "$NetBSD: adiantum_selftest.c,v 1.1 2020/06/29 23:44:01 riastradh Exp $");

#include <sys/types.h>

#ifdef _KERNEL

#include <sys/systm.h>

#include <lib/libkern/libkern.h>

#else

#include <string.h>
#include <stdio.h>

#include <openssl/aes.h>

struct aesenc {
	AES_KEY enckey;
};

struct aesdec {
	AES_KEY deckey;
};

static void
hexdump(int (*prf)(const char *, ...) __printflike(1,2), const char *prefix,
    const void *buf, size_t len)
{
	const uint8_t *p = buf;
	size_t i;

	(*prf)("%s (%zu bytes)\n", prefix, len);
	for (i = 0; i < len; i++) {
		if (i % 16 == 8)
			(*prf)("  ");
		else
			(*prf)(" ");
		(*prf)("%02hhx", p[i]);
		if ((i + 1) % 16 == 0)
			(*prf)("\n");
	}
	if (i % 16)
		(*prf)("\n");
}

#endif

#include "adiantum.h"

/* https://github.com/google/adiantum/blob/aab35db7bfb6e05d5ad0b41b5088a9f5a840bde3/test_vectors/ours/Adiantum/Adiantum_XChaCha12_32_AES256.json */

int
adiantum_selftest(void)
{
	static const struct {
		uint8_t k[32];
		unsigned tlen;
		uint8_t t[64];
		unsigned len;
		uint8_t p[4096];
		uint8_t c[4096];
	} C[] = {
		[0] = {
			.k = {
				0x7f,0xc7,0x15,0x2a, 0xe1,0xf5,0xfd,0xa4,
				0x17,0x67,0x69,0xae, 0xc9,0x2b,0xba,0x82,
				0xa3,0x14,0xe7,0xcf, 0xad,0xfd,0x85,0x40,
				0xda,0x7b,0x7d,0x24, 0xbd,0xf1,0x7d,0x07,
			},
			.tlen = 0,
			.len = 16,
			.p = {
				0x9b,0xe3,0x82,0xc6, 0x5a,0xc1,0x9f,0xad,
				0x46,0x59,0xb8,0x0b, 0xac,0xc8,0x57,0xa0,
			},
			.c = {
				0x82,0x0a,0xe4,0x44, 0x77,0xdd,0x9a,0x18,
				0x6f,0x80,0x28,0x8b, 0x25,0x07,0x0e,0x85,
			},
		},
		[1] = {
			.k = {
				0x26,0x6a,0xf9,0x4a, 0x21,0x49,0x6b,0x4e,
				0x3e,0xff,0x43,0x46, 0x9c,0xc1,0xfa,0x72,
				0x0e,0x77,0x9a,0xd5, 0x37,0x47,0x00,0x38,
				0xb3,0x6f,0x58,0x6c, 0xde,0xc0,0xa6,0x74,
			},
			.tlen = 0,
			.len = 128,
			.p = {
				0xdd,0x07,0xfe,0x61, 0x97,0x0c,0x31,0x48,
				0x09,0xbf,0xdb,0x9b, 0x4b,0x7d,0x9c,0x80,
				0xe6,0x11,0xe5,0x76, 0x5b,0xcc,0x76,0xdf,
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				0xcc,0x05,0x7c,0x31, 0xd3,0xbc,0x17,0x7f,
			},
			.c = {
				0xba,0xd3,0xbf,0xbf, 0xb2,0x4e,0x1a,0xfd,
				0x59,0xbe,0x9d,0x40, 0xe0,0x27,0x94,0xdd,
				0x5c,0x08,0x1c,0xa5, 0xd0,0x25,0x87,0xca,
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				0x03,0x1d,0x66,0xa1, 0x49,0xba,0xe9,0xf5,
			},
		},
		[2] = {
			.k = {
				0x7c,0xab,0xc4,0x63, 0xc0,0x40,0x5e,0xad,
				0x8f,0x02,0x5a,0xa9, 0xba,0x68,0x58,0xe3,
				0xb6,0xbb,0x03,0xc9, 0xe6,0x1e,0xe7,0xc3,
				0xd7,0x2c,0xf7,0x7a, 0xf7,0x2c,0xd1,0x07,
			},
			.tlen = 0,
			.len = 512,
			.p = {
				0x4f,0xc9,0x8f,0xa7, 0x81,0x81,0x3a,0xb7,
				0x3c,0x55,0x8f,0x8f, 0x18,0xc4,0x7a,0xd2,
				0x13,0x70,0x94,0x0f, 0x46,0xb2,0x0f,0x53,
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				0xe4,0x06,0x75,0x69, 0xf5,0x32,0x48,0x80,
			},
			.c = {
				0x66,0x3f,0xf7,0x7a, 0x20,0xa4,0x35,0xd6,
				0x0e,0xe8,0x17,0x32, 0x84,0xae,0xee,0x18,
				0x0f,0x64,0x83,0x66, 0xa4,0xf4,0x24,0x53,
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				0x44,0x57,0x39,0xe7, 0xa9,0xdd,0xac,0x91,
			},
		},
		[3] = {
			.k = {
				0xac,0x95,0xec,0x00, 0xa5,0x57,0x8e,0x99,
				0x14,0x54,0x95,0x60, 0xdc,0xae,0x56,0x66,
				0x03,0x22,0xa1,0x55, 0xbf,0xa5,0x2b,0x1c,
				0x02,0xc9,0x0c,0x2f, 0xa1,0x5d,0x1b,0x84,
			},
			.tlen = 0,
			.len = 1536,
			.p = {
				0xd2,0x80,0x06,0x95, 0xcd,0xe1,0x71,0x2c,
				0xcf,0x89,0xa6,0xc7, 0x8b,0xa7,0xe3,0xcb,
				0x66,0x3e,0x6b,0x58, 0x2a,0x20,0xd1,0xc4,
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				0x8d,0xa4,0x15,0x3d, 0xfc,0x92,0x67,0x91,
			},
			.c = {
				0x5c,0xb9,0xab,0x7c, 0xe4,0x0b,0xbe,0xa5,
				0x17,0x18,0xdf,0xd7, 0x17,0x13,0x98,0xbd,
				0xcb,0x1c,0xa3,0x39, 0x9c,0xbc,0x19,0x1f,
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				0xa6,0x90,0x7f,0xb5, 0xf4,0xbd,0xff,0xae,
			},
		},
		[4] = {
			.k = {
				0x7f,0x56,0x7d,0x15, 0x77,0xe6,0x83,0xac,
				0xd3,0xc5,0xb7,0x39, 0x9e,0x9f,0xf9,0x17,
				0xc7,0xff,0x50,0xb0, 0x33,0xee,0x8f,0xd7,
				0x3a,0xab,0x0b,0xfe, 0x6d,0xd1,0x41,0x8a,
			},
			.tlen = 0,
			.len = 4096,
			.p = {
				0x95,0x96,0x98,0xef, 0x73,0x92,0xb5,0x20,
				0xec,0xfc,0x4d,0x91, 0x54,0xbf,0x8d,0x9d,
				0x54,0xbc,0x4f,0x0f, 0x94,0xfc,0x94,0xcf,
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				0xc8,0xa0,0x06,0xd9, 0x0b,0x80,0xc4,0x84,
			},
			.c = {
				0x10,0x46,0xb6,0xc8, 0xaa,0x83,0x67,0x7b,
				0xc5,0x9a,0x9a,0x0d, 0xe2,0xec,0x6f,0x9a,
				0x3e,0x74,0xa7,0xfa, 0x43,0x93,0x9d,0xc5,
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				0x21,0x6f,0xdb,0x8e, 0xba,0x83,0x42,0xb1,
			},
		},
		[5] = {
			.k = {
				0x79,0xce,0xb0,0x8e, 0xf8,0x7a,0x67,0xc6,
				0x48,0x2c,0x2a,0xc0, 0xa5,0x45,0x06,0x49,
				0xc8,0x90,0xb8,0xe9, 0xc6,0xb6,0xb3,0x50,
				0xbd,0x9e,0x46,0x56, 0x26,0xf2,0xb0,0x3b,
			},
			.tlen = 17,
			.t = {
				0xe6,0x93,0xbe,0x89, 0xf5,0xee,0x40,0xde,
				0xf2,0x9c,0xb5,0xec, 0x6a,0x37,0x23,0x46,
				0x0e,
			},
			.len = 16,
			.p = {
				0x5d,0x83,0x98,0x37, 0xc6,0x33,0x9e,0x7e,
				0x59,0xad,0xd2,0x5b, 0x8a,0x3a,0x9d,0x03,
			},
			.c = {
				0x96,0x23,0x2f,0x7d, 0x52,0xfc,0x98,0x63,
				0x98,0xa5,0x8b,0xdf, 0xca,0xbc,0x85,0x2f,
			},
		},
		[6] = {
			.k = {
				0x9f,0xd3,0x36,0xb1, 0x85,0x07,0xdf,0x19,
				0x01,0xea,0xf9,0x52, 0x68,0xbf,0xce,0xe7,
				0xd0,0x49,0xf3,0xba, 0x58,0xfb,0x87,0x18,
				0x9f,0xca,0x24,0xca, 0x61,0xa3,0xf0,0xda,
			},
			.tlen = 17,
			.t = {
				0xea,0xc6,0x72,0x5e, 0x66,0xd4,0xc7,0xbd,
				0xa1,0x6e,0xab,0x09, 0xb5,0x58,0x39,0xae,
				0x40,
			},
			.len = 128,
			.p = {
				0xc7,0xd6,0x73,0x65, 0xcb,0xf3,0xf5,0x3e,
				0xb9,0xa7,0xbf,0xb1, 0x54,0xcb,0xac,0x01,
				0xee,0xb5,0x94,0x17, 0x40,0x92,0xfd,0xad,
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				0x88,0x08,0x0c,0x00, 0x80,0x7a,0x85,0x64,
			},
			.c = {
				0x49,0x36,0x97,0xd2, 0xde,0xa4,0xde,0x92,
				0x7d,0x30,0x08,0xc3, 0xd9,0x47,0xd4,0xcb,
				0x5b,0x41,0x27,0x2c, 0x06,0xb8,0x2b,0xef,
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				0x01,0xc8,0x4e,0x1f, 0x2a,0x89,0xe2,0x52,
			},
		},
	};
	static struct adiantum A;
	static uint8_t buf[4096];
	unsigned i;
	int result = 0;

	for (i = 0; i < __arraycount(C); i++) {
		adiantum_init(&A, C[i].k);
		adiantum_enc(buf, C[i].p, C[i].len, C[i].t, C[i].tlen, &A);
		if (memcmp(buf, C[i].c, C[i].len)) {
			char prefix[16];
			snprintf(prefix, sizeof prefix, "adiantum enc %u", i);
			hexdump(printf, prefix, buf, C[i].len);
			result = -1;
		}
		memset(buf, 0, sizeof buf); /* paranoia */
		adiantum_dec(buf, C[i].c, C[i].len, C[i].t, C[i].tlen, &A);
		if (memcmp(buf, C[i].p, C[i].len)) {
			char prefix[16];
			snprintf(prefix, sizeof prefix, "adiantum dec %u", i);
			hexdump(printf, prefix, buf, C[i].len);
			result = -1;
		}
	}

	return result;
}
