/*	$NetBSD: adiantum.c,v 1.5 2020/07/26 04:05:20 riastradh Exp $	*/

/*-
 * Copyright (c) 2020 The NetBSD Foundation, Inc.
 * All rights reserved.
 *
 * Redistribution and use in source and binary forms, with or without
 * modification, are permitted provided that the following conditions
 * are met:
 * 1. Redistributions of source code must retain the above copyright
 *    notice, this list of conditions and the following disclaimer.
 * 2. Redistributions in binary form must reproduce the above copyright
 *    notice, this list of conditions and the following disclaimer in the
 *    documentation and/or other materials provided with the distribution.
 *
 * THIS SOFTWARE IS PROVIDED BY THE NETBSD FOUNDATION, INC. AND CONTRIBUTORS
 * ``AS IS'' AND ANY EXPRESS OR IMPLIED WARRANTIES, INCLUDING, BUT NOT LIMITED
 * TO, THE IMPLIED WARRANTIES OF MERCHANTABILITY AND FITNESS FOR A PARTICULAR
 * PURPOSE ARE DISCLAIMED.  IN NO EVENT SHALL THE FOUNDATION OR CONTRIBUTORS
 * BE LIABLE FOR ANY DIRECT, INDIRECT, INCIDENTAL, SPECIAL, EXEMPLARY, OR
 * CONSEQUENTIAL DAMAGES (INCLUDING, BUT NOT LIMITED TO, PROCUREMENT OF
 * SUBSTITUTE GOODS OR SERVICES; LOSS OF USE, DATA, OR PROFITS; OR BUSINESS
 * INTERRUPTION) HOWEVER CAUSED AND ON ANY THEORY OF LIABILITY, WHETHER IN
 * CONTRACT, STRICT LIABILITY, OR TORT (INCLUDING NEGLIGENCE OR OTHERWISE)
 * ARISING IN ANY WAY OUT OF THE USE OF THIS SOFTWARE, EVEN IF ADVISED OF THE
 * POSSIBILITY OF SUCH DAMAGE.
 */

/*
 * The Adiantum wide-block cipher, from
 *
 *	Paul Crowley and Eric Biggers, `Adiantum: length-preserving
 *	encryption for entry-level processors', IACR Transactions on
 *	Symmetric Cryptology 2018(4), pp. 39--61.
 *
 *	https://doi.org/10.13154/tosc.v2018.i4.39-61
 */

#include <sys/cdefs.h>
__KERNEL_RCSID(1, "$NetBSD: adiantum.c,v 1.5 2020/07/26 04:05:20 riastradh Exp $");

#include <sys/types.h>
#include <sys/endian.h>

#ifdef _KERNEL

#include <sys/module.h>
#include <sys/systm.h>

#include <lib/libkern/libkern.h>

#include <crypto/adiantum/adiantum.h>
#include <crypto/aes/aes.h>
#include <crypto/chacha/chacha.h>

#else  /* !defined(_KERNEL) */

#include <sys/cdefs.h>

#include <assert.h>
#include <stdint.h>
#include <stdio.h>
#include <string.h>

#include <openssl/aes.h>

struct aesenc {
	AES_KEY enckey;
};

struct aesdec {
	AES_KEY deckey;
};

#define	AES_256_NROUNDS	14
#define	aes_setenckey256(E, K)	AES_set_encrypt_key((K), 256, &(E)->enckey)
#define	aes_setdeckey256(D, K)	AES_set_decrypt_key((K), 256, &(D)->deckey)
#define	aes_enc(E, P, C, NR)	AES_encrypt(P, C, &(E)->enckey)
#define	aes_dec(D, C, P, NR)	AES_decrypt(C, P, &(D)->deckey)

#include "adiantum.h"

#define	CTASSERT	__CTASSERT
#define	KASSERT		assert
#define	MIN(x,y)	((x) < (y) ? (x) : (y))

static void
hexdump(int (*prf)(const char *, ...) __printflike(1,2), const char *prefix,
    const void *buf, size_t len)
{
	const uint8_t *p = buf;
	size_t i;

	(*prf)("%s (%zu bytes)\n", prefix, len);
	for (i = 0; i < len; i++) {
		if (i % 16 == 8)
			(*prf)("  ");
		else
			(*prf)(" ");
		(*prf)("%02hhx", p[i]);
		if ((i + 1) % 16 == 0)
			(*prf)("\n");
	}
	if (i % 16)
		(*prf)("\n");
}

#endif	/* _KERNEL */

/* Arithmetic modulo 2^128, represented by 16-digit strings in radix 2^8.  */

/* s := a + b (mod 2^128) */
static inline void
add128(uint8_t s[restrict static 16],
    const uint8_t a[static 16], const uint8_t b[static 16])
{
	unsigned i, c;

	c = 0;
	for (i = 0; i < 16; i++) {
		c = a[i] + b[i] + c;
		s[i] = c & 0xff;
		c >>= 8;
	}
}

/* s := a - b (mod 2^128) */
static inline void
sub128(uint8_t d[restrict static 16],
    const uint8_t a[static 16], const uint8_t b[static 16])
{
	unsigned i, c;

	c = 0;
	for (i = 0; i < 16; i++) {
		c = a[i] - b[i] - c;
		d[i] = c & 0xff;
		c = 1 & (c >> 8);
	}
}

static int
addsub128_selftest(void)
{
	static const uint8_t zero[16] = {
		0x00,0x00,0x00,0x00, 0x00,0x00,0x00,0x00,
		0x00,0x00,0x00,0x00, 0x00,0x00,0x00,0x00,
	};
	static const uint8_t one[16] = {
		0x01,0x00,0x00,0x00, 0x00,0x00,0x00,0x00,
		0x00,0x00,0x00,0x00, 0x00,0x00,0x00,0x00,
	};
	static const uint8_t negativeone[16] = {
		0xff,0xff,0xff,0xff, 0xff,0xff,0xff,0xff,
		0xff,0xff,0xff,0xff, 0xff,0xff,0xff,0xff,
	};
	static const uint8_t a[16] = {
		0x03,0x80,0x00,0x00, 0x00,0x00,0x00,0x00,
		0x00,0x00,0x00,0x00, 0x00,0x00,0x00,0x00,
	};
	static const uint8_t b[16] = {
		0x01,0x82,0x00,0x00, 0x00,0x00,0x00,0x00,
		0x00,0x00,0x00,0x00, 0x00,0x00,0x00,0x00,
	};
	static const uint8_t c[16] = {
		0x02,0xfe,0xff,0xff, 0xff,0xff,0xff,0xff,
		0xff,0xff,0xff,0xff, 0xff,0xff,0xff,0xff,
	};
	uint8_t r[16];
	int result = 0;

	sub128(r, zero, one);
	if (memcmp(r, negativeone, 16)) {
		hexdump(printf, "sub128 1", r, sizeof r);
		result = -1;
	}

	sub128(r, a, b);
	if (memcmp(r, c, 16)) {
		hexdump(printf, "sub128 2", r, sizeof r);
		result = -1;
	}

	return result;
}

/* Poly1305 */

struct poly1305 {
	uint32_t r[5];		/* evaluation point */
	uint32_t h[5];		/* value */
};

static void
poly1305_init(struct poly1305 *P, const uint8_t key[static 16])
{

	/* clamp */
	P->r[0] = (le32dec(key +  0) >> 0) & 0x03ffffff;
	P->r[1] = (le32dec(key +  3) >> 2) & 0x03ffff03;
	P->r[2] = (le32dec(key +  6) >> 4) & 0x03ffc0ff;
	P->r[3] = (le32dec(key +  9) >> 6) & 0x03f03fff;
	P->r[4] = (le32dec(key + 12) >> 8) & 0x000fffff;

	/* initialize polynomial evaluation */
	P->h[0] = P->h[1] = P->h[2] = P->h[3] = P->h[4] = 0;
}

static void
poly1305_update_blocks(struct poly1305 *P, const uint8_t *m, size_t mlen)
{
	uint32_t r0 = P->r[0];
	uint32_t r1 = P->r[1];
	uint32_t r2 = P->r[2];
	uint32_t r3 = P->r[3];
	uint32_t r4 = P->r[4];
	uint32_t h0 = P->h[0];
	uint32_t h1 = P->h[1];
	uint32_t h2 = P->h[2];
	uint32_t h3 = P->h[3];
	uint32_t h4 = P->h[4];
	uint32_t m0, m1, m2, m3, m4; /* 26-bit message chunks */
	uint64_t k0, k1, k2, k3, k4; /* 64-bit extension of h */
	uint64_t p0, p1, p2, p3, p4; /* columns of product */
	uint32_t c;		     /* carry */

	while (mlen) {
		if (__predict_false(mlen < 16)) {
			/* Handle padding for uneven last block.  */
			uint8_t buf[16];
			unsigned i;

			for (i = 0; i < mlen; i++)
				buf[i] = m[i];
			buf[i++] = 1;
			for (; i < 16; i++)
				buf[i] = 0;
			m0 = le32dec(buf +  0) >> 0;
			m1 = le32dec(buf +  3) >> 2;
			m2 = le32dec(buf +  6) >> 4;
			m3 = le32dec(buf +  9) >> 6;
			m4 = le32dec(buf + 12) >> 8;
			mlen = 0;

			explicit_memset(buf, 0, sizeof buf);
		} else {
			m0 = le32dec(m +  0) >> 0;
			m1 = le32dec(m +  3) >> 2;
			m2 = le32dec(m +  6) >> 4;
			m3 = le32dec(m +  9) >> 6;
			m4 = le32dec(m + 12) >> 8;
			m4 |= 1u << 24;
			m += 16;
			mlen -= 16;
		}

		/* k := h + m, extended to 64 bits */
		k0 = h0 + (m0 & 0x03ffffff);
		k1 = h1 + (m1 & 0x03ffffff);
		k2 = h2 + (m2 & 0x03ffffff);
		k3 = h3 + m3;
		k4 = h4 + m4;

		/* p := k * r = (h + m)*r mod 2^130 - 5 */
		p0 = r0*k0 + 5*r4*k1 + 5*r3*k2 + 5*r2*k3 + 5*r1*k4;
		p1 = r1*k0 +   r0*k1 + 5*r4*k2 + 5*r3*k3 + 5*r2*k4;
		p2 = r2*k0 +   r1*k1 +   r0*k2 + 5*r4*k3 + 5*r3*k4;
		p3 = r3*k0 +   r2*k1 +   r1*k2 +   r0*k3 + 5*r4*k4;
		p4 = r4*k0 +   r3*k1 +   r2*k2 +   r1*k3 +   r0*k4;

		/* propagate carries and update h */
		p0 += 0; c = p0 >> 26; h0 = p0 & 0x03ffffff;
		p1 += c; c = p1 >> 26; h1 = p1 & 0x03ffffff;
		p2 += c; c = p2 >> 26; h2 = p2 & 0x03ffffff;
		p3 += c; c = p3 >> 26; h3 = p3 & 0x03ffffff;
		p4 += c; c = p4 >> 26; h4 = p4 & 0x03ffffff;

		/* reduce 2^130 = 5 */
		h0 += c*5; c = h0 >> 26; h0 &= 0x03ffffff;
		h1 += c;
	}

	/* update hash values */
	P->h[0] = h0;
	P->h[1] = h1;
	P->h[2] = h2;
	P->h[3] = h3;
	P->h[4] = h4;
}

static void
poly1305_final(uint8_t h[static 16], struct poly1305 *P)
{
	uint32_t h0 = P->h[0];
	uint32_t h1 = P->h[1];
	uint32_t h2 = P->h[2];
	uint32_t h3 = P->h[3];
	uint32_t h4 = P->h[4];
	uint32_t s0, s1, s2, s3, s4; /* h - (2^130 - 5) */
	uint32_t m;		     /* mask */
	uint32_t c;

	/* propagate carries */
	h1 += 0; c = h1 >> 26; h1 &= 0x03ffffff;
	h2 += c; c = h2 >> 26; h2 &= 0x03ffffff;
	h3 += c; c = h3 >> 26; h3 &= 0x03ffffff;
	h4 += c; c = h4 >> 26; h4 &= 0x03ffffff;

	/* reduce 2^130 = 5 */
	h0 += c*5; c = h0 >> 26; h0 &= 0x03ffffff;
	h1 += c;

	/* s := h - (2^130 - 5) */
	c = 5;
	s0 = h0 + c; c = s0 >> 26; s0 &= 0x03ffffff;
	s1 = h1 + c; c = s1 >> 26; s1 &= 0x03ffffff;
	s2 = h2 + c; c = s2 >> 26; s2 &= 0x03ffffff;
	s3 = h3 + c; c = s3 >> 26; s3 &= 0x03ffffff;
	s4 = h4 + c;
	s4 -= 0x04000000;

	/* m := -1 if h < 2^130 - 5 else 0 */
	m = -(s4 >> 31);

	/* conditional subtract */
	h0 = (m & h0) | (~m & s0);
	h1 = (m & h1) | (~m & s1);
	h2 = (m & h2) | (~m & s2);
	h3 = (m & h3) | (~m & s3);
	h4 = (m & h4) | (~m & s4);

	/* reduce modulo 2^128 */
	le32enc(h +  0, ((h1 << 26) | (h0 >>  0)) & 0xffffffff);
	le32enc(h +  4, ((h2 << 20) | (h1 >>  6)) & 0xffffffff);
	le32enc(h +  8, ((h3 << 14) | (h2 >> 12)) & 0xffffffff);
	le32enc(h + 12, ((h4 <<  8) | (h3 >> 18)) & 0xffffffff);
}

static void
poly1305(uint8_t h[static 16], const uint8_t *m, size_t mlen,
    const uint8_t k[static 16])
{
	struct poly1305 P;

	poly1305_init(&P, k);
	poly1305_update_blocks(&P, m, mlen);
	poly1305_final(h, &P);
}

static int
poly1305_selftest(void)
{
	/* https://tools.ietf.org/html/rfc7539#section-2.5.2 */
	static const uint8_t r[16] = {
		0x85,0xd6,0xbe,0x78, 0x57,0x55,0x6d,0x33,
		0x7f,0x44,0x52,0xfe, 0x42,0xd5,0x06,0xa8,
	};
	static const uint8_t s[16] = {
		0x01,0x03,0x80,0x8a, 0xfb,0x0d,0xb2,0xfd,
		0x4a,0xbf,0xf6,0xaf, 0x41,0x49,0xf5,0x1b,
	};
	static const uint8_t m[] = {
		0x43,0x72,0x79,0x70, 0x74,0x6f,0x67,0x72,
		0x61,0x70,0x68,0x69, 0x63,0x20,0x46,0x6f,
		0x72,0x75,0x6d,0x20, 0x52,0x65,0x73,0x65,
		0x61,0x72,0x63,0x68, 0x20,0x47,0x72,0x6f,
		0x75,0x70,
	};
	static const uint8_t expected[16] = {
		0xa8,0x06,0x1d,0xc1, 0x30,0x51,0x36,0xc6,
		0xc2,0x2b,0x8b,0xaf, 0x0c,0x01,0x27,0xa9,
	};
	uint8_t h[16], t[16];
	int result = 0;

	poly1305(h, m, sizeof m, r);
	add128(t, h, s);
	if (memcmp(t, expected, 16)) {
		hexdump(printf, "poly1305 h", h, sizeof h);
		hexdump(printf, "poly1305 t", t, sizeof t);
		result = -1;
	}

	return result;
}

/* NHPoly1305 */

static void
nh(uint8_t h[static 32], const uint8_t *m, size_t mlen,
    const uint32_t k[static 268 /* u/w + 2s(r - 1) */])
{
	const unsigned w = 32;	 /* word size */
	const unsigned s = 2;	 /* stride */
	const unsigned r = 4;	 /* rounds */
	const unsigned u = 8192; /* unit count (bits per msg unit) */
	uint64_t h0 = 0, h1 = 0, h2 = 0, h3 = 0;
	unsigned i;

	CTASSERT(r*w/8 == 16);
	CTASSERT(u/w + 2*s*(r - 1) == 268);

	KASSERT(mlen <= u/8);
	KASSERT(mlen % 16 == 0);

	for (i = 0; i < mlen/16; i++) {
		uint32_t m0 = le32dec(m + 16*i + 4*0);
		uint32_t m1 = le32dec(m + 16*i + 4*1);
		uint32_t m2 = le32dec(m + 16*i + 4*2);
		uint32_t m3 = le32dec(m + 16*i + 4*3);

		uint32_t k00 = k[4*i + 4*0 + 0];
		uint32_t k01 = k[4*i + 4*0 + 1];
		uint32_t k02 = k[4*i + 4*0 + 2];
		uint32_t k03 = k[4*i + 4*0 + 3];
		uint32_t k10 = k[4*i + 4*1 + 0];
		uint32_t k11 = k[4*i + 4*1 + 1];
		uint32_t k12 = k[4*i + 4*1 + 2];
		uint32_t k13 = k[4*i + 4*1 + 3];
		uint32_t k20 = k[4*i + 4*2 + 0];
		uint32_t k21 = k[4*i + 4*2 + 1];
		uint32_t k22 = k[4*i + 4*2 + 2];
		uint32_t k23 = k[4*i + 4*2 + 3];
		uint32_t k30 = k[4*i + 4*3 + 0];
		uint32_t k31 = k[4*i + 4*3 + 1];
		uint32_t k32 = k[4*i + 4*3 + 2];
		uint32_t k33 = k[4*i + 4*3 + 3];

		CTASSERT(s == 2);
		h0 += (uint64_t)(m0 + k00) * (m2 + k02);
		h1 += (uint64_t)(m0 + k10) * (m2 + k12);
		h2 += (uint64_t)(m0 + k20) * (m2 + k22);
		h3 += (uint64_t)(m0 + k30) * (m2 + k32);
		h0 += (uint64_t)(m1 + k01) * (m3 + k03);
		h1 += (uint64_t)(m1 + k11) * (m3 + k13);
		h2 += (uint64_t)(m1 + k21) * (m3 + k23);
		h3 += (uint64_t)(m1 + k31) * (m3 + k33);
	}

	le64enc(h + 8*0, h0);
	le64enc(h + 8*1, h1);
	le64enc(h + 8*2, h2);
	le64enc(h + 8*3, h3);
}

static void
nhpoly1305(uint8_t h[static 16], const uint8_t *m, size_t mlen,
    const uint8_t pk[static 16],
    const uint32_t nhk[static 268 /* u/w + 2s(r - 1) */])
{
	struct poly1305 P;
	uint8_t h0[32];

	/*
	 * In principle NHPoly1305 is defined on uneven message
	 * lengths, but that's a pain in the patootie.
	 */
	KASSERT(mlen % 16 == 0);

	poly1305_init(&P, pk);
	for (; mlen; m += MIN(mlen, 1024), mlen -= MIN(mlen, 1024)) {
		nh(h0, m, MIN(mlen, 1024), nhk);
		poly1305_update_blocks(&P, h0, 32);
	}
	poly1305_final(h, &P);
}

/* https://github.com/google/adiantum/blob/68971e9c6684121b2203b4b05a22768b84051b58/test_vectors/ours/NH/NH.json */
static int
nh_selftest(void)
{
	static const struct {
		uint8_t k[1072];
		unsigned mlen;
		uint8_t m[1024];
		uint8_t h[32];
	} C[] = {
		[0] = {		/* 16-byte message */
			.k = {
				0x22,0x5b,0x80,0xc8, 0x18,0x05,0x37,0x09,
				0x76,0x14,0x4b,0x67, 0xc4,0x50,0x7f,0x2b,
				0x2c,0xff,0x56,0xc5, 0xd5,0x66,0x45,0x68,
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				0x80,0x19,0x16,0xba, 0x2c,0x10,0x38,0x96,
			},
			.mlen = 16,
			.m = {
				0xd3,0x82,0xe7,0x04, 0x35,0xcc,0xf7,0xa4,
				0xf9,0xb2,0xc5,0xed, 0x5a,0xd9,0x58,0xeb,
			},
			.h = {
				0x41,0xd9,0xad,0x54, 0x5a,0x0d,0xcc,0x53,
				0x48,0xf6,0x4c,0x75, 0x43,0x5d,0xdd,0x77,
				0xda,0xca,0x7d,0xec, 0x91,0x3b,0x53,0x16,
				0x5c,0x4b,0x58,0xdc, 0x70,0x0a,0x7b,0x37,
			},
		},
		[1] = {		/* 1008-byte message */
			.k = {
				0xd9,0x94,0x65,0xda, 0xc2,0x60,0xdd,0xa9,
				0x39,0xe5,0x37,0x11, 0xf6,0x74,0xa5,0x95,
				0x36,0x07,0x24,0x99, 0x64,0x6b,0xda,0xe2,
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				0xb8,0x94,0x6a,0x30, 0x90,0xf7,0x44,0xbe,
			},
			.mlen = 1008,
			.m = {
				0x05,0xe3,0x6f,0x44, 0xa4,0x40,0x35,0xf6,
				0xeb,0x86,0xa9,0x6d, 0xed,0x16,0xdb,0xb6,
				0x5b,0x59,0xda,0x30, 0x54,0x6c,0x59,0x35,
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				0x2e,0xb3,0xf0,0xd3, 0xce,0xdb,0x26,0x80,
			},
			.h = {
				0x2d,0xb3,0x7e,0x73, 0xde,0x6a,0x9e,0xa9,
				0x54,0x9a,0x0f,0xb3, 0x0b,0xcc,0xc9,0xde,
				0x7a,0x4e,0x4a,0x71, 0x07,0x33,0xee,0x06,
				0x5c,0x9a,0xa1,0x30, 0x5e,0x39,0x4e,0x10,
			},
		},
		[2] = {		/* 1024-byte message */
			.k = {
				0x4c,0xe4,0x3c,0x6e, 0xa0,0xe3,0x0e,0x64,
				0x35,0x44,0x3e,0x0b, 0x4d,0x29,0xbe,0x04,
				0xa7,0xaa,0x88,0xe0, 0xe0,0x07,0x7d,0xa8,
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				0x4c,0x40,0xbf,0xf7, 0xe0,0x7e,0x08,0xaa,
			},
			.mlen = 1024,
			.m = {
				0x1d,0xea,0xe5,0x2b, 0x4c,0x22,0x4d,0xf3,
				0x15,0x53,0xcb,0x41, 0xf5,0xcf,0x0b,0x7b,
				0xc9,0x80,0xc0,0x95, 0xd2,0x7b,0x08,0x4b,
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				0xf0,0x07,0xea,0xe5, 0xcd,0x4e,0x81,0x34,
			},
			.h = {
				0x9d,0x22,0x88,0xfd, 0x41,0x43,0x88,0x45,
				0x34,0xfe,0x85,0xc4, 0xb9,0xff,0xe1,0x55,
				0x40,0x1d,0x25,0x37, 0xd1,0xf8,0xfc,0x2b,
				0x3a,0xf5,0x3b,0x69, 0xbf,0xa6,0x9d,0xed,
			},
		},
	};
	static uint32_t k[268];
	uint8_t h[32];
	unsigned i, j;
	int result = 0;

	for (i = 0; i < __arraycount(C); i++) {
		for (j = 0; j < 268; j++)
			k[j] = le32dec(C[i].k + 4*j);
		nh(h, C[i].m, C[i].mlen, k);
		if (memcmp(h, C[i].h, 32)) {
			char prefix[10];
			snprintf(prefix, sizeof prefix, "nh %u", i);
			hexdump(printf, prefix, h, 32);
			result = -1;
		}
	}

	return result;
}

/* https://github.com/google/adiantum/blob/a5ad5134ab11b10a3ee982c52385953fac88fedc/test_vectors/ours/NHPoly1305/NHPoly1305.json */
static int
nhpoly1305_selftest(void)
{
	static const struct {
		uint8_t k[1088];
		unsigned mlen;
		uint8_t m[1024];
		uint8_t h[16];
	} C[] = {
		[0] = {		/* 0-byte message */
			.k = {
				/* Poly1305 key */
				0xd2,0x5d,0x4c,0xdd, 0x8d,0x2b,0x7f,0x7a,
				0xd9,0xbe,0x71,0xec, 0xd1,0x83,0x52,0xe3,

				/* NH key */
				0xe1,0xad,0xd7,0x5c, 0x0a,0x75,0x9d,0xec,
				0x1d,0x13,0x7e,0x5d, 0x71,0x07,0xc9,0xe4,
				0x57,0x2d,0x44,0x68, 0xcf,0xd8,0xd6,0xc5,
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				0xeb,0x5c,0xeb,0x61, 0x60,0x5a,0xe5,0x28,
			},
			.mlen = 0,
			.h = {0},
		},
		[1] = {		/* 16-byte message */
			.k = {
				/* Poly1305 key */
				0x29,0x21,0x43,0xcb, 0xcb,0x13,0x07,0xde,
				0xbf,0x48,0xdf,0x8a, 0x7f,0xa2,0x84,0xde,

				/* NH key */
				0x72,0x23,0x9d,0xf5, 0xf0,0x07,0xf2,0x4c,
				0x20,0x3a,0x93,0xb9, 0xcd,0x5d,0xfe,0xcb,
				0x99,0x2c,0x2b,0x58, 0xc6,0x50,0x5f,0x94,
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				0x9f,0xd8,0x25,0x2b, 0xdf,0xc0,0x4c,0xda,
			},
			.mlen = 16,
			.m = {
				0xbc,0xda,0x81,0xa8, 0x78,0x79,0x1c,0xbf,
				0x77,0x53,0xba,0x4c, 0x30,0x5b,0xb8,0x33,
			},
			.h = {
				0x04,0xbf,0x7f,0x6a, 0xce,0x72,0xea,0x6a,
				0x79,0xdb,0xb0,0xc9, 0x60,0xf6,0x12,0xcc,
			},
		},
		[2] = {		/* 1024-byte message */
			.k = {
				0x65,0x4d,0xe3,0xf8, 0xd2,0x4c,0xac,0x28,
				0x68,0xf5,0xb3,0x81, 0x71,0x4b,0xa1,0xfa,
				0x04,0x0e,0xd3,0x81, 0x36,0xbe,0x0c,0x81,
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				0x62,0x44,0x0a,0x4a, 0xce,0x78,0x47,0x22,
			},
			.mlen = 1024,
			.m = {
				0x8e,0xb0,0x4c,0xde, 0x9c,0x4a,0x04,0x5a,
				0xf6,0xa9,0x7f,0x45, 0x25,0xa5,0x7b,0x3a,
				0xbc,0x4d,0x73,0x39, 0x81,0xb5,0xbd,0x3d,
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				0xec,0xaa,0xe3,0x4d, 0x22,0x65,0x39,0x4e,
			},
			.h = {
				0x64,0x3a,0xbc,0xc3, 0x3f,0x74,0x40,0x51,
				0x6e,0x56,0x01,0x1a, 0x51,0xec,0x36,0xde,
			},
		},
	};
	const uint8_t *pk;
	const uint8_t *nhk;
	static uint32_t nhk32[268];
	uint8_t h[16];
	unsigned i, j;
	int result = 0;

	for (i = 0; i < __arraycount(C); i++) {
		pk = C[i].k;
		nhk = C[i].k + 16;
		for (j = 0; j < 268; j++)
			nhk32[j] = le32dec(nhk + 4*j);
		nhpoly1305(h, C[i].m, C[i].mlen, pk, nhk32);
		if (memcmp(h, C[i].h, 16)) {
			char prefix[16];
			snprintf(prefix, sizeof prefix, "nhpoly1305 %u", i);
			hexdump(printf, prefix, h, 32);
			result = -1;
		}
	}

	return result;
}

void
adiantum_init(struct adiantum *A, const uint8_t key[static 32])
{
	uint8_t nonce[24] = {1};
	unsigned i;

	memcpy(A->ks, key, 32);

	/* Relies on ordering of struct members.  */
	memset(A->kk, 0, 32 + 16 + 16 + 1072);
	xchacha_stream_xor(A->kk, A->kk, 32 + 16 + 16 + 1072, 0, nonce, A->ks,
	    12);

	/* Put the NH key words into host byte order.  */
	for (i = 0; i < __arraycount(A->kn); i++)
		A->kn[i] = le32toh(A->kn[i]);

	/* Expand the AES key.  */
	aes_setenckey256(&A->kk_enc, A->kk);
	aes_setdeckey256(&A->kk_dec, A->kk);
}

static void
adiantum_hash(uint8_t h[static 16], const void *l, size_t llen,
    const void *t, size_t tlen,
    const uint8_t kt[static 16],
    const uint8_t kl[static 16],
    const uint32_t kn[static 268])
{
	struct poly1305 P;
	uint8_t llenbuf[16];
	uint8_t ht[16];
	uint8_t hl[16];

	KASSERT(llen % 16 == 0);

	memset(llenbuf, 0, sizeof llenbuf);
	le64enc(llenbuf, 8*llen);

	/* Compute H_T := Poly1305_{K_T}(le128(|l|) || tweak).  */
	poly1305_init(&P, kt);
	poly1305_update_blocks(&P, llenbuf, 16);
	poly1305_update_blocks(&P, t, tlen);
	poly1305_final(ht, &P);

	/* Compute H_L := Poly1305_{K_L}(NH(pad_128(l))).  */
	nhpoly1305(hl, l, llen, kl, kn);

	/* Compute H := H_T + H_L (mod 2^128).  */
	add128(h, ht, hl);
}

void
adiantum_enc(void *c, const void *p, size_t len, const void *t, size_t tlen,
    const struct adiantum *A)
{
	size_t Rlen = 16;
	size_t Llen = len - Rlen;
	uint8_t *c8 = c;
	uint8_t *cL = c8;
	uint8_t *cR = c8 + Llen;
	const uint8_t *p8 = p;
	const uint8_t *pL = p8;
	const uint8_t *pR = p8 + Llen;
	uint8_t h[16];
	uint8_t buf[16] __aligned(16);
	uint8_t nonce[24];

	KASSERT(len % 16 == 0);

	adiantum_hash(h, pL, Llen, t, tlen, A->kt, A->kl, A->kn);
	add128(buf, pR, h);	/* buf := P_M */
	aes_enc(&A->kk_enc, buf, buf, AES_256_NROUNDS); /* buf := C_M */

	memcpy(nonce, buf, 16);
	le64enc(nonce + 16, 1);
	xchacha_stream_xor(cL, pL, Llen, 0, nonce, A->ks, 12);

	adiantum_hash(h, cL, Llen, t, tlen, A->kt, A->kl, A->kn);
	sub128(cR, buf, h);

	explicit_memset(h, 0, sizeof h);
	explicit_memset(buf, 0, sizeof buf);
}

void
adiantum_dec(void *p, const void *c, size_t len, const void *t, size_t tlen,
    const struct adiantum *A)
{
	size_t Rlen = 16;
	size_t Llen = len - Rlen;
	const uint8_t *c8 = c;
	const uint8_t *cL = c8;
	const uint8_t *cR = c8 + Llen;
	uint8_t *p8 = p;
	uint8_t *pL = p8;
	uint8_t *pR = p8 + Llen;
	uint8_t h[16];
	uint8_t buf[16] __aligned(16);
	uint8_t nonce[24];

	KASSERT(len % 16 == 0);

	adiantum_hash(h, cL, Llen, t, tlen, A->kt, A->kl, A->kn);
	add128(buf, cR, h);	/* buf := C_M */

	memcpy(nonce, buf, 16);
	le64enc(nonce + 16, 1);
	xchacha_stream_xor(pL, cL, Llen, 0, nonce, A->ks, 12);

	aes_dec(&A->kk_dec, buf, buf, AES_256_NROUNDS); /* buf := P_M */
	adiantum_hash(h, pL, Llen, t, tlen, A->kt, A->kl, A->kn);
	sub128(pR, buf, h);

	explicit_memset(h, 0, sizeof h);
	explicit_memset(buf, 0, sizeof buf);
}

#ifdef _KERNEL

MODULE(MODULE_CLASS_MISC, adiantum, "aes,chacha");

static int
adiantum_modcmd(modcmd_t cmd, void *opaque)
{

	switch (cmd) {
	case MODULE_CMD_INIT: {
		int result = 0;
		result |= addsub128_selftest();
		result |= poly1305_selftest();
		result |= nh_selftest();
		result |= nhpoly1305_selftest();
		result |= adiantum_selftest();
		if (result)
			panic("adiantum self-test failed");
		aprint_verbose("adiantum: self-test passed\n");
		return 0;
	}
	case MODULE_CMD_FINI:
		return 0;
	default:
		return ENOTTY;
	}
}

#else  /* !defined(_KERNEL) */

#include <err.h>
#include <stdio.h>
#include <unistd.h>

static int
read_block(int fd, void *buf, size_t len)
{
	char *p = buf;
	size_t n = len;
	ssize_t nread;

	for (;;) {
		if ((nread = read(fd, p, n)) == -1)
			err(1, "read");
		if (nread == 0) {
			if (n < len)
				errx(1, "partial block");
			return -1; /* eof */
		}
		if ((size_t)nread >= n)
			break;
		p += (size_t)nread;
		n -= (size_t)nread;
	}

	return 0;
}

static void
write_block(int fd, const void *buf, size_t len)
{
	const char *p = buf;
	size_t n = len;
	ssize_t nwrit;

	for (;;) {
		if ((nwrit = write(fd, p, n)) == -1)
			err(1, "write");
		if ((size_t)nwrit >= n)
			break;
		p += (size_t)nwrit;
		n -= (size_t)nwrit;
	}
}

#define	SECSIZE	512

static void
process(void)
{
	static const uint8_t k[32] = {0};
	static uint8_t buf[65536];
	static struct adiantum C;
	uint8_t blkno[16] = {0};
	unsigned i;

	adiantum_init(&C, k);
	while (read_block(STDIN_FILENO, buf, sizeof buf) == 0) {
		for (i = 0; i < sizeof buf; i += SECSIZE) {
			adiantum_enc(buf + i, buf + i, SECSIZE, blkno, 16, &C);
			le64enc(blkno, 1 + le32dec(blkno));
		}
		write_block(STDOUT_FILENO, buf, sizeof buf);
		if (le64dec(blkno) == 1024*1024*1024/SECSIZE)
			return;
	}
}

int
main(void)
{
	int result = 0;

	result |= addsub128_selftest();
	result |= poly1305_selftest();
	result |= nh_selftest();
	result |= nhpoly1305_selftest();
	result |= adiantum_selftest();
	if (result)
		return result;

	process();
	return 0;
}

#endif	/* _KERNEL */
