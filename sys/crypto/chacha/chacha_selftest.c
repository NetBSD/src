/*	$NetBSD: chacha_selftest.c,v 1.1 2020/07/25 22:46:34 riastradh Exp $	*/

/*-
 * Copyright (c) 2020 The NetBSD Foundation, Inc.
 * All rights reserved.
 *
 * Redistribution and use in source and binary forms, with or without
 * modification, are permitted provided that the following conditions
 * are met:
 * 1. Redistributions of source code must retain the above copyright
 *    notice, this list of conditions and the following disclaimer.
 * 2. Redistributions in binary form must reproduce the above copyright
 *    notice, this list of conditions and the following disclaimer in the
 *    documentation and/or other materials provided with the distribution.
 *
 * THIS SOFTWARE IS PROVIDED BY THE NETBSD FOUNDATION, INC. AND CONTRIBUTORS
 * ``AS IS'' AND ANY EXPRESS OR IMPLIED WARRANTIES, INCLUDING, BUT NOT LIMITED
 * TO, THE IMPLIED WARRANTIES OF MERCHANTABILITY AND FITNESS FOR A PARTICULAR
 * PURPOSE ARE DISCLAIMED.  IN NO EVENT SHALL THE FOUNDATION OR CONTRIBUTORS
 * BE LIABLE FOR ANY DIRECT, INDIRECT, INCIDENTAL, SPECIAL, EXEMPLARY, OR
 * CONSEQUENTIAL DAMAGES (INCLUDING, BUT NOT LIMITED TO, PROCUREMENT OF
 * SUBSTITUTE GOODS OR SERVICES; LOSS OF USE, DATA, OR PROFITS; OR BUSINESS
 * INTERRUPTION) HOWEVER CAUSED AND ON ANY THEORY OF LIABILITY, WHETHER IN
 * CONTRACT, STRICT LIABILITY, OR TORT (INCLUDING NEGLIGENCE OR OTHERWISE)
 * ARISING IN ANY WAY OUT OF THE USE OF THIS SOFTWARE, EVEN IF ADVISED OF THE
 * POSSIBILITY OF SUCH DAMAGE.
 */

#include "chacha_impl.h"

#ifdef _KERNEL

#include <lib/libkern/libkern.h>

#else

#include <stdio.h>
#include <string.h>

static void
hexdump(int (*prf)(const char *, ...) __printflike(1,2), const char *prefix,
    const void *buf, size_t len)
{
	const uint8_t *p = buf;
	size_t i;

	(*prf)("%s (%zu bytes @ %p)\n", prefix, len, buf);
	for (i = 0; i < len; i++) {
		if (i % 16 == 8)
			(*prf)("  ");
		else
			(*prf)(" ");
		(*prf)("%02hhx", p[i]);
		if ((i + 1) % 16 == 0)
			(*prf)("\n");
	}
	if (i % 16)
		(*prf)("\n");
}

#endif

/* https://tools.ietf.org/html/draft-strombergson-chacha-test-vectors-00 */
static int
chacha_core_selftest(const struct chacha_impl *ci)
{
	/* TC1, 32-byte key, rounds=12, keystream block 1 */
	static const uint8_t zero[32];
	static const uint8_t expected0[64] = {
		0x9b,0xf4,0x9a,0x6a, 0x07,0x55,0xf9,0x53,
		0x81,0x1f,0xce,0x12, 0x5f,0x26,0x83,0xd5,
		0x04,0x29,0xc3,0xbb, 0x49,0xe0,0x74,0x14,
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		0x61,0x0b,0xe8,0x2f, 0x41,0x13,0x26,0xbe,
	};
	/* TC7, 32-byte key, rounds=12, keystream block 2 */
	static const uint8_t k1[32] = {
		0x00,0x11,0x22,0x33, 0x44,0x55,0x66,0x77,
		0x88,0x99,0xaa,0xbb, 0xcc,0xdd,0xee,0xff,
		0xff,0xee,0xdd,0xcc, 0xbb,0xaa,0x99,0x88,
		0x77,0x66,0x55,0x44, 0x33,0x22,0x11,0x00,
	};
	static const uint8_t in1[16] = {
		0x01,0x00,0x00,0x00, 0x00,0x00,0x00,0x00,
		0x0f,0x1e,0x2d,0x3c, 0x4b,0x59,0x68,0x77,
	};
	static const uint8_t expected1[64] = {
		0xcd,0x9a,0x2a,0xa9, 0xea,0x93,0xc2,0x67,
		0x5e,0x82,0x88,0x14, 0x08,0xde,0x85,0x2c,
		0x62,0xfa,0x74,0x6a, 0x30,0xe5,0x2b,0x45,
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		0x03,0x28,0x36,0xf4, 0x96,0x71,0x83,0x3e,
	};
	uint8_t out[64];
	int result = 0;

	(*ci->ci_chacha_core)(out, zero, zero, chacha_const32, 12);
	if (memcmp(out, expected0, 64)) {
		hexdump(printf, "chacha core 1", out, sizeof out);
		result = -1;
	}

	(*ci->ci_chacha_core)(out, in1, k1, chacha_const32, 12);
	if (memcmp(out, expected1, 64)) {
		hexdump(printf, "chacha core 2", out, sizeof out);
		result = -1;
	}

	return result;
}

static int
hchacha_selftest(const struct chacha_impl *ci)
{
	/* https://tools.ietf.org/html/draft-irtf-cfrg-xchacha-03, §2.2.1 */
	static const uint8_t k[32] = {
		0x00,0x01,0x02,0x03, 0x04,0x05,0x06,0x07,
		0x08,0x09,0x0a,0x0b, 0x0c,0x0d,0x0e,0x0f,
		0x10,0x11,0x12,0x13, 0x14,0x15,0x16,0x17,
		0x18,0x19,0x1a,0x1b, 0x1c,0x1d,0x1e,0x1f,
	};
	static const uint8_t in[16] = {
		0x00,0x00,0x00,0x09, 0x00,0x00,0x00,0x4a,
		0x00,0x00,0x00,0x00, 0x31,0x41,0x59,0x27,
	};
	static const uint8_t expected[32] = {
		0x82,0x41,0x3b,0x42, 0x27,0xb2,0x7b,0xfe,
		0xd3,0x0e,0x42,0x50, 0x8a,0x87,0x7d,0x73,
		0xa0,0xf9,0xe4,0xd5, 0x8a,0x74,0xa8,0x53,
		0xc1,0x2e,0xc4,0x13, 0x26,0xd3,0xec,0xdc,
	};
	uint8_t out[32];
	int result = 0;

	(*ci->ci_hchacha)(out, in, k, chacha_const32, 20);
	if (memcmp(out, expected, 32)) {
		hexdump(printf, "hchacha", out, sizeof out);
		result = -1;
	}

	return result;
}

static int
chacha_stream_selftest(const struct chacha_impl *ci)
{

	/* XXX */
	return 0;
}

static int
xchacha_stream_selftest(const struct chacha_impl *ci)
{
	/* https://tools.ietf.org/html/draft-irtf-cfrg-xchacha-03, A.2.1 */
	static const uint8_t k[32] = {
		0x80,0x81,0x82,0x83, 0x84,0x85,0x86,0x87,
		0x88,0x89,0x8a,0x8b, 0x8c,0x8d,0x8e,0x8f,
		0x90,0x91,0x92,0x93, 0x94,0x95,0x96,0x97,
		0x98,0x99,0x9a,0x9b, 0x9c,0x9d,0x9e,0x9f,
	};
	static const uint8_t nonce[24] = {
		0x40,0x41,0x42,0x43, 0x44,0x45,0x46,0x47,
		0x48,0x49,0x4a,0x4b, 0x4c,0x4d,0x4e,0x4f,
		0x50,0x51,0x52,0x53, 0x54,0x55,0x56,0x58,
	};
	static const uint8_t p[608] = {
		0x54,0x68,0x65,0x20, 0x64,0x68,0x6f,0x6c,
		0x65,0x20,0x28,0x70, 0x72,0x6f,0x6e,0x6f,
		0x75,0x6e,0x63,0x65, 0x64,0x20,0x22,0x64,
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		0x43,0x61,0x6e,0x69, 0x64,0x61,0x65,0x2e,
	};
	static const uint8_t expected[608] = {
		0x45,0x59,0xab,0xba, 0x4e,0x48,0xc1,0x61,
		0x02,0xe8,0xbb,0x2c, 0x05,0xe6,0x94,0x7f,
		0x50,0xa7,0x86,0xde, 0x16,0x2f,0x9b,0x0b,
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		0x92,0x76,0xab,0xfa, 0xce,0x5b,0x17,0x14,
	};
	uint8_t c[608];
	unsigned i;
	int result = 0;

	/*
	 * 608 = 96 (mod 256)
	 * 607 = 95 (mod 256), = 7 (mod 8)
	 * 543 = 31 (mod 256), = 7 (mod 8)
	 * 511 = 255 (mod 256), = 7 (mod 8)
	 *
	 * This exercises several branches when there are special cases
	 * for integral numbers of 4-byte words, integral numbers of
	 * 64-byte blocks, and integral numbers of 256-byte chunks.
	 */

	(*ci->ci_xchacha_stream)(c, 608, 0, nonce, k, 20);
	for (i = 0; i < 608; i++)
		c[i] ^= p[i];
	if (memcmp(c, expected, 608)) {
		for (i = 0; i < 608; i++)
			c[i] ^= p[i];
		hexdump(printf, "xchacha_stream", c, 608);
		for (i = 0; i < 608; i++)
			c[i] = expected[i] ^ p[i];
		hexdump(printf, "expected", c, 608);
		result = -1;
	}

	(*ci->ci_xchacha_stream)(c, 607, 0, nonce, k, 20);
	for (i = 0; i < 607; i++)
		c[i] ^= p[i];
	if (memcmp(c, expected, 607)) {
		for (i = 0; i < 607; i++)
			c[i] ^= p[i];
		hexdump(printf, "xchacha_stream", c, 607);
		for (i = 0; i < 607; i++)
			c[i] = expected[i] ^ p[i];
		hexdump(printf, "expected", c, 607);
		result = -1;
	}

	(*ci->ci_xchacha_stream)(c, 543, 0, nonce, k, 20);
	for (i = 0; i < 543; i++)
		c[i] ^= p[i];
	if (memcmp(c, expected, 543)) {
		for (i = 0; i < 543; i++)
			c[i] ^= p[i];
		hexdump(printf, "xchacha_stream", c, 543);
		for (i = 0; i < 543; i++)
			c[i] = expected[i] ^ p[i];
		hexdump(printf, "expected", c, 543);
		result = -1;
	}

	(*ci->ci_xchacha_stream)(c, 511, 0, nonce, k, 20);
	for (i = 0; i < 511; i++)
		c[i] ^= p[i];
	if (memcmp(c, expected, 511)) {
		for (i = 0; i < 511; i++)
			c[i] ^= p[i];
		hexdump(printf, "xchacha_stream", c, 511);
		for (i = 0; i < 511; i++)
			c[i] = expected[i] ^ p[i];
		hexdump(printf, "expected", c, 511);
		result = -1;
	}

	(*ci->ci_xchacha_stream)(c, 63, 0, nonce, k, 20);
	for (i = 0; i < 63; i++)
		c[i] ^= p[i];
	if (memcmp(c, expected, 63)) {
		for (i = 0; i < 63; i++)
			c[i] ^= p[i];
		hexdump(printf, "xchacha_stream", c, 63);
		for (i = 0; i < 63; i++)
			c[i] = expected[i] ^ p[i];
		hexdump(printf, "expected", c, 63);
		result = -1;
	}

	(*ci->ci_xchacha_stream_xor)(c, p, 608, 0, nonce, k, 20);
	if (memcmp(c, expected, 608)) {
		hexdump(printf, "xchacha_stream_xor", c, 608);
		hexdump(printf, "expected", expected, 608);
		result = -1;
	}

	memset(c, 0, sizeof c);
	(*ci->ci_xchacha_stream_xor)(c, p, 607, 0, nonce, k, 20);
	if (memcmp(c, expected, 607)) {
		hexdump(printf, "xchacha_stream_xor", c, 607);
		hexdump(printf, "expected", expected, 607);
		result = -1;
	}

	memset(c, 0, sizeof c);
	(*ci->ci_xchacha_stream_xor)(c, p, 543, 0, nonce, k, 20);
	if (memcmp(c, expected, 543)) {
		hexdump(printf, "xchacha_stream_xor", c, 543);
		hexdump(printf, "expected", expected, 543);
		result = -1;
	}

	memset(c, 0, sizeof c);
	(*ci->ci_xchacha_stream_xor)(c, p, 511, 0, nonce, k, 20);
	if (memcmp(c, expected, 511)) {
		hexdump(printf, "xchacha_stream_xor", c, 511);
		hexdump(printf, "expected", expected, 511);
		result = -1;
	}

	memset(c, 0, sizeof c);
	(*ci->ci_xchacha_stream_xor)(c, p, 63, 0, nonce, k, 20);
	if (memcmp(c, expected, 63)) {
		hexdump(printf, "xchacha_stream_xor", c, 63);
		hexdump(printf, "expected", expected, 63);
		result = -1;
	}

	return result;
}

int
chacha_selftest(const struct chacha_impl *ci)
{
	int result = 0;

	result |= chacha_core_selftest(ci);
	result |= chacha_stream_selftest(ci);
	result |= hchacha_selftest(ci);
	result |= xchacha_stream_selftest(ci);

	return result;
}
